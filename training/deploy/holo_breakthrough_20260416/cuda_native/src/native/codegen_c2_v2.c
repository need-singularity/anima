// Generated by HEXA self-host compiler
#include "runtime.c"

HexaVal codegen_c2(HexaVal ast);
HexaVal gen2_fn_forward(HexaVal node);
HexaVal gen2_fn_decl(HexaVal node);
HexaVal gen2_extern_ret_kind(HexaVal ret_type);
HexaVal gen2_ffi_c_type(HexaVal typ);
HexaVal gen2_ffi_c_ret_type(HexaVal ret_type);
HexaVal gen2_has_float_param(HexaVal params);
HexaVal gen2_ffi_marshal_arg(HexaVal param_name, HexaVal param_type);
HexaVal gen2_ffi_wrap_ret(HexaVal ret_type, HexaVal var_name);
HexaVal gen2_static_c_type(HexaVal typ);
HexaVal gen2_extern_static_decl(HexaVal node);
HexaVal gen2_extern_includes(HexaVal ast);
HexaVal gen2_static_ffi_block(HexaVal ast);
HexaVal gen2_extern_wrapper(HexaVal node);
HexaVal gen2_indent(HexaVal n);
HexaVal gen2_stmt(HexaVal node, HexaVal depth);
HexaVal c_escape(HexaVal s);
HexaVal gen2_method_builtin(HexaVal obj_expr, HexaVal method, HexaVal args);
HexaVal gen2_expr(HexaVal node);
HexaVal gen2_struct_decl(HexaVal node);
HexaVal gen2_enum_decl(HexaVal node);
HexaVal gen2_match_stmt(HexaVal node, HexaVal depth);
HexaVal gen2_match_cond(HexaVal pat, HexaVal scrutinee_var);
HexaVal gen2_match_expr(HexaVal node);
HexaVal gen2_match_ternary(HexaVal arms, HexaVal scrutinee_c, HexaVal idx);
HexaVal gen2_arm_value(HexaVal body);
HexaVal _method_registry_lookup(HexaVal name);
HexaVal gen2_impl_block(HexaVal node);
HexaVal _is_known_fn_global(HexaVal name);
HexaVal _is_known_nonlocal(HexaVal name);
HexaVal _is_known_global(HexaVal name);
HexaVal _is_builtin_name(HexaVal name);
HexaVal _add_unique(HexaVal list, HexaVal name);
HexaVal gen2_collect_free(HexaVal node, HexaVal bound, HexaVal out);
HexaVal gen2_lambda_expr(HexaVal node);
HexaVal codegen_c2_full(HexaVal ast);

HexaVal _method_registry;
HexaVal _lambda_counter;
HexaVal _lambda_def_parts;
HexaVal _known_fn_globals;
HexaVal _known_nonlocal_names;

/* rt#37: inline-cache slot accumulator. Each "Field" emission appends a line
 * like "static HexaIC __hexa_ic_N = {0};\n" here; codegen_c2 concatenates
 * these after the #include so every call site has a file-scope slot. */
HexaVal _ic_def_parts;
int _ic_def_parts_init = 0;

HexaVal codegen_c2(HexaVal ast) {
    HexaVal parts = hexa_array_new();
    parts = hexa_array_push(parts, hexa_str("// Generated by HEXA self-host compiler\n"));
    parts = hexa_array_push(parts, hexa_str("#include \"runtime.c\"\n\n"));
    _known_fn_globals = hexa_array_new();
    _known_nonlocal_names = hexa_array_new();
    _lambda_counter = hexa_int(0);
    _lambda_def_parts = hexa_array_new();
    /* rt#37: reset inline-cache accumulator for each codegen invocation. */
    _ic_def_parts = hexa_array_new();
    _ic_def_parts_init = 1;
    HexaVal _gi = hexa_int(0);
    while (hexa_truthy(hexa_bool((_gi).i < (hexa_int(hexa_len(ast))).i))) {
        HexaVal _gk = hexa_map_get(hexa_index_get(ast, _gi), "kind");
        if (hexa_truthy(hexa_bool(hexa_truthy(hexa_bool(hexa_truthy(hexa_bool(hexa_truthy(hexa_eq(_gk, hexa_str("FnDecl"))) || hexa_truthy(hexa_eq(_gk, hexa_str("ExternFnDecl"))))) || hexa_truthy(hexa_eq(_gk, hexa_str("PureFnDecl"))))) || hexa_truthy(hexa_eq(_gk, hexa_str("OptimizeFnStmt")))))) {
            _known_fn_globals = hexa_array_push(_known_fn_globals, hexa_map_get(hexa_index_get(ast, _gi), "name"));
            _known_nonlocal_names = hexa_array_push(_known_nonlocal_names, hexa_map_get(hexa_index_get(ast, _gi), "name"));
        } else {
            if (hexa_truthy(hexa_eq(_gk, hexa_str("StructDecl")))) {
                _known_fn_globals = hexa_array_push(_known_fn_globals, hexa_map_get(hexa_index_get(ast, _gi), "name"));
                _known_nonlocal_names = hexa_array_push(_known_nonlocal_names, hexa_map_get(hexa_index_get(ast, _gi), "name"));
            } else {
                if (hexa_truthy(hexa_eq(_gk, hexa_str("EnumDecl")))) {
                    _known_nonlocal_names = hexa_array_push(_known_nonlocal_names, hexa_map_get(hexa_index_get(ast, _gi), "name"));
                } else {
                    if (hexa_truthy(hexa_eq(_gk, hexa_str("ComptimeConst")))) {
                        _known_nonlocal_names = hexa_array_push(_known_nonlocal_names, hexa_map_get(hexa_index_get(ast, _gi), "name"));
                    } else {
                        if (hexa_truthy(hexa_bool(hexa_truthy(hexa_eq(_gk, hexa_str("LetMutStmt"))) || hexa_truthy(hexa_eq(_gk, hexa_str("LetStmt")))))) {
                            _known_nonlocal_names = hexa_array_push(_known_nonlocal_names, hexa_map_get(hexa_index_get(ast, _gi), "name"));
                        }
                    }
                }
            }
        }
        _gi = hexa_add(_gi, hexa_int(1));
    }
    HexaVal fwd_parts = hexa_array_new();
    HexaVal global_parts = hexa_array_new();
    HexaVal fn_parts = hexa_array_new();
    HexaVal main_parts = hexa_array_new();
    HexaVal extern_fns = hexa_array_new();
    HexaVal i = hexa_int(0);
    while (hexa_truthy(hexa_bool((i).i < (hexa_int(hexa_len(ast))).i))) {
        HexaVal k = hexa_map_get(hexa_index_get(ast, i), "kind");
        if (hexa_truthy(hexa_eq(k, hexa_str("FnDecl")))) {
            fwd_parts = hexa_array_push(fwd_parts, hexa_add(gen2_fn_forward(hexa_index_get(ast, i)), hexa_str("\n")));
            fn_parts = hexa_array_push(fn_parts, hexa_add(gen2_fn_decl(hexa_index_get(ast, i)), hexa_str("\n\n")));
        } else {
            if (hexa_truthy(hexa_eq(k, hexa_str("ExternFnDecl")))) {
                extern_fns = hexa_array_push(extern_fns, hexa_map_get(hexa_index_get(ast, i), "name"));
                HexaVal ew = gen2_extern_wrapper(hexa_index_get(ast, i));
                global_parts = hexa_array_push(global_parts, hexa_map_get(ew, "global"));
                fwd_parts = hexa_array_push(fwd_parts, hexa_add(hexa_map_get(ew, "forward"), hexa_str("\n")));
                fn_parts = hexa_array_push(fn_parts, hexa_add(hexa_map_get(ew, "fn_code"), hexa_str("\n\n")));
                main_parts = hexa_array_push(main_parts, hexa_map_get(ew, "init"));
            } else {
                if (hexa_truthy(hexa_eq(k, hexa_str("StructDecl")))) {
                    fn_parts = hexa_array_push(fn_parts, hexa_add(gen2_struct_decl(hexa_index_get(ast, i)), hexa_str("\n\n")));
                } else {
                    if (hexa_truthy(hexa_eq(k, hexa_str("EnumDecl")))) {
                        fn_parts = hexa_array_push(fn_parts, hexa_add(gen2_enum_decl(hexa_index_get(ast, i)), hexa_str("\n")));
                    } else {
                        if (hexa_truthy(hexa_eq(k, hexa_str("ImplBlock")))) {
                            HexaVal ib = gen2_impl_block(hexa_index_get(ast, i));
                            fwd_parts = hexa_array_push(fwd_parts, hexa_map_get(ib, "forward"));
                            fn_parts = hexa_array_push(fn_parts, hexa_map_get(ib, "fn_code"));
                        } else {
                            if (hexa_truthy(hexa_eq(k, hexa_str("TraitDecl")))) {
                            } else {
                                if (hexa_truthy(hexa_eq(k, hexa_str("LetMutStmt")))) {
                                    global_parts = hexa_array_push(global_parts, hexa_add(hexa_add(hexa_str("HexaVal "), hexa_map_get(hexa_index_get(ast, i), "name")), hexa_str(";\n")));
                                    if (hexa_truthy(hexa_bool(!hexa_truthy(hexa_eq(hexa_type_of(hexa_map_get(hexa_index_get(ast, i), "left")), hexa_str("string")))))) {
                                        main_parts = hexa_array_push(main_parts, hexa_add(hexa_add(hexa_add(hexa_add(hexa_str("    "), hexa_map_get(hexa_index_get(ast, i), "name")), hexa_str(" = ")), gen2_expr(hexa_map_get(hexa_index_get(ast, i), "left"))), hexa_str(";\n")));
                                    } else {
                                        main_parts = hexa_array_push(main_parts, hexa_add(hexa_add(hexa_str("    "), hexa_map_get(hexa_index_get(ast, i), "name")), hexa_str(" = hexa_void();\n")));
                                    }
                                } else {
                                    main_parts = hexa_array_push(main_parts, gen2_stmt(hexa_index_get(ast, i), hexa_int(1)));
                                }
                            }
                        }
                    }
                }
            }
        }
        i = hexa_add(i, hexa_int(1));
    }
    parts = hexa_array_push(parts, hexa_str_join(fwd_parts, hexa_str("")));
    parts = hexa_array_push(parts, hexa_str("\n"));
    parts = hexa_array_push(parts, hexa_str_join(global_parts, hexa_str("")));
    parts = hexa_array_push(parts, hexa_str("\n"));
    /* rt#37: emit all inline-cache slot defs before any fn body uses them. */
    if (_ic_def_parts_init) {
        parts = hexa_array_push(parts, hexa_str_join(_ic_def_parts, hexa_str("")));
        parts = hexa_array_push(parts, hexa_str("\n"));
    }
    parts = hexa_array_push(parts, hexa_str_join(_lambda_def_parts, hexa_str("")));
    parts = hexa_array_push(parts, hexa_str_join(fn_parts, hexa_str("")));
    parts = hexa_array_push(parts, hexa_str("int main() {\n"));
    parts = hexa_array_push(parts, hexa_str_join(main_parts, hexa_str("")));
    parts = hexa_array_push(parts, hexa_str("    return 0;\n}\n"));
    return hexa_str_join(parts, hexa_str(""));
    return hexa_void();
}


HexaVal gen2_fn_forward(HexaVal node) {
    HexaVal params = hexa_array_new();
    HexaVal i = hexa_int(0);
    while (hexa_truthy(hexa_bool((i).i < (hexa_int(hexa_len(hexa_map_get(node, "params")))).i))) {
        params = hexa_array_push(params, hexa_add(hexa_str("HexaVal "), hexa_map_get(hexa_index_get(hexa_map_get(node, "params"), i), "name")));
        i = hexa_add(i, hexa_int(1));
    }
    HexaVal p = hexa_str_join(params, hexa_str(", "));
    if (hexa_truthy(hexa_eq(p, hexa_str("")))) {
        p = hexa_str("void");
    }
    return hexa_add(hexa_add(hexa_add(hexa_add(hexa_str("HexaVal "), hexa_map_get(node, "name")), hexa_str("(")), p), hexa_str(");"));
    return hexa_void();
}


HexaVal gen2_fn_decl(HexaVal node) {
    HexaVal params = hexa_array_new();
    HexaVal i = hexa_int(0);
    while (hexa_truthy(hexa_bool((i).i < (hexa_int(hexa_len(hexa_map_get(node, "params")))).i))) {
        params = hexa_array_push(params, hexa_add(hexa_str("HexaVal "), hexa_map_get(hexa_index_get(hexa_map_get(node, "params"), i), "name")));
        i = hexa_add(i, hexa_int(1));
    }
    HexaVal p = hexa_str_join(params, hexa_str(", "));
    if (hexa_truthy(hexa_eq(p, hexa_str("")))) {
        p = hexa_str("void");
    }
    HexaVal chunks = hexa_array_new();
    chunks = hexa_array_push(chunks, hexa_add(hexa_add(hexa_add(hexa_add(hexa_str("HexaVal "), hexa_map_get(node, "name")), hexa_str("(")), p), hexa_str(") {\n")));
    HexaVal bi = hexa_int(0);
    while (hexa_truthy(hexa_bool((bi).i < (hexa_int(hexa_len(hexa_map_get(node, "body")))).i))) {
        chunks = hexa_array_push(chunks, gen2_stmt(hexa_index_get(hexa_map_get(node, "body"), bi), hexa_int(1)));
        bi = hexa_add(bi, hexa_int(1));
    }
    chunks = hexa_array_push(chunks, hexa_str("    return hexa_void();\n}\n"));
    return hexa_str_join(chunks, hexa_str(""));
    return hexa_void();
}


HexaVal gen2_extern_ret_kind(HexaVal ret_type) {
    if (hexa_truthy(hexa_bool(hexa_truthy(hexa_bool(hexa_truthy(hexa_eq(ret_type, hexa_str("Void"))) || hexa_truthy(hexa_eq(ret_type, hexa_str("void"))))) || hexa_truthy(hexa_eq(ret_type, hexa_str("")))))) {
        return hexa_str("0");
    }
    if (hexa_truthy(hexa_bool(hexa_truthy(hexa_eq(ret_type, hexa_str("Int"))) || hexa_truthy(hexa_eq(ret_type, hexa_str("int")))))) {
        return hexa_str("1");
    }
    if (hexa_truthy(hexa_bool(hexa_truthy(hexa_eq(ret_type, hexa_str("Float"))) || hexa_truthy(hexa_eq(ret_type, hexa_str("float")))))) {
        return hexa_str("2");
    }
    if (hexa_truthy(hexa_bool(hexa_truthy(hexa_eq(ret_type, hexa_str("Bool"))) || hexa_truthy(hexa_eq(ret_type, hexa_str("bool")))))) {
        return hexa_str("3");
    }
    return hexa_str("4");
    return hexa_void();
}


HexaVal gen2_ffi_c_type(HexaVal typ) {
    if (hexa_truthy(hexa_bool(hexa_truthy(hexa_eq(typ, hexa_str("Float"))) || hexa_truthy(hexa_eq(typ, hexa_str("float")))))) {
        return hexa_str("double");
    }
    return hexa_str("int64_t");
    return hexa_void();
}


HexaVal gen2_ffi_c_ret_type(HexaVal ret_type) {
    if (hexa_truthy(hexa_bool(hexa_truthy(hexa_bool(hexa_truthy(hexa_eq(ret_type, hexa_str("Void"))) || hexa_truthy(hexa_eq(ret_type, hexa_str("void"))))) || hexa_truthy(hexa_eq(ret_type, hexa_str("")))))) {
        return hexa_str("void");
    }
    if (hexa_truthy(hexa_bool(hexa_truthy(hexa_eq(ret_type, hexa_str("Float"))) || hexa_truthy(hexa_eq(ret_type, hexa_str("float")))))) {
        return hexa_str("double");
    }
    return hexa_str("int64_t");
    return hexa_void();
}


HexaVal gen2_has_float_param(HexaVal params) {
    HexaVal i = hexa_int(0);
    while (hexa_truthy(hexa_bool((i).i < (hexa_int(hexa_len(params))).i))) {
        HexaVal t = hexa_map_get(hexa_index_get(params, i), "value");
        if (hexa_truthy(hexa_bool(hexa_truthy(hexa_eq(t, hexa_str("Float"))) || hexa_truthy(hexa_eq(t, hexa_str("float")))))) {
            return hexa_int(1);
        }
        i = hexa_add(i, hexa_int(1));
    }
    return hexa_int(0);
    return hexa_void();
}


HexaVal gen2_ffi_marshal_arg(HexaVal param_name, HexaVal param_type) {
    if (hexa_truthy(hexa_bool(hexa_truthy(hexa_eq(param_type, hexa_str("Float"))) || hexa_truthy(hexa_eq(param_type, hexa_str("float")))))) {
        return hexa_add(hexa_add(hexa_add(hexa_add(hexa_add(hexa_add(hexa_str("("), param_name), hexa_str(".tag==TAG_FLOAT?")), param_name), hexa_str(".f:(double)")), param_name), hexa_str(".i)"));
    }
    return hexa_add(hexa_add(hexa_add(hexa_add(hexa_add(hexa_add(hexa_str("("), param_name), hexa_str(".tag==TAG_INT?")), param_name), hexa_str(".i:(int64_t)")), param_name), hexa_str(".f)"));
    return hexa_void();
}


HexaVal gen2_ffi_wrap_ret(HexaVal ret_type, HexaVal var_name) {
    if (hexa_truthy(hexa_bool(hexa_truthy(hexa_bool(hexa_truthy(hexa_eq(ret_type, hexa_str("Void"))) || hexa_truthy(hexa_eq(ret_type, hexa_str("void"))))) || hexa_truthy(hexa_eq(ret_type, hexa_str("")))))) {
        return hexa_str("hexa_void()");
    }
    if (hexa_truthy(hexa_bool(hexa_truthy(hexa_eq(ret_type, hexa_str("Float"))) || hexa_truthy(hexa_eq(ret_type, hexa_str("float")))))) {
        return hexa_add(hexa_add(hexa_str("hexa_float("), var_name), hexa_str(")"));
    }
    if (hexa_truthy(hexa_bool(hexa_truthy(hexa_eq(ret_type, hexa_str("Bool"))) || hexa_truthy(hexa_eq(ret_type, hexa_str("bool")))))) {
        return hexa_add(hexa_add(hexa_str("hexa_bool("), var_name), hexa_str(" != 0)"));
    }
    return hexa_add(hexa_add(hexa_str("hexa_int("), var_name), hexa_str(")"));
    return hexa_void();
}


HexaVal gen2_static_c_type(HexaVal typ) {
    if (hexa_truthy(hexa_bool(hexa_truthy(hexa_bool(hexa_truthy(hexa_eq(typ, hexa_str("i64"))) || hexa_truthy(hexa_eq(typ, hexa_str("Int"))))) || hexa_truthy(hexa_eq(typ, hexa_str("int")))))) {
        return hexa_str("long long");
    }
    if (hexa_truthy(hexa_eq(typ, hexa_str("i32")))) {
        return hexa_str("int");
    }
    if (hexa_truthy(hexa_bool(hexa_truthy(hexa_bool(hexa_truthy(hexa_eq(typ, hexa_str("f64"))) || hexa_truthy(hexa_eq(typ, hexa_str("Float"))))) || hexa_truthy(hexa_eq(typ, hexa_str("float")))))) {
        return hexa_str("double");
    }
    if (hexa_truthy(hexa_eq(typ, hexa_str("f32")))) {
        return hexa_str("float");
    }
    if (hexa_truthy(hexa_bool(hexa_truthy(hexa_bool(hexa_truthy(hexa_eq(typ, hexa_str("str"))) || hexa_truthy(hexa_eq(typ, hexa_str("Str"))))) || hexa_truthy(hexa_eq(typ, hexa_str("String")))))) {
        return hexa_str("char*");
    }
    if (hexa_truthy(hexa_bool(hexa_truthy(hexa_eq(typ, hexa_str("bool"))) || hexa_truthy(hexa_eq(typ, hexa_str("Bool")))))) {
        return hexa_str("int");
    }
    if (hexa_truthy(hexa_bool(hexa_truthy(hexa_bool(hexa_truthy(hexa_eq(typ, hexa_str("void"))) || hexa_truthy(hexa_eq(typ, hexa_str("Void"))))) || hexa_truthy(hexa_eq(typ, hexa_str("")))))) {
        return hexa_str("void");
    }
    if (hexa_truthy(hexa_bool(hexa_truthy(hexa_eq(typ, hexa_str("*Void"))) || hexa_truthy(hexa_eq(typ, hexa_str("Ptr")))))) {
        return hexa_str("void*");
    }
    return typ;
    return hexa_void();
}


HexaVal gen2_extern_static_decl(HexaVal node) {
    HexaVal name = hexa_map_get(node, "name");
    HexaVal ret_type = hexa_map_get(node, "ret_type");
    HexaVal c_name = hexa_map_get(node, "value");
    if (hexa_truthy(hexa_eq(c_name, hexa_str("")))) {
        c_name = name;
    }
    HexaVal c_ret = gen2_static_c_type(ret_type);
    HexaVal c_params = hexa_array_new();
    HexaVal i = hexa_int(0);
    while (hexa_truthy(hexa_bool((i).i < (hexa_int(hexa_len(hexa_map_get(node, "params")))).i))) {
        HexaVal p = hexa_index_get(hexa_map_get(node, "params"), i);
        HexaVal c_typ = gen2_static_c_type(hexa_map_get(p, "value"));
        if (hexa_truthy(hexa_eq(c_typ, hexa_str("void")))) {
            c_params = hexa_array_push(c_params, hexa_add(hexa_str("long long "), hexa_map_get(p, "name")));
        } else {
            c_params = hexa_array_push(c_params, hexa_add(hexa_add(c_typ, hexa_str(" ")), hexa_map_get(p, "name")));
        }
        i = hexa_add(i, hexa_int(1));
    }
    HexaVal params_str = hexa_str_join(c_params, hexa_str(", "));
    HexaVal sig = params_str;
    if (hexa_truthy(hexa_eq(sig, hexa_str("")))) {
        sig = hexa_str("void");
    }
    HexaVal parts = hexa_array_new();
    if (hexa_truthy(hexa_bool(!hexa_truthy(hexa_eq(hexa_map_get(node, "op"), hexa_str("")))))) {
        parts = hexa_array_push(parts, hexa_add(hexa_add(hexa_str("// link: -l"), hexa_map_get(node, "op")), hexa_str("\n")));
    }
    parts = hexa_array_push(parts, hexa_add(hexa_add(hexa_add(hexa_add(hexa_add(hexa_add(hexa_str("extern "), c_ret), hexa_str(" ")), c_name), hexa_str("(")), sig), hexa_str(");\n")));
    return hexa_str_join(parts, hexa_str(""));
    return hexa_void();
}


HexaVal gen2_extern_includes(HexaVal ast) {
    HexaVal needs_stdio = hexa_int(0);
    HexaVal needs_stdlib = hexa_int(0);
    HexaVal needs_string = hexa_int(0);
    HexaVal needs_math = hexa_int(0);
    HexaVal has_extern = hexa_int(0);
    HexaVal i = hexa_int(0);
    while (hexa_truthy(hexa_bool((i).i < (hexa_int(hexa_len(ast))).i))) {
        if (hexa_truthy(hexa_eq(hexa_map_get(hexa_index_get(ast, i), "kind"), hexa_str("ExternFnDecl")))) {
            has_extern = hexa_int(1);
            if (hexa_truthy(hexa_bool(hexa_truthy(hexa_eq(hexa_map_get(hexa_index_get(ast, i), "op"), hexa_str("m"))) || hexa_truthy(hexa_eq(hexa_map_get(hexa_index_get(ast, i), "op"), hexa_str("libm")))))) {
                needs_math = hexa_int(1);
            }
            HexaVal j = hexa_int(0);
            while (hexa_truthy(hexa_bool((j).i < (hexa_int(hexa_len(hexa_map_get(hexa_index_get(ast, i), "params")))).i))) {
                HexaVal t = hexa_map_get(hexa_index_get(hexa_map_get(hexa_index_get(ast, i), "params"), j), "value");
                if (hexa_truthy(hexa_bool(hexa_truthy(hexa_bool(hexa_truthy(hexa_eq(t, hexa_str("str"))) || hexa_truthy(hexa_eq(t, hexa_str("Str"))))) || hexa_truthy(hexa_eq(t, hexa_str("String")))))) {
                    needs_string = hexa_int(1);
                }
                j = hexa_add(j, hexa_int(1));
            }
            HexaVal rt = hexa_map_get(hexa_index_get(ast, i), "ret_type");
            if (hexa_truthy(hexa_bool(hexa_truthy(hexa_bool(hexa_truthy(hexa_eq(rt, hexa_str("str"))) || hexa_truthy(hexa_eq(rt, hexa_str("Str"))))) || hexa_truthy(hexa_eq(rt, hexa_str("String")))))) {
                needs_string = hexa_int(1);
            }
        }
        i = hexa_add(i, hexa_int(1));
    }
    if (hexa_truthy(hexa_eq(has_extern, hexa_int(0)))) {
        return hexa_str("");
    }
    HexaVal includes = hexa_array_new();
    includes = hexa_array_push(includes, hexa_str("#include <stdint.h>\n"));
    if (hexa_truthy(hexa_eq(needs_math, hexa_int(1)))) {
        includes = hexa_array_push(includes, hexa_str("#include <math.h>\n"));
    }
    if (hexa_truthy(hexa_eq(needs_string, hexa_int(1)))) {
        includes = hexa_array_push(includes, hexa_str("#include <string.h>\n"));
    }
    return hexa_str_join(includes, hexa_str(""));
    return hexa_void();
}


HexaVal gen2_static_ffi_block(HexaVal ast) {
    HexaVal includes = gen2_extern_includes(ast);
    HexaVal decls = hexa_array_new();
    HexaVal i = hexa_int(0);
    while (hexa_truthy(hexa_bool((i).i < (hexa_int(hexa_len(ast))).i))) {
        if (hexa_truthy(hexa_eq(hexa_map_get(hexa_index_get(ast, i), "kind"), hexa_str("ExternFnDecl")))) {
            decls = hexa_array_push(decls, gen2_extern_static_decl(hexa_index_get(ast, i)));
        }
        i = hexa_add(i, hexa_int(1));
    }
    if (hexa_truthy(hexa_eq(hexa_int(hexa_len(decls)), hexa_int(0)))) {
        return hexa_str("");
    }
    HexaVal parts = hexa_array_new();
    if (hexa_truthy(hexa_bool(!hexa_truthy(hexa_eq(includes, hexa_str("")))))) {
        parts = hexa_array_push(parts, includes);
    }
    parts = hexa_array_push(parts, hexa_str("\n// ── FFI declarations ──\n"));
    parts = hexa_array_push(parts, hexa_str_join(decls, hexa_str("")));
    parts = hexa_array_push(parts, hexa_str("\n"));
    return hexa_str_join(parts, hexa_str(""));
    return hexa_void();
}


HexaVal gen2_extern_wrapper(HexaVal node) {
    HexaVal name = hexa_map_get(node, "name");
    HexaVal nargs = hexa_int(hexa_len(hexa_map_get(node, "params")));
    HexaVal ret_type = hexa_map_get(node, "ret_type");
    HexaVal c_sym = hexa_map_get(node, "value");
    if (hexa_truthy(hexa_eq(c_sym, hexa_str("")))) {
        c_sym = name;
    }
    HexaVal global = hexa_add(hexa_add(hexa_str("static void* __ffi_sym_"), name), hexa_str(" = NULL;\n"));
    HexaVal fwd_params = hexa_array_new();
    HexaVal fi = hexa_int(0);
    while (hexa_truthy(hexa_bool((fi).i < (nargs).i))) {
        fwd_params = hexa_array_push(fwd_params, hexa_add(hexa_str("HexaVal "), hexa_map_get(hexa_index_get(hexa_map_get(node, "params"), fi), "name")));
        fi = hexa_add(fi, hexa_int(1));
    }
    HexaVal fwd_p = hexa_str_join(fwd_params, hexa_str(", "));
    HexaVal sig_p = fwd_p;
    if (hexa_truthy(hexa_eq(sig_p, hexa_str("")))) {
        sig_p = hexa_str("void");
    }
    HexaVal forward = hexa_add(hexa_add(hexa_add(hexa_add(hexa_str("HexaVal "), name), hexa_str("(")), sig_p), hexa_str(");"));
    HexaVal has_float = gen2_has_float_param(hexa_map_get(node, "params"));
    HexaVal impl_parts = hexa_array_new();
    if (hexa_truthy(hexa_bool(hexa_truthy(hexa_eq(has_float, hexa_int(1))) || hexa_truthy(hexa_bool((nargs).i > (hexa_int(0)).i))))) {
        HexaVal c_ret = gen2_ffi_c_ret_type(ret_type);
        HexaVal typedef_params = hexa_array_new();
        HexaVal ti = hexa_int(0);
        while (hexa_truthy(hexa_bool((ti).i < (nargs).i))) {
            typedef_params = hexa_array_push(typedef_params, gen2_ffi_c_type(hexa_map_get(hexa_index_get(hexa_map_get(node, "params"), ti), "value")));
            ti = hexa_add(ti, hexa_int(1));
        }
        HexaVal td_p = hexa_str_join(typedef_params, hexa_str(", "));
        HexaVal td_sig = td_p;
        if (hexa_truthy(hexa_eq(td_sig, hexa_str("")))) {
            td_sig = hexa_str("void");
        }
        impl_parts = hexa_array_push(impl_parts, hexa_add(hexa_add(hexa_add(hexa_add(hexa_add(hexa_add(hexa_str("typedef "), c_ret), hexa_str(" (*__ffi_ftyp_")), name), hexa_str(")(")), td_sig), hexa_str(");\n")));
        impl_parts = hexa_array_push(impl_parts, hexa_add(hexa_add(hexa_add(hexa_add(hexa_str("HexaVal "), name), hexa_str("(")), sig_p), hexa_str(") {\n")));
        HexaVal call_args = hexa_array_new();
        HexaVal ci = hexa_int(0);
        while (hexa_truthy(hexa_bool((ci).i < (nargs).i))) {
            call_args = hexa_array_push(call_args, gen2_ffi_marshal_arg(hexa_map_get(hexa_index_get(hexa_map_get(node, "params"), ci), "name"), hexa_map_get(hexa_index_get(hexa_map_get(node, "params"), ci), "value")));
            ci = hexa_add(ci, hexa_int(1));
        }
        HexaVal call_str = hexa_str_join(call_args, hexa_str(", "));
        if (hexa_truthy(hexa_bool(hexa_truthy(hexa_bool(hexa_truthy(hexa_eq(ret_type, hexa_str("Void"))) || hexa_truthy(hexa_eq(ret_type, hexa_str("void"))))) || hexa_truthy(hexa_eq(ret_type, hexa_str("")))))) {
            impl_parts = hexa_array_push(impl_parts, hexa_add(hexa_add(hexa_add(hexa_add(hexa_add(hexa_add(hexa_str("    ((__ffi_ftyp_"), name), hexa_str(")__ffi_sym_")), name), hexa_str(")(")), call_str), hexa_str(");\n")));
            impl_parts = hexa_array_push(impl_parts, hexa_str("    return hexa_void();\n"));
        } else {
            impl_parts = hexa_array_push(impl_parts, hexa_add(hexa_add(hexa_add(hexa_add(hexa_add(hexa_add(hexa_add(hexa_add(hexa_str("    "), c_ret), hexa_str(" __r = ((__ffi_ftyp_")), name), hexa_str(")__ffi_sym_")), name), hexa_str(")(")), call_str), hexa_str(");\n")));
            impl_parts = hexa_array_push(impl_parts, hexa_add(hexa_add(hexa_str("    return "), gen2_ffi_wrap_ret(ret_type, hexa_str("__r"))), hexa_str(";\n")));
        }
        impl_parts = hexa_array_push(impl_parts, hexa_str("}\n"));
    } else {
        impl_parts = hexa_array_push(impl_parts, hexa_add(hexa_add(hexa_add(hexa_add(hexa_str("HexaVal "), name), hexa_str("(")), sig_p), hexa_str(") {\n")));
        impl_parts = hexa_array_push(impl_parts, hexa_add(hexa_add(hexa_add(hexa_add(hexa_str("    return hexa_extern_call(__ffi_sym_"), name), hexa_str(", NULL, 0, ")), gen2_extern_ret_kind(ret_type)), hexa_str(");\n")));
        impl_parts = hexa_array_push(impl_parts, hexa_str("}\n"));
    }
    HexaVal impl_code = hexa_str_join(impl_parts, hexa_str(""));
    HexaVal lib_arg = hexa_str("NULL");
    if (hexa_truthy(hexa_bool(!hexa_truthy(hexa_eq(hexa_map_get(node, "op"), hexa_str("")))))) {
        lib_arg = hexa_add(hexa_add(hexa_str("\""), hexa_map_get(node, "op")), hexa_str("\""));
    }
    HexaVal init = hexa_add(hexa_add(hexa_add(hexa_add(hexa_add(hexa_add(hexa_str("    __ffi_sym_"), name), hexa_str(" = hexa_ffi_dlsym(hexa_ffi_dlopen(")), lib_arg), hexa_str("), \"")), c_sym), hexa_str("\");\n"));
    return hexa_map_set(hexa_map_set(hexa_map_set(hexa_map_set(hexa_map_set(hexa_map_set(hexa_map_set(hexa_map_set(hexa_map_set(hexa_map_set(hexa_map_set(hexa_map_set(hexa_map_set(hexa_map_set(hexa_map_set(hexa_map_set(hexa_map_set(hexa_map_set(hexa_map_set(hexa_map_set(hexa_map_set(hexa_map_set(hexa_map_set(hexa_map_set(hexa_map_set(hexa_map_new(), "global", global), "forward", forward), "fn_code", impl_code), "init", init), "kind", hexa_str("")), "name", hexa_str("")), "value", hexa_str("")), "op", hexa_str("")), "left", hexa_str("")), "right", hexa_str("")), "cond", hexa_str("")), "then_body", hexa_str("")), "else_body", hexa_str("")), "params", hexa_str("")), "body", hexa_str("")), "args", hexa_str("")), "fields", hexa_str("")), "items", hexa_str("")), "variants", hexa_str("")), "arms", hexa_str("")), "iter_expr", hexa_str("")), "ret_type", hexa_str("")), "target", hexa_str("")), "trait_name", hexa_str("")), "methods", hexa_str(""));
    return hexa_void();
}


HexaVal gen2_indent(HexaVal n) {
    HexaVal parts = hexa_array_new();
    HexaVal i = hexa_int(0);
    while (hexa_truthy(hexa_bool((i).i < (n).i))) {
        parts = hexa_array_push(parts, hexa_str("    "));
        i = hexa_add(i, hexa_int(1));
    }
    return hexa_str_join(parts, hexa_str(""));
    return hexa_void();
}


HexaVal gen2_stmt(HexaVal node, HexaVal depth) {
    HexaVal pad = gen2_indent(depth);
    HexaVal k = hexa_map_get(node, "kind");
    if (hexa_truthy(hexa_bool(hexa_truthy(hexa_eq(k, hexa_str("LetStmt"))) || hexa_truthy(hexa_eq(k, hexa_str("LetMutStmt")))))) {
        HexaVal init = hexa_str("hexa_void()");
        if (hexa_truthy(hexa_bool(!hexa_truthy(hexa_eq(hexa_type_of(hexa_map_get(node, "left")), hexa_str("string")))))) {
            init = gen2_expr(hexa_map_get(node, "left"));
        }
        return hexa_add(hexa_add(hexa_add(hexa_add(hexa_add(pad, hexa_str("HexaVal ")), hexa_map_get(node, "name")), hexa_str(" = ")), init), hexa_str(";\n"));
    }
    if (hexa_truthy(hexa_eq(k, hexa_str("ConstStmt")))) {
        return hexa_add(hexa_add(hexa_add(hexa_add(hexa_add(pad, hexa_str("HexaVal ")), hexa_map_get(node, "name")), hexa_str(" = ")), gen2_expr(hexa_map_get(node, "left"))), hexa_str(";\n"));
    }
    if (hexa_truthy(hexa_eq(k, hexa_str("AssignStmt")))) {
        if (hexa_truthy(hexa_bool(hexa_truthy(hexa_bool(!hexa_truthy(hexa_eq(hexa_type_of(hexa_map_get(node, "left")), hexa_str("string"))))) && hexa_truthy(hexa_eq(hexa_map_get(hexa_map_get(node, "left"), "kind"), hexa_str("Index")))))) {
            HexaVal container = gen2_expr(hexa_map_get(hexa_map_get(node, "left"), "left"));
            HexaVal idx = gen2_expr(hexa_map_get(hexa_map_get(node, "left"), "right"));
            HexaVal val = gen2_expr(hexa_map_get(node, "right"));
            return hexa_add(hexa_add(hexa_add(hexa_add(hexa_add(hexa_add(hexa_add(hexa_add(pad, container), hexa_str(" = hexa_index_set(")), container), hexa_str(", ")), idx), hexa_str(", ")), val), hexa_str(");\n"));
        }
        if (hexa_truthy(hexa_bool(hexa_truthy(hexa_bool(!hexa_truthy(hexa_eq(hexa_type_of(hexa_map_get(node, "left")), hexa_str("string"))))) && hexa_truthy(hexa_eq(hexa_map_get(hexa_map_get(node, "left"), "kind"), hexa_str("Field")))))) {
            HexaVal obj = gen2_expr(hexa_map_get(hexa_map_get(node, "left"), "left"));
            HexaVal field = hexa_map_get(hexa_map_get(node, "left"), "name");
            HexaVal val = gen2_expr(hexa_map_get(node, "right"));
            return hexa_add(hexa_add(hexa_add(hexa_add(hexa_add(hexa_add(hexa_add(hexa_add(pad, obj), hexa_str(" = hexa_map_set(")), obj), hexa_str(", \"")), field), hexa_str("\", ")), val), hexa_str(");\n"));
        }
        return hexa_add(hexa_add(hexa_add(hexa_add(pad, gen2_expr(hexa_map_get(node, "left"))), hexa_str(" = ")), gen2_expr(hexa_map_get(node, "right"))), hexa_str(";\n"));
    }
    if (hexa_truthy(hexa_eq(k, hexa_str("CompoundAssign")))) {
        HexaVal lhs = gen2_expr(hexa_map_get(node, "left"));
        HexaVal rhs = gen2_expr(hexa_map_get(node, "right"));
        HexaVal op = hexa_map_get(node, "op");
        if (hexa_truthy(hexa_eq(op, hexa_str("+=")))) {
            return hexa_add(hexa_add(hexa_add(hexa_add(hexa_add(hexa_add(pad, lhs), hexa_str(" = hexa_add(")), lhs), hexa_str(", ")), rhs), hexa_str(");\n"));
        }
        if (hexa_truthy(hexa_eq(op, hexa_str("-=")))) {
            return hexa_add(hexa_add(hexa_add(hexa_add(hexa_add(hexa_add(pad, lhs), hexa_str(" = hexa_int((")), lhs), hexa_str(").i - (")), rhs), hexa_str(").i);\n"));
        }
        if (hexa_truthy(hexa_eq(op, hexa_str("*=")))) {
            return hexa_add(hexa_add(hexa_add(hexa_add(hexa_add(hexa_add(pad, lhs), hexa_str(" = hexa_int((")), lhs), hexa_str(").i * (")), rhs), hexa_str(").i);\n"));
        }
        if (hexa_truthy(hexa_eq(op, hexa_str("/=")))) {
            return hexa_add(hexa_add(hexa_add(hexa_add(hexa_add(hexa_add(pad, lhs), hexa_str(" = hexa_int((")), lhs), hexa_str(").i / (")), rhs), hexa_str(").i);\n"));
        }
        if (hexa_truthy(hexa_eq(op, hexa_str("%=")))) {
            return hexa_add(hexa_add(hexa_add(hexa_add(hexa_add(hexa_add(pad, lhs), hexa_str(" = hexa_int((")), lhs), hexa_str(").i % (")), rhs), hexa_str(").i);\n"));
        }
        return hexa_add(hexa_add(hexa_add(pad, hexa_str("/* compound ")), op), hexa_str(" */\n"));
    }
    if (hexa_truthy(hexa_eq(k, hexa_str("ReturnStmt")))) {
        if (hexa_truthy(hexa_bool(!hexa_truthy(hexa_eq(hexa_type_of(hexa_map_get(node, "left")), hexa_str("string")))))) {
            return hexa_add(hexa_add(hexa_add(pad, hexa_str("return ")), gen2_expr(hexa_map_get(node, "left"))), hexa_str(";\n"));
        }
        return hexa_add(pad, hexa_str("return hexa_void();\n"));
    }
    if (hexa_truthy(hexa_eq(k, hexa_str("ExprStmt")))) {
        HexaVal expr = hexa_map_get(node, "left");
        if (hexa_truthy(hexa_eq(hexa_type_of(expr), hexa_str("string")))) {
            return hexa_str("");
        }
        if (hexa_truthy(hexa_eq(hexa_map_get(expr, "kind"), hexa_str("MatchExpr")))) {
            return gen2_match_stmt(expr, depth);
        }
        if (hexa_truthy(hexa_eq(hexa_map_get(expr, "kind"), hexa_str("IfExpr")))) {
            HexaVal chunks = hexa_array_new();
            chunks = hexa_array_push(chunks, hexa_add(hexa_add(hexa_add(pad, hexa_str("if (hexa_truthy(")), gen2_expr(hexa_map_get(expr, "cond"))), hexa_str(")) {\n")));
            HexaVal ti = hexa_int(0);
            while (hexa_truthy(hexa_bool((ti).i < (hexa_int(hexa_len(hexa_map_get(expr, "then_body")))).i))) {
                chunks = hexa_array_push(chunks, gen2_stmt(hexa_index_get(hexa_map_get(expr, "then_body"), ti), hexa_add(depth, hexa_int(1))));
                ti = hexa_add(ti, hexa_int(1));
            }
            chunks = hexa_array_push(chunks, hexa_add(pad, hexa_str("}")));
            if (hexa_truthy(hexa_bool(hexa_truthy(hexa_bool(!hexa_truthy(hexa_eq(hexa_type_of(hexa_map_get(expr, "else_body")), hexa_str("string"))))) && hexa_truthy(hexa_bool((hexa_int(hexa_len(hexa_map_get(expr, "else_body")))).i > (hexa_int(0)).i))))) {
                chunks = hexa_array_push(chunks, hexa_str(" else {\n"));
                HexaVal ei = hexa_int(0);
                while (hexa_truthy(hexa_bool((ei).i < (hexa_int(hexa_len(hexa_map_get(expr, "else_body")))).i))) {
                    chunks = hexa_array_push(chunks, gen2_stmt(hexa_index_get(hexa_map_get(expr, "else_body"), ei), hexa_add(depth, hexa_int(1))));
                    ei = hexa_add(ei, hexa_int(1));
                }
                chunks = hexa_array_push(chunks, hexa_add(pad, hexa_str("}")));
            }
            chunks = hexa_array_push(chunks, hexa_str("\n"));
            return hexa_str_join(chunks, hexa_str(""));
        }
        return hexa_add(hexa_add(pad, gen2_expr(expr)), hexa_str(";\n"));
    }
    if (hexa_truthy(hexa_eq(k, hexa_str("WhileStmt")))) {
        HexaVal chunks = hexa_array_new();
        chunks = hexa_array_push(chunks, hexa_add(hexa_add(hexa_add(pad, hexa_str("while (hexa_truthy(")), gen2_expr(hexa_map_get(node, "cond"))), hexa_str(")) {\n")));
        HexaVal wi = hexa_int(0);
        while (hexa_truthy(hexa_bool((wi).i < (hexa_int(hexa_len(hexa_map_get(node, "body")))).i))) {
            chunks = hexa_array_push(chunks, gen2_stmt(hexa_index_get(hexa_map_get(node, "body"), wi), hexa_add(depth, hexa_int(1))));
            wi = hexa_add(wi, hexa_int(1));
        }
        chunks = hexa_array_push(chunks, hexa_add(pad, hexa_str("}\n")));
        return hexa_str_join(chunks, hexa_str(""));
    }
    if (hexa_truthy(hexa_eq(k, hexa_str("ForStmt")))) {
        HexaVal iter = hexa_map_get(node, "iter_expr");
        if (hexa_truthy(hexa_bool(hexa_truthy(hexa_bool(!hexa_truthy(hexa_eq(hexa_type_of(iter), hexa_str("string"))))) && hexa_truthy(hexa_eq(hexa_map_get(iter, "kind"), hexa_str("Range")))))) {
            HexaVal s = gen2_expr(hexa_map_get(iter, "left"));
            HexaVal e = gen2_expr(hexa_map_get(iter, "right"));
            HexaVal chunks = hexa_array_new();
            chunks = hexa_array_push(chunks, hexa_add(hexa_add(hexa_add(hexa_add(hexa_add(hexa_add(hexa_add(hexa_add(hexa_add(hexa_add(hexa_add(pad, hexa_str("for (HexaVal ")), hexa_map_get(node, "name")), hexa_str(" = ")), s), hexa_str("; ")), hexa_map_get(node, "name")), hexa_str(".i < (")), e), hexa_str(").i; ")), hexa_map_get(node, "name")), hexa_str(".i++) {\n")));
            HexaVal fi = hexa_int(0);
            while (hexa_truthy(hexa_bool((fi).i < (hexa_int(hexa_len(hexa_map_get(node, "body")))).i))) {
                chunks = hexa_array_push(chunks, gen2_stmt(hexa_index_get(hexa_map_get(node, "body"), fi), hexa_add(depth, hexa_int(1))));
                fi = hexa_add(fi, hexa_int(1));
            }
            chunks = hexa_array_push(chunks, hexa_add(pad, hexa_str("}\n")));
            return hexa_str_join(chunks, hexa_str(""));
        }
        HexaVal iter_c = gen2_expr(iter);
        HexaVal chunks = hexa_array_new();
        chunks = hexa_array_push(chunks, hexa_add(pad, hexa_str("{\n")));
        HexaVal pad2 = gen2_indent(hexa_add(depth, hexa_int(1)));
        chunks = hexa_array_push(chunks, hexa_add(hexa_add(hexa_add(pad2, hexa_str("HexaVal __iter_arr = ")), iter_c), hexa_str(";\n")));
        chunks = hexa_array_push(chunks, hexa_add(pad2, hexa_str("for (int __fi = 0; __fi < hexa_len(__iter_arr); __fi++) {\n")));
        HexaVal pad3 = gen2_indent(hexa_add(depth, hexa_int(2)));
        chunks = hexa_array_push(chunks, hexa_add(hexa_add(hexa_add(pad3, hexa_str("HexaVal ")), hexa_map_get(node, "name")), hexa_str(" = hexa_array_get(__iter_arr, __fi);\n")));
        HexaVal fi = hexa_int(0);
        while (hexa_truthy(hexa_bool((fi).i < (hexa_int(hexa_len(hexa_map_get(node, "body")))).i))) {
            chunks = hexa_array_push(chunks, gen2_stmt(hexa_index_get(hexa_map_get(node, "body"), fi), hexa_add(depth, hexa_int(2))));
            fi = hexa_add(fi, hexa_int(1));
        }
        chunks = hexa_array_push(chunks, hexa_add(pad2, hexa_str("}\n")));
        chunks = hexa_array_push(chunks, hexa_add(pad, hexa_str("}\n")));
        return hexa_str_join(chunks, hexa_str(""));
    }
    if (hexa_truthy(hexa_eq(k, hexa_str("BreakStmt")))) {
        return hexa_add(pad, hexa_str("break;\n"));
    }
    if (hexa_truthy(hexa_eq(k, hexa_str("ContinueStmt")))) {
        return hexa_add(pad, hexa_str("continue;\n"));
    }
    if (hexa_truthy(hexa_eq(k, hexa_str("ThrowStmt")))) {
        if (hexa_truthy(hexa_bool(!hexa_truthy(hexa_eq(hexa_type_of(hexa_map_get(node, "left")), hexa_str("string")))))) {
            return hexa_add(hexa_add(hexa_add(pad, hexa_str("hexa_throw(")), gen2_expr(hexa_map_get(node, "left"))), hexa_str(");\n"));
        }
        return hexa_add(pad, hexa_str("hexa_throw(hexa_str(\"error\"));\n"));
    }
    if (hexa_truthy(hexa_bool(hexa_truthy(hexa_eq(k, hexa_str("TryCatchStmt"))) || hexa_truthy(hexa_eq(k, hexa_str("TryCatch")))))) {
        HexaVal try_body = hexa_map_get(node, "left");
        HexaVal catch_body = hexa_map_get(node, "right");
        HexaVal catch_var = hexa_map_get(node, "name");
        HexaVal chunks = hexa_array_new();
        chunks = hexa_array_push(chunks, hexa_add(pad, hexa_str("{\n")));
        HexaVal pad2 = gen2_indent(hexa_add(depth, hexa_int(1)));
        chunks = hexa_array_push(chunks, hexa_add(pad2, hexa_str("jmp_buf __jb; HexaVal __err = hexa_void();\n")));
        chunks = hexa_array_push(chunks, hexa_add(pad2, hexa_str("if (setjmp(__jb) == 0) {\n")));
        chunks = hexa_array_push(chunks, hexa_add(pad2, hexa_str("    __hexa_try_push(&__jb);\n")));
        if (hexa_truthy(hexa_bool(!hexa_truthy(hexa_eq(hexa_type_of(try_body), hexa_str("string")))))) {
            HexaVal ti = hexa_int(0);
            while (hexa_truthy(hexa_bool((ti).i < (hexa_int(hexa_len(try_body))).i))) {
                chunks = hexa_array_push(chunks, gen2_stmt(hexa_index_get(try_body, ti), hexa_add(depth, hexa_int(2))));
                ti = hexa_add(ti, hexa_int(1));
            }
        }
        chunks = hexa_array_push(chunks, hexa_add(pad2, hexa_str("    __hexa_try_pop();\n")));
        chunks = hexa_array_push(chunks, hexa_add(pad2, hexa_str("} else {\n")));
        chunks = hexa_array_push(chunks, hexa_add(pad2, hexa_str("    __err = __hexa_last_error();\n")));
        if (hexa_truthy(hexa_bool(hexa_truthy(hexa_bool(!hexa_truthy(hexa_eq(catch_var, hexa_str(""))))) && hexa_truthy(hexa_bool(!hexa_truthy(hexa_eq(catch_var, hexa_str("_")))))))) {
            chunks = hexa_array_push(chunks, hexa_add(hexa_add(hexa_add(pad2, hexa_str("    HexaVal ")), catch_var), hexa_str(" = __err;\n")));
        }
        if (hexa_truthy(hexa_bool(!hexa_truthy(hexa_eq(hexa_type_of(catch_body), hexa_str("string")))))) {
            HexaVal ci = hexa_int(0);
            while (hexa_truthy(hexa_bool((ci).i < (hexa_int(hexa_len(catch_body))).i))) {
                chunks = hexa_array_push(chunks, gen2_stmt(hexa_index_get(catch_body, ci), hexa_add(depth, hexa_int(2))));
                ci = hexa_add(ci, hexa_int(1));
            }
        }
        chunks = hexa_array_push(chunks, hexa_add(pad2, hexa_str("}\n")));
        chunks = hexa_array_push(chunks, hexa_add(pad, hexa_str("}\n")));
        return hexa_str_join(chunks, hexa_str(""));
    }
    if (hexa_truthy(hexa_eq(k, hexa_str("MatchExpr")))) {
        return gen2_match_stmt(node, depth);
    }
    return hexa_add(hexa_add(hexa_add(pad, hexa_str("/* ")), k), hexa_str(" */\n"));
    return hexa_void();
}


HexaVal c_escape(HexaVal s) {
    HexaVal out = hexa_str_replace(hexa_to_string(s), hexa_str("\\"), hexa_str("\\\\"));
    out = hexa_str_replace(out, hexa_str("\""), hexa_str("\\\""));
    out = hexa_str_replace(out, hexa_str("\n"), hexa_str("\\n"));
    out = hexa_str_replace(out, hexa_str("\r"), hexa_str("\\r"));
    out = hexa_str_replace(out, hexa_str("\t"), hexa_str("\\t"));
    return out;
    return hexa_void();
}


HexaVal gen2_method_builtin(HexaVal obj_expr, HexaVal method, HexaVal args) {
    if (hexa_truthy(hexa_eq(method, hexa_str("push")))) {
        return hexa_add(hexa_add(hexa_add(hexa_add(hexa_str("hexa_array_push("), obj_expr), hexa_str(", ")), gen2_expr(hexa_index_get(args, hexa_int(0)))), hexa_str(")"));
    }
    if (hexa_truthy(hexa_eq(method, hexa_str("len")))) {
        return hexa_add(hexa_add(hexa_str("hexa_int(hexa_len("), obj_expr), hexa_str("))"));
    }
    if (hexa_truthy(hexa_eq(method, hexa_str("chars")))) {
        return hexa_add(hexa_add(hexa_str("hexa_str_chars("), obj_expr), hexa_str(")"));
    }
    if (hexa_truthy(hexa_eq(method, hexa_str("contains")))) {
        return hexa_add(hexa_add(hexa_add(hexa_add(hexa_str("hexa_bool(hexa_str_contains("), obj_expr), hexa_str(", ")), gen2_expr(hexa_index_get(args, hexa_int(0)))), hexa_str("))"));
    }
    if (hexa_truthy(hexa_eq(method, hexa_str("join")))) {
        return hexa_add(hexa_add(hexa_add(hexa_add(hexa_str("hexa_str_join("), obj_expr), hexa_str(", ")), gen2_expr(hexa_index_get(args, hexa_int(0)))), hexa_str(")"));
    }
    if (hexa_truthy(hexa_eq(method, hexa_str("to_upper")))) {
        return hexa_add(hexa_add(hexa_str("hexa_str_to_upper("), obj_expr), hexa_str(")"));
    }
    if (hexa_truthy(hexa_eq(method, hexa_str("to_lower")))) {
        return hexa_add(hexa_add(hexa_str("hexa_str_to_lower("), obj_expr), hexa_str(")"));
    }
    if (hexa_truthy(hexa_eq(method, hexa_str("split")))) {
        return hexa_add(hexa_add(hexa_add(hexa_add(hexa_str("hexa_str_split("), obj_expr), hexa_str(", ")), gen2_expr(hexa_index_get(args, hexa_int(0)))), hexa_str(")"));
    }
    if (hexa_truthy(hexa_eq(method, hexa_str("trim")))) {
        return hexa_add(hexa_add(hexa_str("hexa_str_trim("), obj_expr), hexa_str(")"));
    }
    if (hexa_truthy(hexa_eq(method, hexa_str("replace")))) {
        return hexa_add(hexa_add(hexa_add(hexa_add(hexa_add(hexa_add(hexa_str("hexa_str_replace("), obj_expr), hexa_str(", ")), gen2_expr(hexa_index_get(args, hexa_int(0)))), hexa_str(", ")), gen2_expr(hexa_index_get(args, hexa_int(1)))), hexa_str(")"));
    }
    if (hexa_truthy(hexa_eq(method, hexa_str("repeat")))) {
        return hexa_add(hexa_add(hexa_add(hexa_add(hexa_str("hexa_str_repeat("), obj_expr), hexa_str(", ")), gen2_expr(hexa_index_get(args, hexa_int(0)))), hexa_str(")"));
    }
    if (hexa_truthy(hexa_eq(method, hexa_str("starts_with")))) {
        return hexa_add(hexa_add(hexa_add(hexa_add(hexa_str("hexa_bool(hexa_str_starts_with("), obj_expr), hexa_str(", ")), gen2_expr(hexa_index_get(args, hexa_int(0)))), hexa_str("))"));
    }
    if (hexa_truthy(hexa_eq(method, hexa_str("ends_with")))) {
        return hexa_add(hexa_add(hexa_add(hexa_add(hexa_str("hexa_bool(hexa_str_ends_with("), obj_expr), hexa_str(", ")), gen2_expr(hexa_index_get(args, hexa_int(0)))), hexa_str("))"));
    }
    if (hexa_truthy(hexa_eq(method, hexa_str("substring")))) {
        return hexa_add(hexa_add(hexa_add(hexa_add(hexa_add(hexa_add(hexa_str("hexa_str_substring("), obj_expr), hexa_str(", ")), gen2_expr(hexa_index_get(args, hexa_int(0)))), hexa_str(", ")), gen2_expr(hexa_index_get(args, hexa_int(1)))), hexa_str(")"));
    }
    if (hexa_truthy(hexa_eq(method, hexa_str("index_of")))) {
        return hexa_add(hexa_add(hexa_add(hexa_add(hexa_str("hexa_int(hexa_str_index_of("), obj_expr), hexa_str(", ")), gen2_expr(hexa_index_get(args, hexa_int(0)))), hexa_str("))"));
    }
    if (hexa_truthy(hexa_eq(method, hexa_str("keys")))) {
        return hexa_add(hexa_add(hexa_str("hexa_map_keys("), obj_expr), hexa_str(")"));
    }
    if (hexa_truthy(hexa_eq(method, hexa_str("values")))) {
        return hexa_add(hexa_add(hexa_str("hexa_map_values("), obj_expr), hexa_str(")"));
    }
    if (hexa_truthy(hexa_eq(method, hexa_str("contains_key")))) {
        return hexa_add(hexa_add(hexa_add(hexa_add(hexa_str("hexa_bool(hexa_map_contains_key("), obj_expr), hexa_str(", ")), gen2_expr(hexa_index_get(args, hexa_int(0)))), hexa_str(".s))"));
    }
    if (hexa_truthy(hexa_eq(method, hexa_str("remove")))) {
        return hexa_add(hexa_add(hexa_add(hexa_add(hexa_str("hexa_map_remove("), obj_expr), hexa_str(", ")), gen2_expr(hexa_index_get(args, hexa_int(0)))), hexa_str(".s)"));
    }
    if (hexa_truthy(hexa_eq(method, hexa_str("pop")))) {
        return hexa_add(hexa_add(hexa_str("hexa_array_pop("), obj_expr), hexa_str(")"));
    }
    if (hexa_truthy(hexa_eq(method, hexa_str("reverse")))) {
        return hexa_add(hexa_add(hexa_str("hexa_array_reverse("), obj_expr), hexa_str(")"));
    }
    if (hexa_truthy(hexa_eq(method, hexa_str("sort")))) {
        return hexa_add(hexa_add(hexa_str("hexa_array_sort("), obj_expr), hexa_str(")"));
    }
    // bt 55 — in-place array length shrink; caller must reassign.
    if (hexa_truthy(hexa_eq(method, hexa_str("truncate")))) {
        return hexa_add(hexa_add(hexa_add(hexa_add(hexa_str("hexa_array_truncate("), obj_expr), hexa_str(", ")), gen2_expr(hexa_index_get(args, hexa_int(0)))), hexa_str(")"));
    }
    // rt 32-B — scratch push (no stats) + bulk slice for reusable call_arg_buf.
    if (hexa_truthy(hexa_eq(method, hexa_str("push_nostat")))) {
        return hexa_add(hexa_add(hexa_add(hexa_add(hexa_str("hexa_array_push_nostat("), obj_expr), hexa_str(", ")), gen2_expr(hexa_index_get(args, hexa_int(0)))), hexa_str(")"));
    }
    if (hexa_truthy(hexa_eq(method, hexa_str("slice_fast")))) {
        return hexa_add(hexa_add(hexa_add(hexa_add(hexa_add(hexa_add(hexa_str("hexa_array_slice_fast("), obj_expr), hexa_str(", ")), gen2_expr(hexa_index_get(args, hexa_int(0)))), hexa_str(", ")), gen2_expr(hexa_index_get(args, hexa_int(1)))), hexa_str(")"));
    }
    return hexa_add(hexa_add(hexa_str("hexa_void() /* unknown method."), method), hexa_str(" */"));
    return hexa_void();
}


HexaVal gen2_expr(HexaVal node) {
    HexaVal k = hexa_map_get(node, "kind");
    if (hexa_truthy(hexa_eq(k, hexa_str("IntLit")))) {
        return hexa_add(hexa_add(hexa_str("hexa_int("), hexa_map_get(node, "value")), hexa_str(")"));
    }
    if (hexa_truthy(hexa_eq(k, hexa_str("FloatLit")))) {
        return hexa_add(hexa_add(hexa_str("hexa_float("), hexa_map_get(node, "value")), hexa_str(")"));
    }
    if (hexa_truthy(hexa_eq(k, hexa_str("BoolLit")))) {
        if (hexa_truthy(hexa_eq(hexa_map_get(node, "value"), hexa_str("true")))) {
            return hexa_str("hexa_bool(1)");
        }
        return hexa_str("hexa_bool(0)");
    }
    if (hexa_truthy(hexa_eq(k, hexa_str("StringLit")))) {
        return hexa_add(hexa_add(hexa_str("hexa_str(\""), c_escape(hexa_map_get(node, "value"))), hexa_str("\")"));
    }
    if (hexa_truthy(hexa_eq(k, hexa_str("CharLit")))) {
        return hexa_add(hexa_add(hexa_str("hexa_str(\""), c_escape(hexa_map_get(node, "value"))), hexa_str("\")"));
    }
    if (hexa_truthy(hexa_eq(k, hexa_str("Ident")))) {
        return hexa_map_get(node, "name");
    }
    if (hexa_truthy(hexa_eq(k, hexa_str("BinOp")))) {
        HexaVal l = gen2_expr(hexa_map_get(node, "left"));
        HexaVal r = gen2_expr(hexa_map_get(node, "right"));
        HexaVal op = hexa_map_get(node, "op");
        if (hexa_truthy(hexa_eq(op, hexa_str("+")))) {
            return hexa_add(hexa_add(hexa_add(hexa_add(hexa_str("hexa_add("), l), hexa_str(", ")), r), hexa_str(")"));
        }
        if (hexa_truthy(hexa_eq(op, hexa_str("-")))) {
            return hexa_add(hexa_add(hexa_add(hexa_add(hexa_str("hexa_int(("), l), hexa_str(").i - (")), r), hexa_str(").i)"));
        }
        if (hexa_truthy(hexa_eq(op, hexa_str("*")))) {
            return hexa_add(hexa_add(hexa_add(hexa_add(hexa_str("hexa_int(("), l), hexa_str(").i * (")), r), hexa_str(").i)"));
        }
        if (hexa_truthy(hexa_eq(op, hexa_str("/")))) {
            return hexa_add(hexa_add(hexa_add(hexa_add(hexa_str("hexa_int(("), l), hexa_str(").i / (")), r), hexa_str(").i)"));
        }
        if (hexa_truthy(hexa_eq(op, hexa_str("%")))) {
            return hexa_add(hexa_add(hexa_add(hexa_add(hexa_str("hexa_int(("), l), hexa_str(").i % (")), r), hexa_str(").i)"));
        }
        if (hexa_truthy(hexa_eq(op, hexa_str("==")))) {
            return hexa_add(hexa_add(hexa_add(hexa_add(hexa_str("hexa_eq("), l), hexa_str(", ")), r), hexa_str(")"));
        }
        if (hexa_truthy(hexa_eq(op, hexa_str("!=")))) {
            return hexa_add(hexa_add(hexa_add(hexa_add(hexa_str("hexa_bool(!hexa_truthy(hexa_eq("), l), hexa_str(", ")), r), hexa_str(")))"));
        }
        if (hexa_truthy(hexa_eq(op, hexa_str("<")))) {
            return hexa_add(hexa_add(hexa_add(hexa_add(hexa_str("hexa_bool(("), l), hexa_str(").i < (")), r), hexa_str(").i)"));
        }
        if (hexa_truthy(hexa_eq(op, hexa_str(">")))) {
            return hexa_add(hexa_add(hexa_add(hexa_add(hexa_str("hexa_bool(("), l), hexa_str(").i > (")), r), hexa_str(").i)"));
        }
        if (hexa_truthy(hexa_eq(op, hexa_str("<=")))) {
            return hexa_add(hexa_add(hexa_add(hexa_add(hexa_str("hexa_bool(("), l), hexa_str(").i <= (")), r), hexa_str(").i)"));
        }
        if (hexa_truthy(hexa_eq(op, hexa_str(">=")))) {
            return hexa_add(hexa_add(hexa_add(hexa_add(hexa_str("hexa_bool(("), l), hexa_str(").i >= (")), r), hexa_str(").i)"));
        }
        if (hexa_truthy(hexa_eq(op, hexa_str("&&")))) {
            return hexa_add(hexa_add(hexa_add(hexa_add(hexa_str("hexa_bool(hexa_truthy("), l), hexa_str(") && hexa_truthy(")), r), hexa_str("))"));
        }
        if (hexa_truthy(hexa_eq(op, hexa_str("||")))) {
            return hexa_add(hexa_add(hexa_add(hexa_add(hexa_str("hexa_bool(hexa_truthy("), l), hexa_str(") || hexa_truthy(")), r), hexa_str("))"));
        }
        if (hexa_truthy(hexa_eq(op, hexa_str("??")))) {
            return hexa_add(hexa_add(hexa_add(hexa_add(hexa_str("hexa_null_coal("), l), hexa_str(", ")), r), hexa_str(")"));
        }
        return hexa_add(hexa_add(hexa_str("/* binop "), op), hexa_str(" */"));
    }
    if (hexa_truthy(hexa_eq(k, hexa_str("UnaryOp")))) {
        if (hexa_truthy(hexa_eq(hexa_map_get(node, "op"), hexa_str("-")))) {
            return hexa_add(hexa_add(hexa_str("hexa_int(-("), gen2_expr(hexa_map_get(node, "left"))), hexa_str(").i)"));
        }
        if (hexa_truthy(hexa_eq(hexa_map_get(node, "op"), hexa_str("!")))) {
            return hexa_add(hexa_add(hexa_str("hexa_bool(!hexa_truthy("), gen2_expr(hexa_map_get(node, "left"))), hexa_str("))"));
        }
        return hexa_str("/* unary */");
    }
    if (hexa_truthy(hexa_eq(k, hexa_str("Field")))) {
        HexaVal obj = gen2_expr(hexa_map_get(node, "left"));
        HexaVal field = hexa_map_get(node, "name");
        /* rt#37: emit hexa_map_get_ic(obj, "field", &__hexa_ic_N) per call site.
         * Each call site gets a unique file-scope static HexaIC slot; the first
         * call caches (keys_ptr, len, idx), subsequent monomorphic hits skip
         * the strcmp-chain. HEXA_IC_DISABLE=1 at codegen falls back to
         * hexa_map_get for A/B. */
        const char* ic_disable = getenv("HEXA_IC_DISABLE");
        if (ic_disable && ic_disable[0] == '1') {
            return hexa_add(hexa_add(hexa_add(hexa_add(hexa_str("hexa_map_get("), obj), hexa_str(", \"")), field), hexa_str("\")"));
        }
        /* Stable counter in a function-scope static int; codegen runs once per
         * transpile invocation so across runs the numbering resets naturally. */
        static int _hexa_ic_counter = 0;
        int id = _hexa_ic_counter++;
        char slot_buf[48];
        snprintf(slot_buf, sizeof(slot_buf), "__hexa_ic_%d", id);
        HexaVal slot = hexa_str(slot_buf);
        /* Append "static HexaIC __hexa_ic_N = {0};\n" to a file-scope
         * accumulator so the final program emits all slot defs up-front. */
        if (!_ic_def_parts_init) { _ic_def_parts = hexa_array_new(); _ic_def_parts_init = 1; }
        HexaVal def_line = hexa_add(hexa_add(hexa_str("static HexaIC "), slot), hexa_str(" = {0};\n"));
        _ic_def_parts = hexa_array_push(_ic_def_parts, def_line);
        /* Emit: hexa_map_get_ic(obj, "field", &__hexa_ic_N) */
        return hexa_add(hexa_add(hexa_add(hexa_add(hexa_add(hexa_add(hexa_str("hexa_map_get_ic("), obj), hexa_str(", \"")), field), hexa_str("\", &")), slot), hexa_str(")"));
    }
    if (hexa_truthy(hexa_eq(k, hexa_str("StructInit")))) {
        HexaVal name = hexa_map_get(node, "name");
        HexaVal arg_strs = hexa_array_new();
        HexaVal si = hexa_int(0);
        while (hexa_truthy(hexa_bool((si).i < (hexa_int(hexa_len(hexa_map_get(node, "fields")))).i))) {
            arg_strs = hexa_array_push(arg_strs, gen2_expr(hexa_map_get(hexa_index_get(hexa_map_get(node, "fields"), si), "left")));
            si = hexa_add(si, hexa_int(1));
        }
        return hexa_add(hexa_add(hexa_add(name, hexa_str("(")), hexa_str_join(arg_strs, hexa_str(", "))), hexa_str(")"));
    }
    if (hexa_truthy(hexa_eq(k, hexa_str("Call")))) {
        HexaVal callee = hexa_map_get(node, "left");
        if (hexa_truthy(hexa_bool(hexa_truthy(hexa_bool(!hexa_truthy(hexa_eq(hexa_type_of(callee), hexa_str("string"))))) && hexa_truthy(hexa_eq(hexa_map_get(callee, "kind"), hexa_str("Ident")))))) {
            HexaVal name = hexa_map_get(callee, "name");
            if (hexa_truthy(hexa_eq(name, hexa_str("println")))) {
                if (hexa_truthy(hexa_bool((hexa_int(hexa_len(hexa_map_get(node, "args")))).i > (hexa_int(0)).i))) {
                    return hexa_add(hexa_add(hexa_str("hexa_println("), gen2_expr(hexa_index_get(hexa_map_get(node, "args"), hexa_int(0)))), hexa_str(")"));
                }
                return hexa_str("(printf(\"\\n\"), hexa_void())");
            }
            if (hexa_truthy(hexa_eq(name, hexa_str("print")))) {
                if (hexa_truthy(hexa_bool((hexa_int(hexa_len(hexa_map_get(node, "args")))).i > (hexa_int(0)).i))) {
                    return hexa_add(hexa_add(hexa_str("(hexa_print_val("), gen2_expr(hexa_index_get(hexa_map_get(node, "args"), hexa_int(0)))), hexa_str("), hexa_void())"));
                }
                return hexa_str("hexa_void()");
            }
            if (hexa_truthy(hexa_eq(name, hexa_str("len")))) {
                return hexa_add(hexa_add(hexa_str("hexa_int(hexa_len("), gen2_expr(hexa_index_get(hexa_map_get(node, "args"), hexa_int(0)))), hexa_str("))"));
            }
            if (hexa_truthy(hexa_eq(name, hexa_str("to_string")))) {
                return hexa_add(hexa_add(hexa_str("hexa_to_string("), gen2_expr(hexa_index_get(hexa_map_get(node, "args"), hexa_int(0)))), hexa_str(")"));
            }
            if (hexa_truthy(hexa_eq(name, hexa_str("type_of")))) {
                return hexa_add(hexa_add(hexa_str("hexa_type_of("), gen2_expr(hexa_index_get(hexa_map_get(node, "args"), hexa_int(0)))), hexa_str(")"));
            }
            if (hexa_truthy(hexa_eq(name, hexa_str("sqrt")))) {
                return hexa_add(hexa_add(hexa_str("hexa_sqrt("), gen2_expr(hexa_index_get(hexa_map_get(node, "args"), hexa_int(0)))), hexa_str(")"));
            }
            if (hexa_truthy(hexa_eq(name, hexa_str("floor")))) {
                return hexa_add(hexa_add(hexa_str("hexa_floor("), gen2_expr(hexa_index_get(hexa_map_get(node, "args"), hexa_int(0)))), hexa_str(")"));
            }
            if (hexa_truthy(hexa_eq(name, hexa_str("ceil")))) {
                return hexa_add(hexa_add(hexa_str("hexa_ceil("), gen2_expr(hexa_index_get(hexa_map_get(node, "args"), hexa_int(0)))), hexa_str(")"));
            }
            if (hexa_truthy(hexa_eq(name, hexa_str("abs")))) {
                return hexa_add(hexa_add(hexa_str("hexa_abs("), gen2_expr(hexa_index_get(hexa_map_get(node, "args"), hexa_int(0)))), hexa_str(")"));
            }
            if (hexa_truthy(hexa_eq(name, hexa_str("round")))) {
                HexaVal a = gen2_expr(hexa_index_get(hexa_map_get(node, "args"), hexa_int(0)));
                return hexa_add(hexa_add(hexa_add(hexa_add(hexa_add(hexa_add(hexa_str("hexa_int((int64_t)round("), a), hexa_str(".tag==TAG_FLOAT?")), a), hexa_str(".f:(double)")), a), hexa_str(".i))"));
            }
            if (hexa_truthy(hexa_bool(hexa_truthy(hexa_eq(name, hexa_str("ln"))) || hexa_truthy(hexa_eq(name, hexa_str("log")))))) {
                HexaVal a = gen2_expr(hexa_index_get(hexa_map_get(node, "args"), hexa_int(0)));
                return hexa_add(hexa_add(hexa_add(hexa_add(hexa_add(hexa_add(hexa_str("hexa_float(log("), a), hexa_str(".tag==TAG_FLOAT?")), a), hexa_str(".f:(double)")), a), hexa_str(".i))"));
            }
            if (hexa_truthy(hexa_eq(name, hexa_str("log10")))) {
                HexaVal a = gen2_expr(hexa_index_get(hexa_map_get(node, "args"), hexa_int(0)));
                return hexa_add(hexa_add(hexa_add(hexa_add(hexa_add(hexa_add(hexa_str("hexa_float(log10("), a), hexa_str(".tag==TAG_FLOAT?")), a), hexa_str(".f:(double)")), a), hexa_str(".i))"));
            }
            if (hexa_truthy(hexa_eq(name, hexa_str("exp")))) {
                HexaVal a = gen2_expr(hexa_index_get(hexa_map_get(node, "args"), hexa_int(0)));
                return hexa_add(hexa_add(hexa_add(hexa_add(hexa_add(hexa_add(hexa_str("hexa_float(exp("), a), hexa_str(".tag==TAG_FLOAT?")), a), hexa_str(".f:(double)")), a), hexa_str(".i))"));
            }
            if (hexa_truthy(hexa_eq(name, hexa_str("sin")))) {
                HexaVal a = gen2_expr(hexa_index_get(hexa_map_get(node, "args"), hexa_int(0)));
                return hexa_add(hexa_add(hexa_add(hexa_add(hexa_add(hexa_add(hexa_str("hexa_float(sin("), a), hexa_str(".tag==TAG_FLOAT?")), a), hexa_str(".f:(double)")), a), hexa_str(".i))"));
            }
            if (hexa_truthy(hexa_eq(name, hexa_str("cos")))) {
                HexaVal a = gen2_expr(hexa_index_get(hexa_map_get(node, "args"), hexa_int(0)));
                return hexa_add(hexa_add(hexa_add(hexa_add(hexa_add(hexa_add(hexa_str("hexa_float(cos("), a), hexa_str(".tag==TAG_FLOAT?")), a), hexa_str(".f:(double)")), a), hexa_str(".i))"));
            }
            if (hexa_truthy(hexa_eq(name, hexa_str("pow")))) {
                return hexa_add(hexa_add(hexa_add(hexa_add(hexa_str("hexa_pow("), gen2_expr(hexa_index_get(hexa_map_get(node, "args"), hexa_int(0)))), hexa_str(", ")), gen2_expr(hexa_index_get(hexa_map_get(node, "args"), hexa_int(1)))), hexa_str(")"));
            }
            if (hexa_truthy(hexa_eq(name, hexa_str("to_float")))) {
                HexaVal a = gen2_expr(hexa_index_get(hexa_map_get(node, "args"), hexa_int(0)));
                return hexa_add(hexa_add(hexa_add(hexa_add(hexa_add(hexa_add(hexa_str("hexa_float("), a), hexa_str(".tag==TAG_FLOAT?")), a), hexa_str(".f:(double)")), a), hexa_str(".i)"));
            }
            if (hexa_truthy(hexa_eq(name, hexa_str("is_alpha")))) {
                HexaVal a = gen2_expr(hexa_index_get(hexa_map_get(node, "args"), hexa_int(0)));
                return hexa_add(hexa_add(hexa_add(hexa_add(hexa_add(hexa_add(hexa_add(hexa_add(hexa_add(hexa_add(hexa_str("hexa_bool(("), a), hexa_str(".tag==TAG_STR && ")), a), hexa_str(".s && isalpha((unsigned char)")), a), hexa_str(".s[0])) || (")), a), hexa_str(".tag==TAG_CHAR && isalpha((unsigned char)")), a), hexa_str(".i)))"));
            }
            if (hexa_truthy(hexa_eq(name, hexa_str("is_digit")))) {
                HexaVal a = gen2_expr(hexa_index_get(hexa_map_get(node, "args"), hexa_int(0)));
                return hexa_add(hexa_add(hexa_add(hexa_add(hexa_add(hexa_add(hexa_add(hexa_add(hexa_add(hexa_add(hexa_str("hexa_bool(("), a), hexa_str(".tag==TAG_STR && ")), a), hexa_str(".s && isdigit((unsigned char)")), a), hexa_str(".s[0])) || (")), a), hexa_str(".tag==TAG_CHAR && isdigit((unsigned char)")), a), hexa_str(".i)))"));
            }
            if (hexa_truthy(hexa_eq(name, hexa_str("is_alphanumeric")))) {
                HexaVal a = gen2_expr(hexa_index_get(hexa_map_get(node, "args"), hexa_int(0)));
                return hexa_add(hexa_add(hexa_add(hexa_add(hexa_add(hexa_add(hexa_add(hexa_add(hexa_add(hexa_add(hexa_str("hexa_bool(("), a), hexa_str(".tag==TAG_STR && ")), a), hexa_str(".s && isalnum((unsigned char)")), a), hexa_str(".s[0])) || (")), a), hexa_str(".tag==TAG_CHAR && isalnum((unsigned char)")), a), hexa_str(".i)))"));
            }
            if (hexa_truthy(hexa_eq(name, hexa_str("file_exists")))) {
                HexaVal a = gen2_expr(hexa_index_get(hexa_map_get(node, "args"), hexa_int(0)));
                return hexa_add(hexa_add(hexa_str("hexa_bool(access("), a), hexa_str(".s, F_OK) == 0)"));
            }
            if (hexa_truthy(hexa_bool(hexa_truthy(hexa_eq(name, hexa_str("env"))) || hexa_truthy(hexa_eq(name, hexa_str("env_var")))))) {
                return hexa_add(hexa_add(hexa_str("hexa_env_var("), gen2_expr(hexa_index_get(hexa_map_get(node, "args"), hexa_int(0)))), hexa_str(")"));
            }
            if (hexa_truthy(hexa_eq(name, hexa_str("format")))) {
                HexaVal fmt_args = hexa_str("hexa_array_new()");
                HexaVal fi = hexa_int(1);
                while (hexa_truthy(hexa_bool((fi).i < (hexa_int(hexa_len(hexa_map_get(node, "args")))).i))) {
                    fmt_args = hexa_add(hexa_add(hexa_add(hexa_add(hexa_str("hexa_array_push("), fmt_args), hexa_str(", ")), gen2_expr(hexa_index_get(hexa_map_get(node, "args"), fi))), hexa_str(")"));
                    fi = hexa_add(fi, hexa_int(1));
                }
                return hexa_add(hexa_add(hexa_add(hexa_add(hexa_str("hexa_format_n("), gen2_expr(hexa_index_get(hexa_map_get(node, "args"), hexa_int(0)))), hexa_str(", ")), fmt_args), hexa_str(")"));
            }
            if (hexa_truthy(hexa_eq(name, hexa_str("eprintln")))) {
                if (hexa_truthy(hexa_bool((hexa_int(hexa_len(hexa_map_get(node, "args")))).i > (hexa_int(0)).i))) {
                    return hexa_add(hexa_add(hexa_str("(hexa_eprint_val("), gen2_expr(hexa_index_get(hexa_map_get(node, "args"), hexa_int(0)))), hexa_str("), fprintf(stderr, \"\\n\"), hexa_void())"));
                }
                return hexa_str("(fprintf(stderr, \"\\n\"), hexa_void())");
            }
            if (hexa_truthy(hexa_eq(name, hexa_str("args")))) {
                return hexa_str("hexa_args()");
            }
            if (hexa_truthy(hexa_eq(name, hexa_str("exec")))) {
                return hexa_add(hexa_add(hexa_str("hexa_exec("), gen2_expr(hexa_index_get(hexa_map_get(node, "args"), hexa_int(0)))), hexa_str(")"));
            }
            if (hexa_truthy(hexa_eq(name, hexa_str("to_int")))) {
                HexaVal a = gen2_expr(hexa_index_get(hexa_map_get(node, "args"), hexa_int(0)));
                return hexa_add(hexa_add(hexa_add(hexa_add(hexa_add(hexa_add(hexa_add(hexa_add(hexa_add(hexa_add(hexa_str("hexa_int(("), a), hexa_str(".tag==TAG_FLOAT?(int64_t)")), a), hexa_str(".f:")), a), hexa_str(".tag==TAG_STR?atoll(")), a), hexa_str(".s):")), a), hexa_str(".i))"));
            }
            if (hexa_truthy(hexa_eq(name, hexa_str("min")))) {
                HexaVal a = gen2_expr(hexa_index_get(hexa_map_get(node, "args"), hexa_int(0)));
                HexaVal b = gen2_expr(hexa_index_get(hexa_map_get(node, "args"), hexa_int(1)));
                return hexa_add(hexa_add(hexa_add(hexa_add(hexa_add(hexa_add(hexa_add(hexa_add(hexa_str("hexa_int(("), a), hexa_str(").i < (")), b), hexa_str(").i ? (")), a), hexa_str(").i : (")), b), hexa_str(").i)"));
            }
            if (hexa_truthy(hexa_eq(name, hexa_str("max")))) {
                HexaVal a = gen2_expr(hexa_index_get(hexa_map_get(node, "args"), hexa_int(0)));
                HexaVal b = gen2_expr(hexa_index_get(hexa_map_get(node, "args"), hexa_int(1)));
                return hexa_add(hexa_add(hexa_add(hexa_add(hexa_add(hexa_add(hexa_add(hexa_add(hexa_str("hexa_int(("), a), hexa_str(").i > (")), b), hexa_str(").i ? (")), a), hexa_str(").i : (")), b), hexa_str(").i)"));
            }
            if (hexa_truthy(hexa_eq(name, hexa_str("read_file")))) {
                return hexa_add(hexa_add(hexa_str("hexa_read_file("), gen2_expr(hexa_index_get(hexa_map_get(node, "args"), hexa_int(0)))), hexa_str(")"));
            }
            if (hexa_truthy(hexa_eq(name, hexa_str("write_file")))) {
                return hexa_add(hexa_add(hexa_add(hexa_add(hexa_str("hexa_write_file("), gen2_expr(hexa_index_get(hexa_map_get(node, "args"), hexa_int(0)))), hexa_str(", ")), gen2_expr(hexa_index_get(hexa_map_get(node, "args"), hexa_int(1)))), hexa_str(")"));
            }
            if (hexa_truthy(hexa_eq(name, hexa_str("cstring")))) {
                return hexa_add(hexa_add(hexa_str("hexa_cstring("), gen2_expr(hexa_index_get(hexa_map_get(node, "args"), hexa_int(0)))), hexa_str(")"));
            }
            if (hexa_truthy(hexa_eq(name, hexa_str("from_cstring")))) {
                return hexa_add(hexa_add(hexa_str("hexa_from_cstring("), gen2_expr(hexa_index_get(hexa_map_get(node, "args"), hexa_int(0)))), hexa_str(")"));
            }
            if (hexa_truthy(hexa_eq(name, hexa_str("ptr_null")))) {
                return hexa_str("hexa_ptr_null()");
            }
            if (hexa_truthy(hexa_eq(name, hexa_str("ptr_addr")))) {
                return hexa_add(hexa_add(hexa_str("hexa_ptr_addr("), gen2_expr(hexa_index_get(hexa_map_get(node, "args"), hexa_int(0)))), hexa_str(")"));
            }
            if (hexa_truthy(hexa_eq(name, hexa_str("callback_create")))) {
                HexaVal arg = hexa_index_get(hexa_map_get(node, "args"), hexa_int(0));
                if (hexa_truthy(hexa_bool(hexa_truthy(hexa_bool(!hexa_truthy(hexa_eq(hexa_type_of(arg), hexa_str("string"))))) && hexa_truthy(hexa_eq(hexa_map_get(arg, "kind"), hexa_str("Ident")))))) {
                    HexaVal fn_name = hexa_map_get(arg, "name");
                    return hexa_add(hexa_add(hexa_str("hexa_callback_create((HexaVal){.tag=TAG_FN, .fn={.fn_ptr=(void*)"), fn_name), hexa_str(", .arity=0}})"));
                }
                return hexa_add(hexa_add(hexa_str("hexa_callback_create("), gen2_expr(hexa_index_get(hexa_map_get(node, "args"), hexa_int(0)))), hexa_str(")"));
            }
            if (hexa_truthy(hexa_eq(name, hexa_str("callback_free")))) {
                return hexa_add(hexa_add(hexa_str("hexa_callback_free("), gen2_expr(hexa_index_get(hexa_map_get(node, "args"), hexa_int(0)))), hexa_str(")"));
            }
            if (hexa_truthy(hexa_eq(name, hexa_str("callback_slot_id")))) {
                return hexa_add(hexa_add(hexa_str("hexa_callback_slot_id("), gen2_expr(hexa_index_get(hexa_map_get(node, "args"), hexa_int(0)))), hexa_str(")"));
            }
            if (hexa_truthy(hexa_eq(name, hexa_str("ptr_alloc")))) {
                return hexa_add(hexa_add(hexa_str("hexa_ptr_alloc("), gen2_expr(hexa_index_get(hexa_map_get(node, "args"), hexa_int(0)))), hexa_str(")"));
            }
            if (hexa_truthy(hexa_eq(name, hexa_str("ptr_free")))) {
                return hexa_add(hexa_add(hexa_add(hexa_add(hexa_str("hexa_ptr_free("), gen2_expr(hexa_index_get(hexa_map_get(node, "args"), hexa_int(0)))), hexa_str(", ")), gen2_expr(hexa_index_get(hexa_map_get(node, "args"), hexa_int(1)))), hexa_str(")"));
            }
            if (hexa_truthy(hexa_eq(name, hexa_str("ptr_write")))) {
                return hexa_add(hexa_add(hexa_add(hexa_add(hexa_add(hexa_add(hexa_str("hexa_ptr_write("), gen2_expr(hexa_index_get(hexa_map_get(node, "args"), hexa_int(0)))), hexa_str(", ")), gen2_expr(hexa_index_get(hexa_map_get(node, "args"), hexa_int(1)))), hexa_str(", ")), gen2_expr(hexa_index_get(hexa_map_get(node, "args"), hexa_int(2)))), hexa_str(")"));
            }
            if (hexa_truthy(hexa_eq(name, hexa_str("ptr_write_f32")))) {
                return hexa_add(hexa_add(hexa_add(hexa_add(hexa_add(hexa_add(hexa_str("hexa_ptr_write_f32("), gen2_expr(hexa_index_get(hexa_map_get(node, "args"), hexa_int(0)))), hexa_str(", ")), gen2_expr(hexa_index_get(hexa_map_get(node, "args"), hexa_int(1)))), hexa_str(", ")), gen2_expr(hexa_index_get(hexa_map_get(node, "args"), hexa_int(2)))), hexa_str(")"));
            }
            if (hexa_truthy(hexa_eq(name, hexa_str("ptr_write_i32")))) {
                return hexa_add(hexa_add(hexa_add(hexa_add(hexa_add(hexa_add(hexa_str("hexa_ptr_write_i32("), gen2_expr(hexa_index_get(hexa_map_get(node, "args"), hexa_int(0)))), hexa_str(", ")), gen2_expr(hexa_index_get(hexa_map_get(node, "args"), hexa_int(1)))), hexa_str(", ")), gen2_expr(hexa_index_get(hexa_map_get(node, "args"), hexa_int(2)))), hexa_str(")"));
            }
            if (hexa_truthy(hexa_eq(name, hexa_str("ptr_read")))) {
                return hexa_add(hexa_add(hexa_add(hexa_add(hexa_str("hexa_ptr_read("), gen2_expr(hexa_index_get(hexa_map_get(node, "args"), hexa_int(0)))), hexa_str(", ")), gen2_expr(hexa_index_get(hexa_map_get(node, "args"), hexa_int(1)))), hexa_str(")"));
            }
            if (hexa_truthy(hexa_eq(name, hexa_str("ptr_read_f64")))) {
                return hexa_add(hexa_add(hexa_add(hexa_add(hexa_str("hexa_ptr_read_f64("), gen2_expr(hexa_index_get(hexa_map_get(node, "args"), hexa_int(0)))), hexa_str(", ")), gen2_expr(hexa_index_get(hexa_map_get(node, "args"), hexa_int(1)))), hexa_str(")"));
            }
            if (hexa_truthy(hexa_eq(name, hexa_str("ptr_read_f32")))) {
                return hexa_add(hexa_add(hexa_add(hexa_add(hexa_str("hexa_ptr_read_f32("), gen2_expr(hexa_index_get(hexa_map_get(node, "args"), hexa_int(0)))), hexa_str(", ")), gen2_expr(hexa_index_get(hexa_map_get(node, "args"), hexa_int(1)))), hexa_str(")"));
            }
            if (hexa_truthy(hexa_eq(name, hexa_str("ptr_read_i32")))) {
                return hexa_add(hexa_add(hexa_add(hexa_add(hexa_str("hexa_ptr_read_i32("), gen2_expr(hexa_index_get(hexa_map_get(node, "args"), hexa_int(0)))), hexa_str(", ")), gen2_expr(hexa_index_get(hexa_map_get(node, "args"), hexa_int(1)))), hexa_str(")"));
            }
            if (hexa_truthy(hexa_eq(name, hexa_str("ptr_offset")))) {
                return hexa_add(hexa_add(hexa_add(hexa_add(hexa_str("hexa_ptr_offset("), gen2_expr(hexa_index_get(hexa_map_get(node, "args"), hexa_int(0)))), hexa_str(", ")), gen2_expr(hexa_index_get(hexa_map_get(node, "args"), hexa_int(1)))), hexa_str(")"));
            }
            if (hexa_truthy(hexa_eq(name, hexa_str("deref")))) {
                return hexa_add(hexa_add(hexa_str("hexa_deref("), gen2_expr(hexa_index_get(hexa_map_get(node, "args"), hexa_int(0)))), hexa_str(")"));
            }
            if (hexa_truthy(hexa_eq(name, hexa_str("struct_pack")))) {
                HexaVal a_strs = hexa_array_new();
                HexaVal si = hexa_int(0);
                while (hexa_truthy(hexa_bool((si).i < (hexa_int(hexa_len(hexa_map_get(node, "args")))).i))) {
                    a_strs = hexa_array_push(a_strs, gen2_expr(hexa_index_get(hexa_map_get(node, "args"), si)));
                    si = hexa_add(si, hexa_int(1));
                }
                HexaVal n = hexa_to_string(hexa_int(hexa_len(hexa_map_get(node, "args"))));
                return hexa_add(hexa_add(hexa_add(hexa_add(hexa_str("hexa_struct_pack((HexaVal[]){"), hexa_str_join(a_strs, hexa_str(", "))), hexa_str("}, ")), n), hexa_str(")"));
            }
            if (hexa_truthy(hexa_eq(name, hexa_str("struct_pack_f32")))) {
                HexaVal a_strs = hexa_array_new();
                HexaVal si = hexa_int(0);
                while (hexa_truthy(hexa_bool((si).i < (hexa_int(hexa_len(hexa_map_get(node, "args")))).i))) {
                    a_strs = hexa_array_push(a_strs, gen2_expr(hexa_index_get(hexa_map_get(node, "args"), si)));
                    si = hexa_add(si, hexa_int(1));
                }
                HexaVal n = hexa_to_string(hexa_int(hexa_len(hexa_map_get(node, "args"))));
                return hexa_add(hexa_add(hexa_add(hexa_add(hexa_str("hexa_struct_pack_f32((HexaVal[]){"), hexa_str_join(a_strs, hexa_str(", "))), hexa_str("}, ")), n), hexa_str(")"));
            }
            if (hexa_truthy(hexa_eq(name, hexa_str("struct_unpack")))) {
                return hexa_add(hexa_add(hexa_add(hexa_add(hexa_str("hexa_struct_unpack("), gen2_expr(hexa_index_get(hexa_map_get(node, "args"), hexa_int(0)))), hexa_str(", ")), gen2_expr(hexa_index_get(hexa_map_get(node, "args"), hexa_int(1)))), hexa_str(")"));
            }
            if (hexa_truthy(hexa_eq(name, hexa_str("struct_unpack_f32")))) {
                return hexa_add(hexa_add(hexa_add(hexa_add(hexa_str("hexa_struct_unpack_f32("), gen2_expr(hexa_index_get(hexa_map_get(node, "args"), hexa_int(0)))), hexa_str(", ")), gen2_expr(hexa_index_get(hexa_map_get(node, "args"), hexa_int(1)))), hexa_str(")"));
            }
            if (hexa_truthy(hexa_eq(name, hexa_str("struct_rect")))) {
                return hexa_add(hexa_add(hexa_add(hexa_add(hexa_add(hexa_add(hexa_add(hexa_add(hexa_str("hexa_struct_rect("), gen2_expr(hexa_index_get(hexa_map_get(node, "args"), hexa_int(0)))), hexa_str(", ")), gen2_expr(hexa_index_get(hexa_map_get(node, "args"), hexa_int(1)))), hexa_str(", ")), gen2_expr(hexa_index_get(hexa_map_get(node, "args"), hexa_int(2)))), hexa_str(", ")), gen2_expr(hexa_index_get(hexa_map_get(node, "args"), hexa_int(3)))), hexa_str(")"));
            }
            if (hexa_truthy(hexa_eq(name, hexa_str("struct_point")))) {
                return hexa_add(hexa_add(hexa_add(hexa_add(hexa_str("hexa_struct_point("), gen2_expr(hexa_index_get(hexa_map_get(node, "args"), hexa_int(0)))), hexa_str(", ")), gen2_expr(hexa_index_get(hexa_map_get(node, "args"), hexa_int(1)))), hexa_str(")"));
            }
            if (hexa_truthy(hexa_eq(name, hexa_str("struct_size")))) {
                return hexa_add(hexa_add(hexa_add(hexa_add(hexa_str("hexa_struct_size_pack("), gen2_expr(hexa_index_get(hexa_map_get(node, "args"), hexa_int(0)))), hexa_str(", ")), gen2_expr(hexa_index_get(hexa_map_get(node, "args"), hexa_int(1)))), hexa_str(")"));
            }
            if (hexa_truthy(hexa_eq(name, hexa_str("struct_free")))) {
                return hexa_add(hexa_add(hexa_str("hexa_struct_free("), gen2_expr(hexa_index_get(hexa_map_get(node, "args"), hexa_int(0)))), hexa_str(")"));
            }
            HexaVal arg_strs = hexa_array_new();
            HexaVal ai = hexa_int(0);
            while (hexa_truthy(hexa_bool((ai).i < (hexa_int(hexa_len(hexa_map_get(node, "args")))).i))) {
                arg_strs = hexa_array_push(arg_strs, gen2_expr(hexa_index_get(hexa_map_get(node, "args"), ai)));
                ai = hexa_add(ai, hexa_int(1));
            }
            if (hexa_truthy(_is_known_fn_global(name))) {
                return hexa_add(hexa_add(hexa_add(name, hexa_str("(")), hexa_str_join(arg_strs, hexa_str(", "))), hexa_str(")"));
            }
            HexaVal nargs = hexa_int(hexa_len(hexa_map_get(node, "args")));
            if (hexa_truthy(hexa_eq(nargs, hexa_int(0)))) {
                return hexa_add(hexa_add(hexa_str("hexa_call0("), name), hexa_str(")"));
            }
            if (hexa_truthy(hexa_eq(nargs, hexa_int(1)))) {
                return hexa_add(hexa_add(hexa_add(hexa_add(hexa_str("hexa_call1("), name), hexa_str(", ")), hexa_index_get(arg_strs, hexa_int(0))), hexa_str(")"));
            }
            if (hexa_truthy(hexa_eq(nargs, hexa_int(2)))) {
                return hexa_add(hexa_add(hexa_add(hexa_add(hexa_str("hexa_call2("), name), hexa_str(", ")), hexa_str_join(arg_strs, hexa_str(", "))), hexa_str(")"));
            }
            if (hexa_truthy(hexa_eq(nargs, hexa_int(3)))) {
                return hexa_add(hexa_add(hexa_add(hexa_add(hexa_str("hexa_call3("), name), hexa_str(", ")), hexa_str_join(arg_strs, hexa_str(", "))), hexa_str(")"));
            }
            if (hexa_truthy(hexa_eq(nargs, hexa_int(4)))) {
                return hexa_add(hexa_add(hexa_add(hexa_add(hexa_str("hexa_call4("), name), hexa_str(", ")), hexa_str_join(arg_strs, hexa_str(", "))), hexa_str(")"));
            }
            return hexa_add(hexa_add(hexa_add(name, hexa_str("(")), hexa_str_join(arg_strs, hexa_str(", "))), hexa_str(")"));
        }
        if (hexa_truthy(hexa_bool(hexa_truthy(hexa_bool(!hexa_truthy(hexa_eq(hexa_type_of(callee), hexa_str("string"))))) && hexa_truthy(hexa_eq(hexa_map_get(callee, "kind"), hexa_str("Field")))))) {
            HexaVal obj = gen2_expr(hexa_map_get(callee, "left"));
            HexaVal method = hexa_map_get(callee, "name");
            HexaVal user_types = _method_registry_lookup(method);
            if (hexa_truthy(hexa_bool((hexa_int(hexa_len(user_types))).i > (hexa_int(0)).i))) {
                HexaVal u_args = hexa_array_new();
                HexaVal uai = hexa_int(0);
                while (hexa_truthy(hexa_bool((uai).i < (hexa_int(hexa_len(hexa_map_get(node, "args")))).i))) {
                    u_args = hexa_array_push(u_args, gen2_expr(hexa_index_get(hexa_map_get(node, "args"), uai)));
                    uai = hexa_add(uai, hexa_int(1));
                }
                HexaVal u_arg_tail = hexa_str_join(u_args, hexa_str(", "));
                HexaVal __saved_obj = obj;
                HexaVal fb = gen2_method_builtin(hexa_str("__mr"), method, hexa_map_get(node, "args"));
                HexaVal chain = fb;
                HexaVal ti = hexa_int((hexa_int(hexa_len(user_types))).i - (hexa_int(1)).i);
                while (hexa_truthy(hexa_bool((ti).i >= (hexa_int(0)).i))) {
                    HexaVal tname = hexa_index_get(user_types, ti);
                    HexaVal call_args = hexa_str("__mr");
                    HexaVal full_args = (hexa_truthy(hexa_eq(u_arg_tail, hexa_str(""))) ? call_args : hexa_add(hexa_add(call_args, hexa_str(", ")), u_arg_tail));
                    chain = hexa_add(hexa_add(hexa_add(hexa_add(hexa_add(hexa_add(hexa_add(hexa_add(hexa_add(hexa_add(hexa_str("(hexa_is_type(__mr, \""), tname), hexa_str("\") ? ")), tname), hexa_str("__")), method), hexa_str("(")), full_args), hexa_str(") : ")), chain), hexa_str(")"));
                    ti = hexa_int((ti).i - (hexa_int(1)).i);
                }
                return hexa_add(hexa_add(hexa_add(hexa_add(hexa_str("({ HexaVal __mr = "), __saved_obj), hexa_str("; ")), chain), hexa_str("; })"));
            }
            if (hexa_truthy(hexa_eq(method, hexa_str("push")))) {
                return hexa_add(hexa_add(hexa_add(hexa_add(hexa_str("hexa_array_push("), obj), hexa_str(", ")), gen2_expr(hexa_index_get(hexa_map_get(node, "args"), hexa_int(0)))), hexa_str(")"));
            }
            if (hexa_truthy(hexa_eq(method, hexa_str("len")))) {
                return hexa_add(hexa_add(hexa_str("hexa_int(hexa_len("), obj), hexa_str("))"));
            }
            if (hexa_truthy(hexa_eq(method, hexa_str("chars")))) {
                return hexa_add(hexa_add(hexa_str("hexa_str_chars("), obj), hexa_str(")"));
            }
            if (hexa_truthy(hexa_eq(method, hexa_str("contains")))) {
                return hexa_add(hexa_add(hexa_add(hexa_add(hexa_str("hexa_bool(hexa_str_contains("), obj), hexa_str(", ")), gen2_expr(hexa_index_get(hexa_map_get(node, "args"), hexa_int(0)))), hexa_str("))"));
            }
            if (hexa_truthy(hexa_eq(method, hexa_str("join")))) {
                return hexa_add(hexa_add(hexa_add(hexa_add(hexa_str("hexa_str_join("), obj), hexa_str(", ")), gen2_expr(hexa_index_get(hexa_map_get(node, "args"), hexa_int(0)))), hexa_str(")"));
            }
            if (hexa_truthy(hexa_eq(method, hexa_str("to_upper")))) {
                return hexa_add(hexa_add(hexa_str("hexa_str_to_upper("), obj), hexa_str(")"));
            }
            if (hexa_truthy(hexa_eq(method, hexa_str("to_lower")))) {
                return hexa_add(hexa_add(hexa_str("hexa_str_to_lower("), obj), hexa_str(")"));
            }
            if (hexa_truthy(hexa_eq(method, hexa_str("split")))) {
                return hexa_add(hexa_add(hexa_add(hexa_add(hexa_str("hexa_str_split("), obj), hexa_str(", ")), gen2_expr(hexa_index_get(hexa_map_get(node, "args"), hexa_int(0)))), hexa_str(")"));
            }
            if (hexa_truthy(hexa_eq(method, hexa_str("trim")))) {
                return hexa_add(hexa_add(hexa_str("hexa_str_trim("), obj), hexa_str(")"));
            }
            if (hexa_truthy(hexa_eq(method, hexa_str("replace")))) {
                return hexa_add(hexa_add(hexa_add(hexa_add(hexa_add(hexa_add(hexa_str("hexa_str_replace("), obj), hexa_str(", ")), gen2_expr(hexa_index_get(hexa_map_get(node, "args"), hexa_int(0)))), hexa_str(", ")), gen2_expr(hexa_index_get(hexa_map_get(node, "args"), hexa_int(1)))), hexa_str(")"));
            }
            if (hexa_truthy(hexa_eq(method, hexa_str("repeat")))) {
                return hexa_add(hexa_add(hexa_add(hexa_add(hexa_str("hexa_str_repeat("), obj), hexa_str(", ")), gen2_expr(hexa_index_get(hexa_map_get(node, "args"), hexa_int(0)))), hexa_str(")"));
            }
            if (hexa_truthy(hexa_eq(method, hexa_str("starts_with")))) {
                return hexa_add(hexa_add(hexa_add(hexa_add(hexa_str("hexa_bool(hexa_str_starts_with("), obj), hexa_str(", ")), gen2_expr(hexa_index_get(hexa_map_get(node, "args"), hexa_int(0)))), hexa_str("))"));
            }
            if (hexa_truthy(hexa_eq(method, hexa_str("ends_with")))) {
                return hexa_add(hexa_add(hexa_add(hexa_add(hexa_str("hexa_bool(hexa_str_ends_with("), obj), hexa_str(", ")), gen2_expr(hexa_index_get(hexa_map_get(node, "args"), hexa_int(0)))), hexa_str("))"));
            }
            if (hexa_truthy(hexa_eq(method, hexa_str("substring")))) {
                return hexa_add(hexa_add(hexa_add(hexa_add(hexa_add(hexa_add(hexa_str("hexa_str_substring("), obj), hexa_str(", ")), gen2_expr(hexa_index_get(hexa_map_get(node, "args"), hexa_int(0)))), hexa_str(", ")), gen2_expr(hexa_index_get(hexa_map_get(node, "args"), hexa_int(1)))), hexa_str(")"));
            }
            if (hexa_truthy(hexa_eq(method, hexa_str("index_of")))) {
                return hexa_add(hexa_add(hexa_add(hexa_add(hexa_str("hexa_int(hexa_str_index_of("), obj), hexa_str(", ")), gen2_expr(hexa_index_get(hexa_map_get(node, "args"), hexa_int(0)))), hexa_str("))"));
            }
            if (hexa_truthy(hexa_eq(method, hexa_str("keys")))) {
                return hexa_add(hexa_add(hexa_str("hexa_map_keys("), obj), hexa_str(")"));
            }
            if (hexa_truthy(hexa_eq(method, hexa_str("values")))) {
                return hexa_add(hexa_add(hexa_str("hexa_map_values("), obj), hexa_str(")"));
            }
            if (hexa_truthy(hexa_eq(method, hexa_str("contains_key")))) {
                return hexa_add(hexa_add(hexa_add(hexa_add(hexa_str("hexa_bool(hexa_map_contains_key("), obj), hexa_str(", ")), gen2_expr(hexa_index_get(hexa_map_get(node, "args"), hexa_int(0)))), hexa_str(".s))"));
            }
            if (hexa_truthy(hexa_eq(method, hexa_str("remove")))) {
                return hexa_add(hexa_add(hexa_add(hexa_add(hexa_str("hexa_map_remove("), obj), hexa_str(", ")), gen2_expr(hexa_index_get(hexa_map_get(node, "args"), hexa_int(0)))), hexa_str(".s)"));
            }
            if (hexa_truthy(hexa_eq(method, hexa_str("pop")))) {
                return hexa_add(hexa_add(hexa_str("hexa_array_pop("), obj), hexa_str(")"));
            }
            if (hexa_truthy(hexa_eq(method, hexa_str("reverse")))) {
                return hexa_add(hexa_add(hexa_str("hexa_array_reverse("), obj), hexa_str(")"));
            }
            if (hexa_truthy(hexa_eq(method, hexa_str("sort")))) {
                return hexa_add(hexa_add(hexa_str("hexa_array_sort("), obj), hexa_str(")"));
            }
            // bt 55 — in-place array length shrink; caller must reassign.
            if (hexa_truthy(hexa_eq(method, hexa_str("truncate")))) {
                return hexa_add(hexa_add(hexa_add(hexa_add(hexa_str("hexa_array_truncate("), obj), hexa_str(", ")), gen2_expr(hexa_index_get(hexa_map_get(node, "args"), hexa_int(0)))), hexa_str(")"));
            }
            // rt 32-B — scratch push (no stats) + bulk slice for reusable call_arg_buf.
            if (hexa_truthy(hexa_eq(method, hexa_str("push_nostat")))) {
                return hexa_add(hexa_add(hexa_add(hexa_add(hexa_str("hexa_array_push_nostat("), obj), hexa_str(", ")), gen2_expr(hexa_index_get(hexa_map_get(node, "args"), hexa_int(0)))), hexa_str(")"));
            }
            if (hexa_truthy(hexa_eq(method, hexa_str("slice_fast")))) {
                return hexa_add(hexa_add(hexa_add(hexa_add(hexa_add(hexa_add(hexa_str("hexa_array_slice_fast("), obj), hexa_str(", ")), gen2_expr(hexa_index_get(hexa_map_get(node, "args"), hexa_int(0)))), hexa_str(", ")), gen2_expr(hexa_index_get(hexa_map_get(node, "args"), hexa_int(1)))), hexa_str(")"));
            }
            return hexa_add(hexa_add(hexa_str("/* method."), method), hexa_str(" */"));
        }
        HexaVal cexpr = gen2_expr(callee);
        HexaVal nargs = hexa_int(hexa_len(hexa_map_get(node, "args")));
        HexaVal cargs = hexa_array_new();
        HexaVal ci = hexa_int(0);
        while (hexa_truthy(hexa_bool((ci).i < (nargs).i))) {
            cargs = hexa_array_push(cargs, gen2_expr(hexa_index_get(hexa_map_get(node, "args"), ci)));
            ci = hexa_add(ci, hexa_int(1));
        }
        if (hexa_truthy(hexa_eq(nargs, hexa_int(0)))) {
            return hexa_add(hexa_add(hexa_str("hexa_call0("), cexpr), hexa_str(")"));
        }
        if (hexa_truthy(hexa_eq(nargs, hexa_int(1)))) {
            return hexa_add(hexa_add(hexa_add(hexa_add(hexa_str("hexa_call1("), cexpr), hexa_str(", ")), hexa_index_get(cargs, hexa_int(0))), hexa_str(")"));
        }
        if (hexa_truthy(hexa_eq(nargs, hexa_int(2)))) {
            return hexa_add(hexa_add(hexa_add(hexa_add(hexa_str("hexa_call2("), cexpr), hexa_str(", ")), hexa_str_join(cargs, hexa_str(", "))), hexa_str(")"));
        }
        if (hexa_truthy(hexa_eq(nargs, hexa_int(3)))) {
            return hexa_add(hexa_add(hexa_add(hexa_add(hexa_str("hexa_call3("), cexpr), hexa_str(", ")), hexa_str_join(cargs, hexa_str(", "))), hexa_str(")"));
        }
        if (hexa_truthy(hexa_eq(nargs, hexa_int(4)))) {
            return hexa_add(hexa_add(hexa_add(hexa_add(hexa_str("hexa_call4("), cexpr), hexa_str(", ")), hexa_str_join(cargs, hexa_str(", "))), hexa_str(")"));
        }
        return hexa_add(hexa_add(hexa_str("/* indirect call arity "), hexa_to_string(nargs)), hexa_str(" unsupported */"));
    }
    if (hexa_truthy(hexa_eq(k, hexa_str("Array")))) {
        HexaVal out = hexa_str("hexa_array_new()");
        HexaVal ai = hexa_int(0);
        while (hexa_truthy(hexa_bool((ai).i < (hexa_int(hexa_len(hexa_map_get(node, "items")))).i))) {
            out = hexa_add(hexa_add(hexa_add(hexa_add(hexa_str("hexa_array_push("), out), hexa_str(", ")), gen2_expr(hexa_index_get(hexa_map_get(node, "items"), ai))), hexa_str(")"));
            ai = hexa_add(ai, hexa_int(1));
        }
        return out;
    }
    if (hexa_truthy(hexa_eq(k, hexa_str("Index")))) {
        return hexa_add(hexa_add(hexa_add(hexa_add(hexa_str("hexa_index_get("), gen2_expr(hexa_map_get(node, "left"))), hexa_str(", ")), gen2_expr(hexa_map_get(node, "right"))), hexa_str(")"));
    }
    if (hexa_truthy(hexa_eq(k, hexa_str("EnumPath")))) {
        HexaVal ename = hexa_map_get(node, "name");
        HexaVal vname = hexa_map_get(node, "value");
        return hexa_add(hexa_add(ename, hexa_str("_")), vname);
    }
    if (hexa_truthy(hexa_eq(k, hexa_str("IfExpr")))) {
        HexaVal c = gen2_expr(hexa_map_get(node, "cond"));
        HexaVal t_val = hexa_str("hexa_void()");
        if (hexa_truthy(hexa_bool(hexa_truthy(hexa_bool(!hexa_truthy(hexa_eq(hexa_type_of(hexa_map_get(node, "then_body")), hexa_str("string"))))) && hexa_truthy(hexa_bool((hexa_int(hexa_len(hexa_map_get(node, "then_body")))).i > (hexa_int(0)).i))))) {
            HexaVal t_last = hexa_index_get(hexa_map_get(node, "then_body"), hexa_int((hexa_int(hexa_len(hexa_map_get(node, "then_body")))).i - (hexa_int(1)).i));
            if (hexa_truthy(hexa_bool(hexa_truthy(hexa_bool(hexa_truthy(hexa_bool(!hexa_truthy(hexa_eq(hexa_type_of(t_last), hexa_str("string"))))) && hexa_truthy(hexa_eq(hexa_map_get(t_last, "kind"), hexa_str("ExprStmt"))))) && hexa_truthy(hexa_bool(!hexa_truthy(hexa_eq(hexa_type_of(hexa_map_get(t_last, "left")), hexa_str("string")))))))) {
                t_val = gen2_expr(hexa_map_get(t_last, "left"));
            }
        }
        HexaVal e_val = hexa_str("hexa_void()");
        if (hexa_truthy(hexa_bool(hexa_truthy(hexa_bool(!hexa_truthy(hexa_eq(hexa_type_of(hexa_map_get(node, "else_body")), hexa_str("string"))))) && hexa_truthy(hexa_bool((hexa_int(hexa_len(hexa_map_get(node, "else_body")))).i > (hexa_int(0)).i))))) {
            HexaVal e_last = hexa_index_get(hexa_map_get(node, "else_body"), hexa_int((hexa_int(hexa_len(hexa_map_get(node, "else_body")))).i - (hexa_int(1)).i));
            if (hexa_truthy(hexa_bool(hexa_truthy(hexa_bool(hexa_truthy(hexa_bool(!hexa_truthy(hexa_eq(hexa_type_of(e_last), hexa_str("string"))))) && hexa_truthy(hexa_eq(hexa_map_get(e_last, "kind"), hexa_str("ExprStmt"))))) && hexa_truthy(hexa_bool(!hexa_truthy(hexa_eq(hexa_type_of(hexa_map_get(e_last, "left")), hexa_str("string")))))))) {
                e_val = gen2_expr(hexa_map_get(e_last, "left"));
            }
        }
        return hexa_add(hexa_add(hexa_add(hexa_add(hexa_add(hexa_add(hexa_str("(hexa_truthy("), c), hexa_str(") ? ")), t_val), hexa_str(" : ")), e_val), hexa_str(")"));
    }
    if (hexa_truthy(hexa_eq(k, hexa_str("MatchExpr")))) {
        return gen2_match_expr(node);
    }
    if (hexa_truthy(hexa_eq(k, hexa_str("Lambda")))) {
        return gen2_lambda_expr(node);
    }
    if (hexa_truthy(hexa_bool(hexa_truthy(hexa_eq(k, hexa_str("Tuple"))) || hexa_truthy(hexa_eq(k, hexa_str("TupleLit")))))) {
        HexaVal out = hexa_str("hexa_array_new()");
        HexaVal items = hexa_map_get(node, "items");
        if (hexa_truthy(hexa_bool(!hexa_truthy(hexa_eq(hexa_type_of(items), hexa_str("string")))))) {
            HexaVal ti = hexa_int(0);
            while (hexa_truthy(hexa_bool((ti).i < (hexa_int(hexa_len(items))).i))) {
                out = hexa_add(hexa_add(hexa_add(hexa_add(hexa_str("hexa_array_push("), out), hexa_str(", ")), gen2_expr(hexa_index_get(items, ti))), hexa_str(")"));
                ti = hexa_add(ti, hexa_int(1));
            }
        }
        return out;
    }
    if (hexa_truthy(hexa_eq(k, hexa_str("MapLit")))) {
        HexaVal out = hexa_str("hexa_map_new()");
        if (hexa_truthy(hexa_bool(!hexa_truthy(hexa_eq(hexa_type_of(hexa_map_get(node, "items")), hexa_str("string")))))) {
            HexaVal mi = hexa_int(0);
            while (hexa_truthy(hexa_bool((mi).i < (hexa_int(hexa_len(hexa_map_get(node, "items")))).i))) {
                HexaVal entry = hexa_index_get(hexa_map_get(node, "items"), mi);
                HexaVal key_c = gen2_expr(hexa_map_get(entry, "left"));
                if (hexa_truthy(hexa_bool(hexa_truthy(hexa_bool(!hexa_truthy(hexa_eq(hexa_type_of(hexa_map_get(entry, "left")), hexa_str("string"))))) && hexa_truthy(hexa_eq(hexa_map_get(hexa_map_get(entry, "left"), "kind"), hexa_str("StringLit")))))) {
                    key_c = hexa_add(hexa_add(hexa_str("\""), c_escape(hexa_map_get(hexa_map_get(entry, "left"), "value"))), hexa_str("\""));
                }
                out = hexa_add(hexa_add(hexa_add(hexa_add(hexa_add(hexa_add(hexa_str("hexa_map_set("), out), hexa_str(", ")), key_c), hexa_str(", ")), gen2_expr(hexa_map_get(entry, "right"))), hexa_str(")"));
                mi = hexa_add(mi, hexa_int(1));
            }
        }
        return out;
    }
    if (hexa_truthy(hexa_eq(k, hexa_str("NegFloat")))) {
        return hexa_add(hexa_add(hexa_str("hexa_float(-("), gen2_expr(hexa_map_get(node, "left"))), hexa_str(").f)"));
    }
    if (hexa_truthy(hexa_eq(k, hexa_str("Wildcard")))) {
        return hexa_str("/* wildcard */");
    }
    if (hexa_truthy(hexa_eq(k, hexa_str("")))) {
        return hexa_str("hexa_map_new()");
    }
    return hexa_add(hexa_add(hexa_str("/* expr:"), k), hexa_str(" */"));
    return hexa_void();
}


HexaVal gen2_struct_decl(HexaVal node) {
    HexaVal name = hexa_map_get(node, "name");
    HexaVal params = hexa_array_new();
    HexaVal body_parts = hexa_array_new();
    body_parts = hexa_array_push(body_parts, hexa_str("    HexaVal __s = hexa_map_new();\n"));
    body_parts = hexa_array_push(body_parts, hexa_add(hexa_add(hexa_str("    __s = hexa_map_set(__s, \"__type__\", hexa_str(\""), name), hexa_str("\"));\n")));
    HexaVal i = hexa_int(0);
    while (hexa_truthy(hexa_bool((i).i < (hexa_int(hexa_len(hexa_map_get(node, "fields")))).i))) {
        HexaVal f = hexa_index_get(hexa_map_get(node, "fields"), i);
        params = hexa_array_push(params, hexa_add(hexa_str("HexaVal "), hexa_map_get(f, "name")));
        body_parts = hexa_array_push(body_parts, hexa_add(hexa_add(hexa_add(hexa_add(hexa_str("    __s = hexa_map_set(__s, \""), hexa_map_get(f, "name")), hexa_str("\", ")), hexa_map_get(f, "name")), hexa_str(");\n")));
        i = hexa_add(i, hexa_int(1));
    }
    HexaVal p = hexa_str_join(params, hexa_str(", "));
    if (hexa_truthy(hexa_eq(p, hexa_str("")))) {
        p = hexa_str("void");
    }
    return hexa_add(hexa_add(hexa_add(hexa_add(hexa_add(hexa_add(hexa_str("HexaVal "), name), hexa_str("(")), p), hexa_str(") {\n")), hexa_str_join(body_parts, hexa_str(""))), hexa_str("    return __s;\n}\n"));
    return hexa_void();
}


HexaVal gen2_enum_decl(HexaVal node) {
    HexaVal name = hexa_map_get(node, "name");
    HexaVal parts = hexa_array_new();
    parts = hexa_array_push(parts, hexa_add(hexa_add(hexa_str("// enum "), name), hexa_str("\n")));
    HexaVal i = hexa_int(0);
    while (hexa_truthy(hexa_bool((i).i < (hexa_int(hexa_len(hexa_map_get(node, "variants")))).i))) {
        HexaVal v = hexa_index_get(hexa_map_get(node, "variants"), i);
        parts = hexa_array_push(parts, hexa_add(hexa_add(hexa_add(hexa_add(hexa_add(hexa_add(hexa_str("#define "), name), hexa_str("_")), hexa_map_get(v, "name")), hexa_str(" hexa_int(")), hexa_to_string(i)), hexa_str(")\n")));
        i = hexa_add(i, hexa_int(1));
    }
    return hexa_str_join(parts, hexa_str(""));
    return hexa_void();
}


HexaVal gen2_match_stmt(HexaVal node, HexaVal depth) {
    HexaVal pad = gen2_indent(depth);
    HexaVal scrutinee = gen2_expr(hexa_map_get(node, "left"));
    HexaVal chunks = hexa_array_new();
    chunks = hexa_array_push(chunks, hexa_add(pad, hexa_str("{\n")));
    HexaVal pad2 = gen2_indent(hexa_add(depth, hexa_int(1)));
    chunks = hexa_array_push(chunks, hexa_add(hexa_add(hexa_add(pad2, hexa_str("HexaVal __match_val = ")), scrutinee), hexa_str(";\n")));
    HexaVal ai = hexa_int(0);
    while (hexa_truthy(hexa_bool((ai).i < (hexa_int(hexa_len(hexa_map_get(node, "arms")))).i))) {
        HexaVal arm = hexa_index_get(hexa_map_get(node, "arms"), ai);
        HexaVal pat = hexa_map_get(arm, "left");
        HexaVal is_wildcard = hexa_bool(hexa_truthy(hexa_bool(!hexa_truthy(hexa_eq(hexa_type_of(pat), hexa_str("string"))))) && hexa_truthy(hexa_eq(hexa_map_get(pat, "kind"), hexa_str("Wildcard"))));
        if (hexa_truthy(is_wildcard)) {
            if (hexa_truthy(hexa_bool((ai).i > (hexa_int(0)).i))) {
                chunks = hexa_array_push(chunks, hexa_str(" else {\n"));
            } else {
                chunks = hexa_array_push(chunks, hexa_add(pad2, hexa_str("{\n")));
            }
        } else {
            HexaVal cond = gen2_match_cond(pat, hexa_str("__match_val"));
            if (hexa_truthy(hexa_eq(ai, hexa_int(0)))) {
                chunks = hexa_array_push(chunks, hexa_add(hexa_add(hexa_add(pad2, hexa_str("if (")), cond), hexa_str(") {\n")));
            } else {
                chunks = hexa_array_push(chunks, hexa_add(hexa_add(hexa_str(" else if ("), cond), hexa_str(") {\n")));
            }
        }
        HexaVal bi = hexa_int(0);
        while (hexa_truthy(hexa_bool((bi).i < (hexa_int(hexa_len(hexa_map_get(arm, "body")))).i))) {
            chunks = hexa_array_push(chunks, gen2_stmt(hexa_index_get(hexa_map_get(arm, "body"), bi), hexa_add(depth, hexa_int(2))));
            bi = hexa_add(bi, hexa_int(1));
        }
        chunks = hexa_array_push(chunks, hexa_add(pad2, hexa_str("}")));
        ai = hexa_add(ai, hexa_int(1));
    }
    chunks = hexa_array_push(chunks, hexa_add(hexa_add(hexa_str("\n"), pad), hexa_str("}\n")));
    return hexa_str_join(chunks, hexa_str(""));
    return hexa_void();
}


HexaVal gen2_match_cond(HexaVal pat, HexaVal scrutinee_var) {
    if (hexa_truthy(hexa_eq(hexa_type_of(pat), hexa_str("string")))) {
        return hexa_str("1");
    }
    HexaVal k = hexa_map_get(pat, "kind");
    if (hexa_truthy(hexa_eq(k, hexa_str("Wildcard")))) {
        return hexa_str("1");
    }
    if (hexa_truthy(hexa_eq(k, hexa_str("IntLit")))) {
        return hexa_add(hexa_add(hexa_add(hexa_add(hexa_str("hexa_truthy(hexa_eq("), scrutinee_var), hexa_str(", hexa_int(")), hexa_map_get(pat, "value")), hexa_str(")))"));
    }
    if (hexa_truthy(hexa_eq(k, hexa_str("FloatLit")))) {
        return hexa_add(hexa_add(hexa_add(hexa_add(hexa_str("hexa_truthy(hexa_eq("), scrutinee_var), hexa_str(", hexa_float(")), hexa_map_get(pat, "value")), hexa_str(")))"));
    }
    if (hexa_truthy(hexa_eq(k, hexa_str("StringLit")))) {
        return hexa_add(hexa_add(hexa_add(hexa_add(hexa_str("hexa_truthy(hexa_eq("), scrutinee_var), hexa_str(", hexa_str(\"")), c_escape(hexa_map_get(pat, "value"))), hexa_str("\")))"));
    }
    if (hexa_truthy(hexa_eq(k, hexa_str("BoolLit")))) {
        if (hexa_truthy(hexa_eq(hexa_map_get(pat, "value"), hexa_str("true")))) {
            return hexa_add(hexa_add(hexa_str("hexa_truthy(hexa_eq("), scrutinee_var), hexa_str(", hexa_bool(1)))"));
        }
        return hexa_add(hexa_add(hexa_str("hexa_truthy(hexa_eq("), scrutinee_var), hexa_str(", hexa_bool(0)))"));
    }
    if (hexa_truthy(hexa_eq(k, hexa_str("EnumPath")))) {
        HexaVal enum_const = hexa_add(hexa_add(hexa_map_get(pat, "name"), hexa_str("_")), hexa_map_get(pat, "value"));
        return hexa_add(hexa_add(hexa_add(hexa_add(hexa_str("hexa_truthy(hexa_eq("), scrutinee_var), hexa_str(", ")), enum_const), hexa_str("))"));
    }
    return hexa_add(hexa_add(hexa_add(hexa_add(hexa_str("hexa_truthy(hexa_eq("), scrutinee_var), hexa_str(", ")), gen2_expr(pat)), hexa_str("))"));
    return hexa_void();
}


HexaVal gen2_match_expr(HexaVal node) {
    HexaVal scrutinee = gen2_expr(hexa_map_get(node, "left"));
    HexaVal arms = hexa_map_get(node, "arms");
    return gen2_match_ternary(arms, scrutinee, hexa_int(0));
    return hexa_void();
}


HexaVal gen2_match_ternary(HexaVal arms, HexaVal scrutinee_c, HexaVal idx) {
    if (hexa_truthy(hexa_bool((idx).i >= (hexa_int(hexa_len(arms))).i))) {
        return hexa_str("hexa_void()");
    }
    HexaVal arm = hexa_index_get(arms, idx);
    HexaVal pat = hexa_map_get(arm, "left");
    HexaVal is_wildcard = hexa_bool(hexa_truthy(hexa_bool(!hexa_truthy(hexa_eq(hexa_type_of(pat), hexa_str("string"))))) && hexa_truthy(hexa_eq(hexa_map_get(pat, "kind"), hexa_str("Wildcard"))));
    HexaVal val = gen2_arm_value(hexa_map_get(arm, "body"));
    if (hexa_truthy(hexa_bool(hexa_truthy(is_wildcard) || hexa_truthy(hexa_eq(idx, hexa_int((hexa_int(hexa_len(arms))).i - (hexa_int(1)).i)))))) {
        if (hexa_truthy(is_wildcard)) {
            return val;
        }
        HexaVal cond = gen2_match_cond(pat, scrutinee_c);
        return hexa_add(hexa_add(hexa_add(hexa_add(hexa_str("("), cond), hexa_str(" ? ")), val), hexa_str(" : hexa_void())"));
    }
    HexaVal cond = gen2_match_cond(pat, scrutinee_c);
    HexaVal rest = gen2_match_ternary(arms, scrutinee_c, hexa_add(idx, hexa_int(1)));
    return hexa_add(hexa_add(hexa_add(hexa_add(hexa_add(hexa_add(hexa_str("("), cond), hexa_str(" ? ")), val), hexa_str(" : ")), rest), hexa_str(")"));
    return hexa_void();
}


HexaVal gen2_arm_value(HexaVal body) {
    if (hexa_truthy(hexa_bool(hexa_truthy(hexa_eq(hexa_type_of(body), hexa_str("string"))) || hexa_truthy(hexa_eq(hexa_int(hexa_len(body)), hexa_int(0)))))) {
        return hexa_str("hexa_void()");
    }
    HexaVal last = hexa_index_get(body, hexa_int((hexa_int(hexa_len(body))).i - (hexa_int(1)).i));
    if (hexa_truthy(hexa_eq(hexa_map_get(last, "kind"), hexa_str("ExprStmt")))) {
        return gen2_expr(hexa_map_get(last, "left"));
    }
    if (hexa_truthy(hexa_eq(hexa_map_get(last, "kind"), hexa_str("ReturnStmt")))) {
        if (hexa_truthy(hexa_bool(!hexa_truthy(hexa_eq(hexa_type_of(hexa_map_get(last, "left")), hexa_str("string")))))) {
            return gen2_expr(hexa_map_get(last, "left"));
        }
    }
    return hexa_str("hexa_void()");
    return hexa_void();
}


HexaVal _method_registry_lookup(HexaVal name) {
    HexaVal out = hexa_array_new();
    HexaVal i = hexa_int(0);
    while (hexa_truthy(hexa_bool((i).i < (hexa_int(hexa_len(_method_registry))).i))) {
        HexaVal e = hexa_index_get(_method_registry, i);
        if (hexa_truthy(hexa_eq(hexa_index_get(e, hexa_int(0)), name))) {
            out = hexa_array_push(out, hexa_index_get(e, hexa_int(1)));
        }
        i = hexa_add(i, hexa_int(1));
    }
    return out;
    return hexa_void();
}


HexaVal gen2_impl_block(HexaVal node) {
    HexaVal type_n = hexa_map_get(node, "target");
    HexaVal fwd_chunks = hexa_array_new();
    HexaVal fn_chunks = hexa_array_new();
    HexaVal methods = hexa_map_get(node, "methods");
    HexaVal mi = hexa_int(0);
    while (hexa_truthy(hexa_bool((mi).i < (hexa_int(hexa_len(methods))).i))) {
        HexaVal m = hexa_index_get(methods, mi);
        HexaVal mangled = hexa_add(hexa_add(type_n, hexa_str("__")), hexa_map_get(m, "name"));
        _method_registry = hexa_array_push(_method_registry, hexa_array_push(hexa_array_push(hexa_array_new(), hexa_map_get(m, "name")), type_n));
        HexaVal params = hexa_array_new();
        HexaVal pi = hexa_int(0);
        while (hexa_truthy(hexa_bool((pi).i < (hexa_int(hexa_len(hexa_map_get(m, "params")))).i))) {
            params = hexa_array_push(params, hexa_add(hexa_str("HexaVal "), hexa_map_get(hexa_index_get(hexa_map_get(m, "params"), pi), "name")));
            pi = hexa_add(pi, hexa_int(1));
        }
        HexaVal p = hexa_str_join(params, hexa_str(", "));
        if (hexa_truthy(hexa_eq(p, hexa_str("")))) {
            p = hexa_str("void");
        }
        fwd_chunks = hexa_array_push(fwd_chunks, hexa_add(hexa_add(hexa_add(hexa_add(hexa_str("HexaVal "), mangled), hexa_str("(")), p), hexa_str(");\n")));
        HexaVal body_chunks = hexa_array_new();
        body_chunks = hexa_array_push(body_chunks, hexa_add(hexa_add(hexa_add(hexa_add(hexa_str("HexaVal "), mangled), hexa_str("(")), p), hexa_str(") {\n")));
        HexaVal bi = hexa_int(0);
        while (hexa_truthy(hexa_bool((bi).i < (hexa_int(hexa_len(hexa_map_get(m, "body")))).i))) {
            body_chunks = hexa_array_push(body_chunks, gen2_stmt(hexa_index_get(hexa_map_get(m, "body"), bi), hexa_int(1)));
            bi = hexa_add(bi, hexa_int(1));
        }
        body_chunks = hexa_array_push(body_chunks, hexa_str("    return hexa_void();\n}\n\n"));
        fn_chunks = hexa_array_push(fn_chunks, hexa_str_join(body_chunks, hexa_str("")));
        mi = hexa_add(mi, hexa_int(1));
    }
    return hexa_map_set(hexa_map_set(hexa_map_new(), "forward", hexa_str_join(fwd_chunks, hexa_str(""))), "fn_code", hexa_str_join(fn_chunks, hexa_str("")));
    return hexa_void();
}


HexaVal _is_known_fn_global(HexaVal name) {
    HexaVal i = hexa_int(0);
    while (hexa_truthy(hexa_bool((i).i < (hexa_int(hexa_len(_known_fn_globals))).i))) {
        if (hexa_truthy(hexa_eq(hexa_index_get(_known_fn_globals, i), name))) {
            return hexa_bool(1);
        }
        i = hexa_add(i, hexa_int(1));
    }
    return hexa_bool(0);
    return hexa_void();
}


HexaVal _is_known_nonlocal(HexaVal name) {
    HexaVal i = hexa_int(0);
    while (hexa_truthy(hexa_bool((i).i < (hexa_int(hexa_len(_known_nonlocal_names))).i))) {
        if (hexa_truthy(hexa_eq(hexa_index_get(_known_nonlocal_names, i), name))) {
            return hexa_bool(1);
        }
        i = hexa_add(i, hexa_int(1));
    }
    return hexa_bool(0);
    return hexa_void();
}


HexaVal _is_known_global(HexaVal name) {
    return _is_known_nonlocal(name);
    return hexa_void();
}


HexaVal _is_builtin_name(HexaVal name) {
    if (hexa_truthy(hexa_eq(name, hexa_str("println")))) {
        return hexa_bool(1);
    }
    if (hexa_truthy(hexa_eq(name, hexa_str("print")))) {
        return hexa_bool(1);
    }
    if (hexa_truthy(hexa_eq(name, hexa_str("eprintln")))) {
        return hexa_bool(1);
    }
    if (hexa_truthy(hexa_eq(name, hexa_str("len")))) {
        return hexa_bool(1);
    }
    if (hexa_truthy(hexa_eq(name, hexa_str("to_string")))) {
        return hexa_bool(1);
    }
    if (hexa_truthy(hexa_eq(name, hexa_str("type_of")))) {
        return hexa_bool(1);
    }
    if (hexa_truthy(hexa_eq(name, hexa_str("sqrt")))) {
        return hexa_bool(1);
    }
    if (hexa_truthy(hexa_eq(name, hexa_str("floor")))) {
        return hexa_bool(1);
    }
    if (hexa_truthy(hexa_eq(name, hexa_str("ceil")))) {
        return hexa_bool(1);
    }
    if (hexa_truthy(hexa_eq(name, hexa_str("abs")))) {
        return hexa_bool(1);
    }
    if (hexa_truthy(hexa_eq(name, hexa_str("round")))) {
        return hexa_bool(1);
    }
    if (hexa_truthy(hexa_eq(name, hexa_str("ln")))) {
        return hexa_bool(1);
    }
    if (hexa_truthy(hexa_eq(name, hexa_str("log")))) {
        return hexa_bool(1);
    }
    if (hexa_truthy(hexa_eq(name, hexa_str("log10")))) {
        return hexa_bool(1);
    }
    if (hexa_truthy(hexa_eq(name, hexa_str("exp")))) {
        return hexa_bool(1);
    }
    if (hexa_truthy(hexa_eq(name, hexa_str("sin")))) {
        return hexa_bool(1);
    }
    if (hexa_truthy(hexa_eq(name, hexa_str("cos")))) {
        return hexa_bool(1);
    }
    if (hexa_truthy(hexa_eq(name, hexa_str("pow")))) {
        return hexa_bool(1);
    }
    if (hexa_truthy(hexa_eq(name, hexa_str("to_float")))) {
        return hexa_bool(1);
    }
    if (hexa_truthy(hexa_eq(name, hexa_str("to_int")))) {
        return hexa_bool(1);
    }
    if (hexa_truthy(hexa_eq(name, hexa_str("min")))) {
        return hexa_bool(1);
    }
    if (hexa_truthy(hexa_eq(name, hexa_str("max")))) {
        return hexa_bool(1);
    }
    if (hexa_truthy(hexa_eq(name, hexa_str("format")))) {
        return hexa_bool(1);
    }
    if (hexa_truthy(hexa_eq(name, hexa_str("args")))) {
        return hexa_bool(1);
    }
    if (hexa_truthy(hexa_eq(name, hexa_str("exec")))) {
        return hexa_bool(1);
    }
    if (hexa_truthy(hexa_eq(name, hexa_str("read_file")))) {
        return hexa_bool(1);
    }
    if (hexa_truthy(hexa_eq(name, hexa_str("write_file")))) {
        return hexa_bool(1);
    }
    if (hexa_truthy(hexa_eq(name, hexa_str("file_exists")))) {
        return hexa_bool(1);
    }
    if (hexa_truthy(hexa_eq(name, hexa_str("is_alpha")))) {
        return hexa_bool(1);
    }
    if (hexa_truthy(hexa_eq(name, hexa_str("is_digit")))) {
        return hexa_bool(1);
    }
    if (hexa_truthy(hexa_eq(name, hexa_str("is_alphanumeric")))) {
        return hexa_bool(1);
    }
    if (hexa_truthy(hexa_eq(name, hexa_str("true")))) {
        return hexa_bool(1);
    }
    if (hexa_truthy(hexa_eq(name, hexa_str("false")))) {
        return hexa_bool(1);
    }
    if (hexa_truthy(hexa_eq(name, hexa_str("env")))) {
        return hexa_bool(1);
    }
    if (hexa_truthy(hexa_eq(name, hexa_str("env_var")))) {
        return hexa_bool(1);
    }
    return hexa_bool(0);
    return hexa_void();
}


HexaVal _add_unique(HexaVal list, HexaVal name) {
    HexaVal i = hexa_int(0);
    while (hexa_truthy(hexa_bool((i).i < (hexa_int(hexa_len(list))).i))) {
        if (hexa_truthy(hexa_eq(hexa_index_get(list, i), name))) {
            return list;
        }
        i = hexa_add(i, hexa_int(1));
    }
    return hexa_array_push(list, name);
    return hexa_void();
}


HexaVal gen2_collect_free(HexaVal node, HexaVal bound, HexaVal out) {
    if (hexa_truthy(hexa_eq(hexa_type_of(node), hexa_str("string")))) {
        return out;
    }
    if (hexa_truthy(hexa_eq(hexa_type_of(node), hexa_str("array")))) {
        HexaVal local = bound;
        HexaVal result = out;
        HexaVal i = hexa_int(0);
        while (hexa_truthy(hexa_bool((i).i < (hexa_int(hexa_len(node))).i))) {
            HexaVal s = hexa_index_get(node, i);
            if (hexa_truthy(hexa_bool(!hexa_truthy(hexa_eq(hexa_type_of(s), hexa_str("string")))))) {
                HexaVal sk = hexa_map_get(s, "kind");
                if (hexa_truthy(hexa_bool(hexa_truthy(hexa_eq(sk, hexa_str("LetStmt"))) || hexa_truthy(hexa_eq(sk, hexa_str("LetMutStmt")))))) {
                    if (hexa_truthy(hexa_bool(!hexa_truthy(hexa_eq(hexa_type_of(hexa_map_get(s, "left")), hexa_str("string")))))) {
                        result = gen2_collect_free(hexa_map_get(s, "left"), local, result);
                    }
                    local = hexa_array_push(local, hexa_map_get(s, "name"));
                } else {
                    if (hexa_truthy(hexa_bool(hexa_truthy(hexa_eq(sk, hexa_str("ForStmt"))) || hexa_truthy(hexa_eq(sk, hexa_str("ForInStmt")))))) {
                        if (hexa_truthy(hexa_bool(!hexa_truthy(hexa_eq(hexa_type_of(hexa_map_get(s, "left")), hexa_str("string")))))) {
                            result = gen2_collect_free(hexa_map_get(s, "left"), local, result);
                        }
                        HexaVal body_local = hexa_array_push(local, hexa_map_get(s, "name"));
                        if (hexa_truthy(hexa_eq(hexa_type_of(hexa_map_get(s, "body")), hexa_str("array")))) {
                            result = gen2_collect_free(hexa_map_get(s, "body"), body_local, result);
                        }
                    } else {
                        result = gen2_collect_free(s, local, result);
                    }
                }
            }
            i = hexa_add(i, hexa_int(1));
        }
        return result;
    }
    HexaVal k = hexa_map_get(node, "kind");
    if (hexa_truthy(hexa_bool(hexa_truthy(hexa_bool(hexa_truthy(hexa_bool(hexa_truthy(hexa_bool(hexa_truthy(hexa_bool(hexa_truthy(hexa_eq(k, hexa_str("IntLit"))) || hexa_truthy(hexa_eq(k, hexa_str("FloatLit"))))) || hexa_truthy(hexa_eq(k, hexa_str("StringLit"))))) || hexa_truthy(hexa_eq(k, hexa_str("BoolLit"))))) || hexa_truthy(hexa_eq(k, hexa_str("CharLit"))))) || hexa_truthy(hexa_eq(k, hexa_str("Wildcard")))))) {
        return out;
    }
    if (hexa_truthy(hexa_eq(k, hexa_str("Ident")))) {
        HexaVal name = hexa_map_get(node, "name");
        if (hexa_truthy(_is_known_global(name))) {
            return out;
        }
        if (hexa_truthy(_is_builtin_name(name))) {
            return out;
        }
        HexaVal bi = hexa_int(0);
        while (hexa_truthy(hexa_bool((bi).i < (hexa_int(hexa_len(bound))).i))) {
            if (hexa_truthy(hexa_eq(hexa_index_get(bound, bi), name))) {
                return out;
            }
            bi = hexa_add(bi, hexa_int(1));
        }
        return _add_unique(out, name);
    }
    if (hexa_truthy(hexa_eq(k, hexa_str("Lambda")))) {
        HexaVal inner_bound = bound;
        HexaVal pi = hexa_int(0);
        while (hexa_truthy(hexa_bool((pi).i < (hexa_int(hexa_len(hexa_map_get(node, "params")))).i))) {
            inner_bound = hexa_array_push(inner_bound, hexa_index_get(hexa_map_get(node, "params"), pi));
            pi = hexa_add(pi, hexa_int(1));
        }
        return gen2_collect_free(hexa_map_get(node, "left"), inner_bound, out);
    }
    HexaVal result = out;
    if (hexa_truthy(hexa_bool(!hexa_truthy(hexa_eq(hexa_type_of(hexa_map_get(node, "left")), hexa_str("string")))))) {
        result = gen2_collect_free(hexa_map_get(node, "left"), bound, result);
    }
    if (hexa_truthy(hexa_bool(!hexa_truthy(hexa_eq(hexa_type_of(hexa_map_get(node, "right")), hexa_str("string")))))) {
        result = gen2_collect_free(hexa_map_get(node, "right"), bound, result);
    }
    if (hexa_truthy(hexa_bool(!hexa_truthy(hexa_eq(hexa_type_of(hexa_map_get(node, "cond")), hexa_str("string")))))) {
        result = gen2_collect_free(hexa_map_get(node, "cond"), bound, result);
    }
    if (hexa_truthy(hexa_bool(!hexa_truthy(hexa_eq(hexa_type_of(hexa_map_get(node, "then_body")), hexa_str("string")))))) {
        result = gen2_collect_free(hexa_map_get(node, "then_body"), bound, result);
    }
    if (hexa_truthy(hexa_bool(!hexa_truthy(hexa_eq(hexa_type_of(hexa_map_get(node, "else_body")), hexa_str("string")))))) {
        result = gen2_collect_free(hexa_map_get(node, "else_body"), bound, result);
    }
    if (hexa_truthy(hexa_bool(!hexa_truthy(hexa_eq(hexa_type_of(hexa_map_get(node, "body")), hexa_str("string")))))) {
        result = gen2_collect_free(hexa_map_get(node, "body"), bound, result);
    }
    if (hexa_truthy(hexa_eq(hexa_type_of(hexa_map_get(node, "args")), hexa_str("array")))) {
        HexaVal ai = hexa_int(0);
        while (hexa_truthy(hexa_bool((ai).i < (hexa_int(hexa_len(hexa_map_get(node, "args")))).i))) {
            result = gen2_collect_free(hexa_index_get(hexa_map_get(node, "args"), ai), bound, result);
            ai = hexa_add(ai, hexa_int(1));
        }
    }
    if (hexa_truthy(hexa_eq(hexa_type_of(hexa_map_get(node, "items")), hexa_str("array")))) {
        HexaVal ii = hexa_int(0);
        while (hexa_truthy(hexa_bool((ii).i < (hexa_int(hexa_len(hexa_map_get(node, "items")))).i))) {
            result = gen2_collect_free(hexa_index_get(hexa_map_get(node, "items"), ii), bound, result);
            ii = hexa_add(ii, hexa_int(1));
        }
    }
    if (hexa_truthy(hexa_eq(hexa_type_of(hexa_map_get(node, "arms")), hexa_str("array")))) {
        HexaVal mi = hexa_int(0);
        while (hexa_truthy(hexa_bool((mi).i < (hexa_int(hexa_len(hexa_map_get(node, "arms")))).i))) {
            HexaVal arm = hexa_index_get(hexa_map_get(node, "arms"), mi);
            if (hexa_truthy(hexa_eq(hexa_type_of(hexa_map_get(arm, "body")), hexa_str("array")))) {
                result = gen2_collect_free(hexa_map_get(arm, "body"), bound, result);
            }
            mi = hexa_add(mi, hexa_int(1));
        }
    }
    return result;
    return hexa_void();
}


HexaVal gen2_lambda_expr(HexaVal node) {
    HexaVal id = _lambda_counter;
    _lambda_counter = hexa_add(_lambda_counter, hexa_int(1));
    HexaVal fn_name = hexa_add(hexa_str("__hexa_lambda_"), hexa_to_string(id));
    HexaVal bound = hexa_array_new();
    HexaVal pi = hexa_int(0);
    while (hexa_truthy(hexa_bool((pi).i < (hexa_int(hexa_len(hexa_map_get(node, "params")))).i))) {
        bound = hexa_array_push(bound, hexa_index_get(hexa_map_get(node, "params"), pi));
        pi = hexa_add(pi, hexa_int(1));
    }
    HexaVal free_vars = gen2_collect_free(hexa_map_get(node, "left"), bound, hexa_array_new());
    HexaVal arity = hexa_int(hexa_len(hexa_map_get(node, "params")));
    HexaVal params = hexa_array_new();
    params = hexa_array_push(params, hexa_str("HexaVal __env"));
    pi = hexa_int(0);
    while (hexa_truthy(hexa_bool((pi).i < (hexa_int(hexa_len(hexa_map_get(node, "params")))).i))) {
        params = hexa_array_push(params, hexa_add(hexa_str("HexaVal "), hexa_index_get(hexa_map_get(node, "params"), pi)));
        pi = hexa_add(pi, hexa_int(1));
    }
    HexaVal p = hexa_str_join(params, hexa_str(", "));
    if (hexa_truthy(hexa_eq(p, hexa_str("")))) {
        p = hexa_str("void");
    }
    HexaVal body_parts = hexa_array_new();
    if (hexa_truthy(hexa_bool((hexa_int(hexa_len(free_vars))).i > (hexa_int(0)).i))) {
        HexaVal fi = hexa_int(0);
        while (hexa_truthy(hexa_bool((fi).i < (hexa_int(hexa_len(free_vars))).i))) {
            body_parts = hexa_array_push(body_parts, hexa_add(hexa_add(hexa_add(hexa_add(hexa_str("    HexaVal "), hexa_index_get(free_vars, fi)), hexa_str(" = hexa_array_get(__env, ")), hexa_to_string(fi)), hexa_str(");\n")));
            fi = hexa_add(fi, hexa_int(1));
        }
    }
    HexaVal lbody = hexa_map_get(node, "left");
    if (hexa_truthy(hexa_bool(!hexa_truthy(hexa_eq(hexa_type_of(lbody), hexa_str("string")))))) {
        if (hexa_truthy(hexa_eq(hexa_type_of(lbody), hexa_str("array")))) {
            HexaVal bi = hexa_int(0);
            while (hexa_truthy(hexa_bool((bi).i < (hexa_int(hexa_len(lbody))).i))) {
                body_parts = hexa_array_push(body_parts, gen2_stmt(hexa_index_get(lbody, bi), hexa_int(1)));
                bi = hexa_add(bi, hexa_int(1));
            }
        } else {
            body_parts = hexa_array_push(body_parts, hexa_add(hexa_add(hexa_str("    return "), gen2_expr(lbody)), hexa_str(";\n")));
        }
    }
    HexaVal fn_def = hexa_add(hexa_add(hexa_add(hexa_add(hexa_add(hexa_add(hexa_str("HexaVal "), fn_name), hexa_str("(")), p), hexa_str(") {\n")), hexa_str_join(body_parts, hexa_str(""))), hexa_str("    return hexa_void();\n}\n\n"));
    _lambda_def_parts = hexa_array_push(_lambda_def_parts, fn_def);
    if (hexa_truthy(hexa_eq(hexa_int(hexa_len(free_vars)), hexa_int(0)))) {
        return hexa_add(hexa_add(hexa_add(hexa_add(hexa_str("hexa_closure_new((void*)&"), fn_name), hexa_str(", ")), hexa_to_string(arity)), hexa_str(", hexa_array_new())"));
    }
    HexaVal env_expr = hexa_str("hexa_array_new()");
    HexaVal fi = hexa_int(0);
    while (hexa_truthy(hexa_bool((fi).i < (hexa_int(hexa_len(free_vars))).i))) {
        env_expr = hexa_add(hexa_add(hexa_add(hexa_add(hexa_str("hexa_array_push("), env_expr), hexa_str(", ")), hexa_index_get(free_vars, fi)), hexa_str(")"));
        fi = hexa_add(fi, hexa_int(1));
    }
    return hexa_add(hexa_add(hexa_add(hexa_add(hexa_add(hexa_add(hexa_str("hexa_closure_new((void*)&"), fn_name), hexa_str(", ")), hexa_to_string(arity)), hexa_str(", ")), env_expr), hexa_str(")"));
    return hexa_void();
}


HexaVal codegen_c2_full(HexaVal ast) {
    _lambda_counter = hexa_int(0);
    _lambda_def_parts = hexa_array_new();
    _method_registry = hexa_array_new();
    _known_fn_globals = hexa_array_new();
    _known_nonlocal_names = hexa_array_new();
    HexaVal gi = hexa_int(0);
    while (hexa_truthy(hexa_bool((gi).i < (hexa_int(hexa_len(ast))).i))) {
        HexaVal gk = hexa_map_get(hexa_index_get(ast, gi), "kind");
        if (hexa_truthy(hexa_bool(hexa_truthy(hexa_bool(hexa_truthy(hexa_bool(hexa_truthy(hexa_eq(gk, hexa_str("FnDecl"))) || hexa_truthy(hexa_eq(gk, hexa_str("ExternFnDecl"))))) || hexa_truthy(hexa_eq(gk, hexa_str("PureFnDecl"))))) || hexa_truthy(hexa_eq(gk, hexa_str("OptimizeFnStmt")))))) {
            _known_fn_globals = hexa_array_push(_known_fn_globals, hexa_map_get(hexa_index_get(ast, gi), "name"));
            _known_nonlocal_names = hexa_array_push(_known_nonlocal_names, hexa_map_get(hexa_index_get(ast, gi), "name"));
        } else {
            if (hexa_truthy(hexa_eq(gk, hexa_str("StructDecl")))) {
                _known_fn_globals = hexa_array_push(_known_fn_globals, hexa_map_get(hexa_index_get(ast, gi), "name"));
                _known_nonlocal_names = hexa_array_push(_known_nonlocal_names, hexa_map_get(hexa_index_get(ast, gi), "name"));
            } else {
                if (hexa_truthy(hexa_eq(gk, hexa_str("EnumDecl")))) {
                    _known_nonlocal_names = hexa_array_push(_known_nonlocal_names, hexa_map_get(hexa_index_get(ast, gi), "name"));
                } else {
                    if (hexa_truthy(hexa_eq(gk, hexa_str("ComptimeConst")))) {
                        _known_nonlocal_names = hexa_array_push(_known_nonlocal_names, hexa_map_get(hexa_index_get(ast, gi), "name"));
                    } else {
                        if (hexa_truthy(hexa_bool(hexa_truthy(hexa_eq(gk, hexa_str("LetMutStmt"))) || hexa_truthy(hexa_eq(gk, hexa_str("LetStmt")))))) {
                            _known_nonlocal_names = hexa_array_push(_known_nonlocal_names, hexa_map_get(hexa_index_get(ast, gi), "name"));
                        }
                    }
                }
            }
        }
        gi = hexa_add(gi, hexa_int(1));
    }
    HexaVal fwd_parts = hexa_array_new();
    HexaVal global_parts = hexa_array_new();
    HexaVal fn_parts = hexa_array_new();
    HexaVal main_parts = hexa_array_new();
    HexaVal i = hexa_int(0);
    while (hexa_truthy(hexa_bool((i).i < (hexa_int(hexa_len(ast))).i))) {
        HexaVal k = hexa_map_get(hexa_index_get(ast, i), "kind");
        if (hexa_truthy(hexa_eq(k, hexa_str("FnDecl")))) {
            fwd_parts = hexa_array_push(fwd_parts, hexa_add(gen2_fn_forward(hexa_index_get(ast, i)), hexa_str("\n")));
            fn_parts = hexa_array_push(fn_parts, hexa_add(gen2_fn_decl(hexa_index_get(ast, i)), hexa_str("\n\n")));
        } else {
            if (hexa_truthy(hexa_eq(k, hexa_str("ExternFnDecl")))) {
                HexaVal ew = gen2_extern_wrapper(hexa_index_get(ast, i));
                global_parts = hexa_array_push(global_parts, hexa_map_get(ew, "global"));
                fwd_parts = hexa_array_push(fwd_parts, hexa_add(hexa_map_get(ew, "forward"), hexa_str("\n")));
                fn_parts = hexa_array_push(fn_parts, hexa_add(hexa_map_get(ew, "fn_code"), hexa_str("\n\n")));
                main_parts = hexa_array_push(main_parts, hexa_map_get(ew, "init"));
            } else {
                if (hexa_truthy(hexa_eq(k, hexa_str("StructDecl")))) {
                    fn_parts = hexa_array_push(fn_parts, hexa_add(gen2_struct_decl(hexa_index_get(ast, i)), hexa_str("\n\n")));
                } else {
                    if (hexa_truthy(hexa_eq(k, hexa_str("EnumDecl")))) {
                        fn_parts = hexa_array_push(fn_parts, hexa_add(gen2_enum_decl(hexa_index_get(ast, i)), hexa_str("\n")));
                    } else {
                        if (hexa_truthy(hexa_eq(k, hexa_str("ImplBlock")))) {
                            HexaVal ib = gen2_impl_block(hexa_index_get(ast, i));
                            fwd_parts = hexa_array_push(fwd_parts, hexa_map_get(ib, "forward"));
                            fn_parts = hexa_array_push(fn_parts, hexa_map_get(ib, "fn_code"));
                        } else {
                            if (hexa_truthy(hexa_eq(k, hexa_str("TraitDecl")))) {
                            } else {
                                if (hexa_truthy(hexa_eq(k, hexa_str("LetMutStmt")))) {
                                    global_parts = hexa_array_push(global_parts, hexa_add(hexa_add(hexa_str("HexaVal "), hexa_map_get(hexa_index_get(ast, i), "name")), hexa_str(";\n")));
                                    if (hexa_truthy(hexa_bool(!hexa_truthy(hexa_eq(hexa_type_of(hexa_map_get(hexa_index_get(ast, i), "left")), hexa_str("string")))))) {
                                        main_parts = hexa_array_push(main_parts, hexa_add(hexa_add(hexa_add(hexa_add(hexa_str("    "), hexa_map_get(hexa_index_get(ast, i), "name")), hexa_str(" = ")), gen2_expr(hexa_map_get(hexa_index_get(ast, i), "left"))), hexa_str(";\n")));
                                    } else {
                                        main_parts = hexa_array_push(main_parts, hexa_add(hexa_add(hexa_str("    "), hexa_map_get(hexa_index_get(ast, i), "name")), hexa_str(" = hexa_void();\n")));
                                    }
                                } else {
                                    main_parts = hexa_array_push(main_parts, gen2_stmt(hexa_index_get(ast, i), hexa_int(1)));
                                }
                            }
                        }
                    }
                }
            }
        }
        i = hexa_add(i, hexa_int(1));
    }
    HexaVal out_parts = hexa_array_new();
    out_parts = hexa_array_push(out_parts, hexa_str("// Generated by HEXA self-host compiler\n"));
    out_parts = hexa_array_push(out_parts, hexa_str("#include \"runtime.c\"\n\n"));
    out_parts = hexa_array_push(out_parts, hexa_str_join(fwd_parts, hexa_str("")));
    out_parts = hexa_array_push(out_parts, hexa_str("\n"));
    out_parts = hexa_array_push(out_parts, hexa_str_join(global_parts, hexa_str("")));
    out_parts = hexa_array_push(out_parts, hexa_str("\n"));
    out_parts = hexa_array_push(out_parts, hexa_str_join(_lambda_def_parts, hexa_str("")));
    out_parts = hexa_array_push(out_parts, hexa_str_join(fn_parts, hexa_str("")));
    out_parts = hexa_array_push(out_parts, hexa_str("int main() {\n"));
    out_parts = hexa_array_push(out_parts, hexa_str_join(main_parts, hexa_str("")));
    out_parts = hexa_array_push(out_parts, hexa_str("    return 0;\n}\n"));
    return hexa_str_join(out_parts, hexa_str(""));
    return hexa_void();
}


int main() {
    _method_registry = hexa_array_new();
    _lambda_counter = hexa_int(0);
    _lambda_def_parts = hexa_array_new();
    _known_fn_globals = hexa_array_new();
    _known_nonlocal_names = hexa_array_new();
    hexa_println(hexa_str("=== HEXA → C (HexaVal runtime) Code Generator ==="));
    return 0;
}
