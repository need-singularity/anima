// Generated by HEXA self-host compiler
#include "runtime.c"

HexaVal empty_node(void);
HexaVal node_int_lit(HexaVal val);
HexaVal node_float_lit(HexaVal val);
HexaVal node_bool_lit(HexaVal val);
HexaVal node_string_lit(HexaVal val);
HexaVal node_char_lit(HexaVal val);
HexaVal node_ident(HexaVal name);
HexaVal node_wildcard(void);
HexaVal p_record_error(HexaVal line, HexaVal col, HexaVal message);
HexaVal p_synchronize(void);
HexaVal p_get_errors(void);
HexaVal p_has_errors(void);
HexaVal p_error_count(void);
HexaVal p_format_errors(void);
HexaVal p_peek(void);
HexaVal p_peek_kind(void);
HexaVal p_peek_ahead(HexaVal offset);
HexaVal p_at_end(void);
HexaVal p_advance(void);
HexaVal p_check(HexaVal expected_kind);
HexaVal p_expect(HexaVal expected_kind);
HexaVal p_expect_ident(void);
HexaVal p_skip_newlines(void);
HexaVal parse(HexaVal tokens);
HexaVal parse_strict(HexaVal tokens);
HexaVal parse_stmt(void);
HexaVal parse_let(void);
HexaVal parse_const(void);
HexaVal parse_static(void);
HexaVal parse_return(void);
HexaVal parse_proof_stmt(void);
HexaVal parse_assert_stmt(void);
HexaVal parse_use_decl(void);
HexaVal parse_mod_decl(void);
HexaVal parse_fn_decl(void);
HexaVal parse_type_annotation(void);
HexaVal parse_params(void);
HexaVal parse_struct_decl(void);
HexaVal parse_enum_decl(void);
HexaVal parse_trait_decl(void);
HexaVal parse_impl_block(void);
HexaVal parse_for_stmt(void);
HexaVal parse_while_stmt(void);
HexaVal parse_loop_stmt(void);
HexaVal parse_if_expr(void);
HexaVal parse_match_expr(void);
HexaVal parse_match_pattern(void);
HexaVal parse_block(void);
HexaVal parse_expr(void);
HexaVal parse_null_coal(void);
HexaVal parse_or(void);
HexaVal parse_and(void);
HexaVal parse_comparison(void);
HexaVal parse_addition(void);
HexaVal parse_multiplication(void);
HexaVal parse_unary(void);
HexaVal parse_postfix(void);
HexaVal parse_args(void);
HexaVal parse_primary(void);
HexaVal parse_try_catch(void);
HexaVal parse_throw_stmt(void);
HexaVal parse_panic_stmt(void);
HexaVal parse_recover_stmt(void);
HexaVal parse_drop_stmt(void);
HexaVal parse_spawn_stmt(void);
HexaVal parse_scope_stmt(void);
HexaVal parse_select_stmt(void);
HexaVal parse_async_fn(void);
HexaVal parse_attribute_prefix(void);
HexaVal parse_extern_fn(void);
HexaVal parse_type_alias(void);
HexaVal parse_atomic_let(void);
HexaVal parse_break_stmt(void);
HexaVal parse_continue_stmt(void);
HexaVal parse_yield_stmt(void);
HexaVal parse_comptime_stmt(void);
HexaVal parse_intent_stmt(void);
HexaVal parse_verify_stmt(void);
HexaVal parse_generate_stmt(void);
HexaVal parse_optimize_stmt(void);
HexaVal parse_effect_decl(void);
HexaVal parse_pure_fn(void);
HexaVal parse_macro_def(void);
HexaVal parse_derive_decl(void);
HexaVal parse_theorem_stmt(void);
HexaVal parse_handle_stmt(void);
HexaVal parse_visibility(void);
HexaVal parse_type_params(void);
HexaVal parse_where_clauses(void);
HexaVal ast_to_string(HexaVal node, HexaVal indent);
HexaVal print_ast(HexaVal stmts);
HexaVal is_keyword(HexaVal word);
HexaVal keyword_kind(HexaVal word);
HexaVal is_ident_start(HexaVal ch);
HexaVal is_ident_char(HexaVal ch);
HexaVal tokenize(HexaVal source);

HexaVal p_tokens;
HexaVal p_pos;
HexaVal p_pending_symbol;
HexaVal p_pending_link;
HexaVal p_pending_attrs;
HexaVal p_errors;
HexaVal p_max_errors;

HexaVal Token(HexaVal kind, HexaVal value, HexaVal line, HexaVal col) {
    HexaVal __s = hexa_map_new();
    __s = hexa_map_set(__s, "__type__", hexa_str("Token"));
    __s = hexa_map_set(__s, "kind", kind);
    __s = hexa_map_set(__s, "value", value);
    __s = hexa_map_set(__s, "line", line);
    __s = hexa_map_set(__s, "col", col);
    return __s;
}


HexaVal empty_node(void) {
    return hexa_map_set(hexa_map_set(hexa_map_set(hexa_map_set(hexa_map_set(hexa_map_set(hexa_map_set(hexa_map_set(hexa_map_set(hexa_map_set(hexa_map_set(hexa_map_set(hexa_map_set(hexa_map_set(hexa_map_set(hexa_map_set(hexa_map_set(hexa_map_set(hexa_map_set(hexa_map_set(hexa_map_set(hexa_map_new(), "kind", hexa_str("")), "name", hexa_str("")), "value", hexa_str("")), "op", hexa_str("")), "left", hexa_str("")), "right", hexa_str("")), "cond", hexa_str("")), "then_body", hexa_str("")), "else_body", hexa_str("")), "params", hexa_str("")), "body", hexa_str("")), "args", hexa_str("")), "fields", hexa_str("")), "items", hexa_str("")), "variants", hexa_str("")), "arms", hexa_str("")), "iter_expr", hexa_str("")), "ret_type", hexa_str("")), "target", hexa_str("")), "trait_name", hexa_str("")), "methods", hexa_str(""));
    return hexa_void();
}


HexaVal node_int_lit(HexaVal val) {
    HexaVal n = empty_node();
    return hexa_map_set(hexa_map_set(hexa_map_set(hexa_map_set(hexa_map_set(hexa_map_set(hexa_map_set(hexa_map_set(hexa_map_set(hexa_map_set(hexa_map_set(hexa_map_set(hexa_map_set(hexa_map_set(hexa_map_set(hexa_map_set(hexa_map_set(hexa_map_set(hexa_map_set(hexa_map_set(hexa_map_set(hexa_map_new(), "kind", hexa_str("IntLit")), "name", hexa_str("")), "value", val), "op", hexa_str("")), "left", hexa_str("")), "right", hexa_str("")), "cond", hexa_str("")), "then_body", hexa_str("")), "else_body", hexa_str("")), "params", hexa_str("")), "body", hexa_str("")), "args", hexa_str("")), "fields", hexa_str("")), "items", hexa_str("")), "variants", hexa_str("")), "arms", hexa_str("")), "iter_expr", hexa_str("")), "ret_type", hexa_str("")), "target", hexa_str("")), "trait_name", hexa_str("")), "methods", hexa_str(""));
    return hexa_void();
}


HexaVal node_float_lit(HexaVal val) {
    return hexa_map_set(hexa_map_set(hexa_map_set(hexa_map_set(hexa_map_set(hexa_map_set(hexa_map_set(hexa_map_set(hexa_map_set(hexa_map_set(hexa_map_set(hexa_map_set(hexa_map_set(hexa_map_set(hexa_map_set(hexa_map_set(hexa_map_set(hexa_map_set(hexa_map_set(hexa_map_set(hexa_map_set(hexa_map_new(), "kind", hexa_str("FloatLit")), "name", hexa_str("")), "value", val), "op", hexa_str("")), "left", hexa_str("")), "right", hexa_str("")), "cond", hexa_str("")), "then_body", hexa_str("")), "else_body", hexa_str("")), "params", hexa_str("")), "body", hexa_str("")), "args", hexa_str("")), "fields", hexa_str("")), "items", hexa_str("")), "variants", hexa_str("")), "arms", hexa_str("")), "iter_expr", hexa_str("")), "ret_type", hexa_str("")), "target", hexa_str("")), "trait_name", hexa_str("")), "methods", hexa_str(""));
    return hexa_void();
}


HexaVal node_bool_lit(HexaVal val) {
    return hexa_map_set(hexa_map_set(hexa_map_set(hexa_map_set(hexa_map_set(hexa_map_set(hexa_map_set(hexa_map_set(hexa_map_set(hexa_map_set(hexa_map_set(hexa_map_set(hexa_map_set(hexa_map_set(hexa_map_set(hexa_map_set(hexa_map_set(hexa_map_set(hexa_map_set(hexa_map_set(hexa_map_set(hexa_map_new(), "kind", hexa_str("BoolLit")), "name", hexa_str("")), "value", val), "op", hexa_str("")), "left", hexa_str("")), "right", hexa_str("")), "cond", hexa_str("")), "then_body", hexa_str("")), "else_body", hexa_str("")), "params", hexa_str("")), "body", hexa_str("")), "args", hexa_str("")), "fields", hexa_str("")), "items", hexa_str("")), "variants", hexa_str("")), "arms", hexa_str("")), "iter_expr", hexa_str("")), "ret_type", hexa_str("")), "target", hexa_str("")), "trait_name", hexa_str("")), "methods", hexa_str(""));
    return hexa_void();
}


HexaVal node_string_lit(HexaVal val) {
    return hexa_map_set(hexa_map_set(hexa_map_set(hexa_map_set(hexa_map_set(hexa_map_set(hexa_map_set(hexa_map_set(hexa_map_set(hexa_map_set(hexa_map_set(hexa_map_set(hexa_map_set(hexa_map_set(hexa_map_set(hexa_map_set(hexa_map_set(hexa_map_set(hexa_map_set(hexa_map_set(hexa_map_set(hexa_map_new(), "kind", hexa_str("StringLit")), "name", hexa_str("")), "value", val), "op", hexa_str("")), "left", hexa_str("")), "right", hexa_str("")), "cond", hexa_str("")), "then_body", hexa_str("")), "else_body", hexa_str("")), "params", hexa_str("")), "body", hexa_str("")), "args", hexa_str("")), "fields", hexa_str("")), "items", hexa_str("")), "variants", hexa_str("")), "arms", hexa_str("")), "iter_expr", hexa_str("")), "ret_type", hexa_str("")), "target", hexa_str("")), "trait_name", hexa_str("")), "methods", hexa_str(""));
    return hexa_void();
}


HexaVal node_char_lit(HexaVal val) {
    return hexa_map_set(hexa_map_set(hexa_map_set(hexa_map_set(hexa_map_set(hexa_map_set(hexa_map_set(hexa_map_set(hexa_map_set(hexa_map_set(hexa_map_set(hexa_map_set(hexa_map_set(hexa_map_set(hexa_map_set(hexa_map_set(hexa_map_set(hexa_map_set(hexa_map_set(hexa_map_set(hexa_map_set(hexa_map_new(), "kind", hexa_str("CharLit")), "name", hexa_str("")), "value", val), "op", hexa_str("")), "left", hexa_str("")), "right", hexa_str("")), "cond", hexa_str("")), "then_body", hexa_str("")), "else_body", hexa_str("")), "params", hexa_str("")), "body", hexa_str("")), "args", hexa_str("")), "fields", hexa_str("")), "items", hexa_str("")), "variants", hexa_str("")), "arms", hexa_str("")), "iter_expr", hexa_str("")), "ret_type", hexa_str("")), "target", hexa_str("")), "trait_name", hexa_str("")), "methods", hexa_str(""));
    return hexa_void();
}


HexaVal node_ident(HexaVal name) {
    return hexa_map_set(hexa_map_set(hexa_map_set(hexa_map_set(hexa_map_set(hexa_map_set(hexa_map_set(hexa_map_set(hexa_map_set(hexa_map_set(hexa_map_set(hexa_map_set(hexa_map_set(hexa_map_set(hexa_map_set(hexa_map_set(hexa_map_set(hexa_map_set(hexa_map_set(hexa_map_set(hexa_map_set(hexa_map_new(), "kind", hexa_str("Ident")), "name", name), "value", hexa_str("")), "op", hexa_str("")), "left", hexa_str("")), "right", hexa_str("")), "cond", hexa_str("")), "then_body", hexa_str("")), "else_body", hexa_str("")), "params", hexa_str("")), "body", hexa_str("")), "args", hexa_str("")), "fields", hexa_str("")), "items", hexa_str("")), "variants", hexa_str("")), "arms", hexa_str("")), "iter_expr", hexa_str("")), "ret_type", hexa_str("")), "target", hexa_str("")), "trait_name", hexa_str("")), "methods", hexa_str(""));
    return hexa_void();
}


HexaVal node_wildcard(void) {
    return hexa_map_set(hexa_map_set(hexa_map_set(hexa_map_set(hexa_map_set(hexa_map_set(hexa_map_set(hexa_map_set(hexa_map_set(hexa_map_set(hexa_map_set(hexa_map_set(hexa_map_set(hexa_map_set(hexa_map_set(hexa_map_set(hexa_map_set(hexa_map_set(hexa_map_set(hexa_map_set(hexa_map_set(hexa_map_new(), "kind", hexa_str("Wildcard")), "name", hexa_str("_")), "value", hexa_str("")), "op", hexa_str("")), "left", hexa_str("")), "right", hexa_str("")), "cond", hexa_str("")), "then_body", hexa_str("")), "else_body", hexa_str("")), "params", hexa_str("")), "body", hexa_str("")), "args", hexa_str("")), "fields", hexa_str("")), "items", hexa_str("")), "variants", hexa_str("")), "arms", hexa_str("")), "iter_expr", hexa_str("")), "ret_type", hexa_str("")), "target", hexa_str("")), "trait_name", hexa_str("")), "methods", hexa_str(""));
    return hexa_void();
}


HexaVal p_record_error(HexaVal line, HexaVal col, HexaVal message) {
    if (hexa_truthy(hexa_bool((hexa_int(hexa_len(p_errors))).i < (p_max_errors).i))) {
        p_errors = hexa_array_push(p_errors, hexa_map_set(hexa_map_set(hexa_map_set(hexa_map_new(), "line", line), "col", col), "message", message));
    }
    return hexa_void();
}


HexaVal p_synchronize(void) {
    while (hexa_truthy(hexa_bool(!hexa_truthy(p_at_end())))) {
        HexaVal cur = p_peek();
        if (hexa_truthy(hexa_eq(hexa_map_get(cur, "kind"), hexa_str("Newline")))) {
            p_advance();
            HexaVal next = p_peek();
            if (hexa_truthy(hexa_eq(hexa_map_get(next, "kind"), hexa_str("Let")))) {
                return hexa_bool(1);
            }
            if (hexa_truthy(hexa_eq(hexa_map_get(next, "kind"), hexa_str("Const")))) {
                return hexa_bool(1);
            }
            if (hexa_truthy(hexa_eq(hexa_map_get(next, "kind"), hexa_str("Static")))) {
                return hexa_bool(1);
            }
            if (hexa_truthy(hexa_eq(hexa_map_get(next, "kind"), hexa_str("Fn")))) {
                return hexa_bool(1);
            }
            if (hexa_truthy(hexa_eq(hexa_map_get(next, "kind"), hexa_str("Struct")))) {
                return hexa_bool(1);
            }
            if (hexa_truthy(hexa_eq(hexa_map_get(next, "kind"), hexa_str("Enum")))) {
                return hexa_bool(1);
            }
            if (hexa_truthy(hexa_eq(hexa_map_get(next, "kind"), hexa_str("For")))) {
                return hexa_bool(1);
            }
            if (hexa_truthy(hexa_eq(hexa_map_get(next, "kind"), hexa_str("While")))) {
                return hexa_bool(1);
            }
            if (hexa_truthy(hexa_eq(hexa_map_get(next, "kind"), hexa_str("Loop")))) {
                return hexa_bool(1);
            }
            if (hexa_truthy(hexa_eq(hexa_map_get(next, "kind"), hexa_str("Return")))) {
                return hexa_bool(1);
            }
            if (hexa_truthy(hexa_eq(hexa_map_get(next, "kind"), hexa_str("If")))) {
                return hexa_bool(1);
            }
            if (hexa_truthy(hexa_eq(hexa_map_get(next, "kind"), hexa_str("Match")))) {
                return hexa_bool(1);
            }
            if (hexa_truthy(hexa_eq(hexa_map_get(next, "kind"), hexa_str("Impl")))) {
                return hexa_bool(1);
            }
            if (hexa_truthy(hexa_eq(hexa_map_get(next, "kind"), hexa_str("Trait")))) {
                return hexa_bool(1);
            }
            if (hexa_truthy(hexa_eq(hexa_map_get(next, "kind"), hexa_str("Use")))) {
                return hexa_bool(1);
            }
            if (hexa_truthy(hexa_eq(hexa_map_get(next, "kind"), hexa_str("Mod")))) {
                return hexa_bool(1);
            }
            if (hexa_truthy(hexa_eq(hexa_map_get(next, "kind"), hexa_str("Try")))) {
                return hexa_bool(1);
            }
            if (hexa_truthy(hexa_eq(hexa_map_get(next, "kind"), hexa_str("Assert")))) {
                return hexa_bool(1);
            }
            if (hexa_truthy(hexa_eq(hexa_map_get(next, "kind"), hexa_str("Proof")))) {
                return hexa_bool(1);
            }
            if (hexa_truthy(hexa_eq(hexa_map_get(next, "kind"), hexa_str("At")))) {
                return hexa_bool(1);
            }
            if (hexa_truthy(hexa_eq(hexa_map_get(next, "kind"), hexa_str("Eof")))) {
                return hexa_bool(1);
            }
        } else {
            p_advance();
        }
    }
    return hexa_bool(0);
    return hexa_void();
}


HexaVal p_get_errors(void) {
    return p_errors;
    return hexa_void();
}


HexaVal p_has_errors(void) {
    return hexa_bool((hexa_int(hexa_len(p_errors))).i > (hexa_int(0)).i);
    return hexa_void();
}


HexaVal p_error_count(void) {
    return hexa_int(hexa_len(p_errors));
    return hexa_void();
}


HexaVal p_format_errors(void) {
    HexaVal lines = hexa_array_new();
    HexaVal i = hexa_int(0);
    while (hexa_truthy(hexa_bool((i).i < (hexa_int(hexa_len(p_errors))).i))) {
        HexaVal e = hexa_index_get(p_errors, i);
        lines = hexa_array_push(lines, hexa_add(hexa_add(hexa_add(hexa_add(hexa_add(hexa_add(hexa_add(hexa_str("  error["), hexa_to_string(hexa_add(i, hexa_int(1)))), hexa_str("] ")), hexa_to_string(hexa_map_get(e, "line"))), hexa_str(":")), hexa_to_string(hexa_map_get(e, "col"))), hexa_str(" — ")), hexa_map_get(e, "message")));
        i = hexa_add(i, hexa_int(1));
    }
    return hexa_str_join(lines, hexa_str("\n"));
    return hexa_void();
}


HexaVal p_peek(void) {
    if (hexa_truthy(hexa_bool((p_pos).i >= (hexa_int(hexa_len(p_tokens))).i))) {
        return Token(hexa_str("Eof"), hexa_str(""), hexa_int(0), hexa_int(0));
    }
    return hexa_index_get(p_tokens, p_pos);
    return hexa_void();
}


HexaVal p_peek_kind(void) {
    return hexa_map_get(p_peek(), "kind");
    return hexa_void();
}


HexaVal p_peek_ahead(HexaVal offset) {
    HexaVal idx = hexa_add(p_pos, offset);
    if (hexa_truthy(hexa_bool((idx).i >= (hexa_int(hexa_len(p_tokens))).i))) {
        return Token(hexa_str("Eof"), hexa_str(""), hexa_int(0), hexa_int(0));
    }
    return hexa_index_get(p_tokens, idx);
    return hexa_void();
}


HexaVal p_at_end(void) {
    return hexa_eq(p_peek_kind(), hexa_str("Eof"));
    return hexa_void();
}


HexaVal p_advance(void) {
    HexaVal tok = p_peek();
    p_pos = hexa_add(p_pos, hexa_int(1));
    return tok;
    return hexa_void();
}


HexaVal p_check(HexaVal expected_kind) {
    return hexa_eq(p_peek_kind(), expected_kind);
    return hexa_void();
}


HexaVal p_expect(HexaVal expected_kind) {
    if (hexa_truthy(p_check(expected_kind))) {
        return p_advance();
    }
    HexaVal tok = p_peek();
    HexaVal msg = hexa_add(hexa_add(hexa_add(hexa_add(hexa_add(hexa_add(hexa_str("expected "), expected_kind), hexa_str(", got ")), hexa_map_get(tok, "kind")), hexa_str(" ('")), hexa_map_get(tok, "value")), hexa_str("')"));
    p_record_error(hexa_map_get(tok, "line"), hexa_map_get(tok, "col"), msg);
    hexa_println(hexa_add(hexa_add(hexa_add(hexa_add(hexa_add(hexa_str("Parse error at "), hexa_to_string(hexa_map_get(tok, "line"))), hexa_str(":")), hexa_to_string(hexa_map_get(tok, "col"))), hexa_str(": ")), msg));
    return tok;
    return hexa_void();
}


HexaVal p_expect_ident(void) {
    HexaVal tok = p_peek();
    if (hexa_truthy(hexa_eq(hexa_map_get(tok, "kind"), hexa_str("Ident")))) {
        p_pos = hexa_add(p_pos, hexa_int(1));
        return hexa_map_get(tok, "value");
    }
    HexaVal msg2 = hexa_add(hexa_add(hexa_add(hexa_add(hexa_str("expected identifier, got "), hexa_map_get(tok, "kind")), hexa_str(" ('")), hexa_map_get(tok, "value")), hexa_str("')"));
    p_record_error(hexa_map_get(tok, "line"), hexa_map_get(tok, "col"), msg2);
    hexa_println(hexa_add(hexa_add(hexa_add(hexa_add(hexa_add(hexa_str("Parse error at "), hexa_to_string(hexa_map_get(tok, "line"))), hexa_str(":")), hexa_to_string(hexa_map_get(tok, "col"))), hexa_str(": ")), msg2));
    return hexa_str("");
    return hexa_void();
}


HexaVal p_skip_newlines(void) {
    while (hexa_truthy(hexa_eq(p_peek_kind(), hexa_str("Newline")))) {
        p_pos = hexa_add(p_pos, hexa_int(1));
    }
    return hexa_void();
}


HexaVal parse(HexaVal tokens) {
    p_tokens = tokens;
    p_pos = hexa_int(0);
    p_pending_symbol = hexa_str("");
    p_pending_link = hexa_str("");
    p_errors = hexa_array_new();
    HexaVal stmts = hexa_array_new();
    p_skip_newlines();
    while (hexa_truthy(hexa_bool(!hexa_truthy(p_at_end())))) {
        HexaVal prev_pos = p_pos;
        HexaVal parse_ok = hexa_bool(1);
        {
            jmp_buf __jb; HexaVal __err = hexa_void();
            if (setjmp(__jb) == 0) {
                __hexa_try_push(&__jb);
                stmts = hexa_array_push(stmts, parse_stmt());
                __hexa_try_pop();
            } else {
                __err = __hexa_last_error();
                HexaVal parse_err = __err;
                HexaVal err_tok = p_peek();
                p_record_error(hexa_map_get(err_tok, "line"), hexa_map_get(err_tok, "col"), hexa_to_string(parse_err));
                p_synchronize();
                parse_ok = hexa_bool(0);
            }
        }
        if (hexa_truthy(parse_ok)) {
            if (hexa_truthy(hexa_eq(p_pos, prev_pos))) {
                p_advance();
            }
        }
        p_skip_newlines();
    }
    return stmts;
    return hexa_void();
}


HexaVal parse_strict(HexaVal tokens) {
    p_tokens = tokens;
    p_pos = hexa_int(0);
    p_pending_symbol = hexa_str("");
    p_pending_link = hexa_str("");
    p_errors = hexa_array_new();
    HexaVal stmts = hexa_array_new();
    p_skip_newlines();
    while (hexa_truthy(hexa_bool(!hexa_truthy(p_at_end())))) {
        stmts = hexa_array_push(stmts, parse_stmt());
        p_skip_newlines();
    }
    return stmts;
    return hexa_void();
}


HexaVal parse_stmt(void) {
    p_skip_newlines();
    while (hexa_truthy(hexa_eq(p_peek_kind(), hexa_str("At")))) {
        p_advance();
        HexaVal attr_name = p_expect_ident();
        HexaVal attr_arg = hexa_str("");
        if (hexa_truthy(hexa_eq(p_peek_kind(), hexa_str("LParen")))) {
            p_advance();
            if (hexa_truthy(hexa_bool(!hexa_truthy(hexa_eq(p_peek_kind(), hexa_str("RParen")))))) {
                HexaVal tok = p_advance();
                attr_arg = hexa_map_get(tok, "value");
                while (hexa_truthy(hexa_bool(hexa_truthy(hexa_bool(!hexa_truthy(hexa_eq(p_peek_kind(), hexa_str("RParen"))))) && hexa_truthy(hexa_bool(!hexa_truthy(hexa_eq(p_peek_kind(), hexa_str("Eof")))))))) {
                    p_advance();
                }
            }
            p_expect(hexa_str("RParen"));
        }
        if (hexa_truthy(hexa_eq(attr_name, hexa_str("symbol")))) {
            p_pending_symbol = attr_arg;
        } else {
            if (hexa_truthy(hexa_eq(attr_name, hexa_str("link")))) {
                p_pending_link = attr_arg;
            } else {
                if (hexa_truthy(hexa_eq(p_pending_attrs, hexa_str("")))) {
                    p_pending_attrs = attr_name;
                } else {
                    p_pending_attrs = hexa_add(hexa_add(p_pending_attrs, hexa_str(",")), attr_name);
                }
            }
        }
        p_skip_newlines();
    }
    HexaVal kind = p_peek_kind();
    if (hexa_truthy(hexa_eq(kind, hexa_str("Let")))) {
        return parse_let();
    }
    if (hexa_truthy(hexa_eq(kind, hexa_str("Const")))) {
        return parse_const();
    }
    if (hexa_truthy(hexa_eq(kind, hexa_str("Static")))) {
        return parse_static();
    }
    if (hexa_truthy(hexa_eq(kind, hexa_str("Fn")))) {
        return parse_fn_decl();
    }
    if (hexa_truthy(hexa_eq(kind, hexa_str("Struct")))) {
        return parse_struct_decl();
    }
    if (hexa_truthy(hexa_eq(kind, hexa_str("Enum")))) {
        return parse_enum_decl();
    }
    if (hexa_truthy(hexa_eq(kind, hexa_str("For")))) {
        return parse_for_stmt();
    }
    if (hexa_truthy(hexa_eq(kind, hexa_str("While")))) {
        return parse_while_stmt();
    }
    if (hexa_truthy(hexa_eq(kind, hexa_str("Loop")))) {
        return parse_loop_stmt();
    }
    if (hexa_truthy(hexa_eq(kind, hexa_str("Return")))) {
        return parse_return();
    }
    if (hexa_truthy(hexa_eq(kind, hexa_str("Proof")))) {
        return parse_proof_stmt();
    }
    if (hexa_truthy(hexa_eq(kind, hexa_str("Assert")))) {
        return parse_assert_stmt();
    }
    if (hexa_truthy(hexa_eq(kind, hexa_str("Impl")))) {
        return parse_impl_block();
    }
    if (hexa_truthy(hexa_eq(kind, hexa_str("Trait")))) {
        return parse_trait_decl();
    }
    if (hexa_truthy(hexa_eq(kind, hexa_str("Use")))) {
        return parse_use_decl();
    }
    if (hexa_truthy(hexa_eq(kind, hexa_str("Mod")))) {
        return parse_mod_decl();
    }
    if (hexa_truthy(hexa_eq(kind, hexa_str("Ident")))) {
        HexaVal tok = p_peek();
        if (hexa_truthy(hexa_eq(hexa_map_get(tok, "value"), hexa_str("import")))) {
            p_advance();
            HexaVal path = hexa_str("");
            if (hexa_truthy(hexa_eq(p_peek_kind(), hexa_str("StringLit")))) {
                HexaVal str_tok = p_advance();
                path = hexa_map_get(str_tok, "value");
            }
            return hexa_map_set(hexa_map_set(hexa_map_set(hexa_map_set(hexa_map_set(hexa_map_set(hexa_map_set(hexa_map_set(hexa_map_set(hexa_map_set(hexa_map_set(hexa_map_set(hexa_map_set(hexa_map_set(hexa_map_set(hexa_map_set(hexa_map_set(hexa_map_set(hexa_map_set(hexa_map_set(hexa_map_set(hexa_map_new(), "kind", hexa_str("ImportStmt")), "name", path), "value", hexa_str("")), "op", hexa_str("")), "left", hexa_str("")), "right", hexa_str("")), "cond", hexa_str("")), "then_body", hexa_str("")), "else_body", hexa_str("")), "params", hexa_str("")), "body", hexa_str("")), "args", hexa_str("")), "fields", hexa_str("")), "items", hexa_str("")), "variants", hexa_str("")), "arms", hexa_str("")), "iter_expr", hexa_str("")), "ret_type", hexa_str("")), "target", hexa_str("")), "trait_name", hexa_str("")), "methods", hexa_str(""));
        }
    }
    if (hexa_truthy(hexa_eq(kind, hexa_str("Try")))) {
        return parse_try_catch();
    }
    if (hexa_truthy(hexa_eq(kind, hexa_str("Throw")))) {
        return parse_throw_stmt();
    }
    if (hexa_truthy(hexa_eq(kind, hexa_str("Panic")))) {
        return parse_panic_stmt();
    }
    if (hexa_truthy(hexa_eq(kind, hexa_str("Drop")))) {
        return parse_drop_stmt();
    }
    if (hexa_truthy(hexa_eq(kind, hexa_str("Spawn")))) {
        return parse_spawn_stmt();
    }
    if (hexa_truthy(hexa_eq(kind, hexa_str("Scope")))) {
        return parse_scope_stmt();
    }
    if (hexa_truthy(hexa_eq(kind, hexa_str("Select")))) {
        return parse_select_stmt();
    }
    if (hexa_truthy(hexa_eq(kind, hexa_str("Async")))) {
        return parse_async_fn();
    }
    if (hexa_truthy(hexa_eq(kind, hexa_str("Extern")))) {
        return parse_extern_fn();
    }
    if (hexa_truthy(hexa_eq(kind, hexa_str("Type")))) {
        return parse_type_alias();
    }
    if (hexa_truthy(hexa_eq(kind, hexa_str("Atomic")))) {
        return parse_atomic_let();
    }
    if (hexa_truthy(hexa_eq(kind, hexa_str("Break")))) {
        return parse_break_stmt();
    }
    if (hexa_truthy(hexa_eq(kind, hexa_str("Continue")))) {
        return parse_continue_stmt();
    }
    if (hexa_truthy(hexa_eq(kind, hexa_str("Yield")))) {
        return parse_yield_stmt();
    }
    if (hexa_truthy(hexa_eq(kind, hexa_str("Comptime")))) {
        return parse_comptime_stmt();
    }
    if (hexa_truthy(hexa_eq(kind, hexa_str("Intent")))) {
        return parse_intent_stmt();
    }
    if (hexa_truthy(hexa_eq(kind, hexa_str("Verify")))) {
        return parse_verify_stmt();
    }
    if (hexa_truthy(hexa_eq(kind, hexa_str("Generate")))) {
        return parse_generate_stmt();
    }
    if (hexa_truthy(hexa_eq(kind, hexa_str("Optimize")))) {
        return parse_optimize_stmt();
    }
    if (hexa_truthy(hexa_eq(kind, hexa_str("Effect")))) {
        return parse_effect_decl();
    }
    if (hexa_truthy(hexa_eq(kind, hexa_str("Pure")))) {
        return parse_pure_fn();
    }
    if (hexa_truthy(hexa_eq(kind, hexa_str("Macro")))) {
        return parse_macro_def();
    }
    if (hexa_truthy(hexa_eq(kind, hexa_str("Derive")))) {
        return parse_derive_decl();
    }
    if (hexa_truthy(hexa_eq(kind, hexa_str("Theorem")))) {
        return parse_theorem_stmt();
    }
    if (hexa_truthy(hexa_eq(kind, hexa_str("Handle")))) {
        return parse_handle_stmt();
    }
    if (hexa_truthy(hexa_eq(kind, hexa_str("Recover")))) {
        return parse_recover_stmt();
    }
    if (hexa_truthy(hexa_eq(kind, hexa_str("Attribute")))) {
        return parse_attribute_prefix();
    }
    HexaVal expr = parse_expr();
    if (hexa_truthy(hexa_eq(p_peek_kind(), hexa_str("Eq")))) {
        p_advance();
        HexaVal rhs = parse_expr();
        return hexa_map_set(hexa_map_set(hexa_map_set(hexa_map_set(hexa_map_set(hexa_map_set(hexa_map_set(hexa_map_set(hexa_map_set(hexa_map_set(hexa_map_set(hexa_map_set(hexa_map_set(hexa_map_set(hexa_map_set(hexa_map_set(hexa_map_set(hexa_map_set(hexa_map_set(hexa_map_set(hexa_map_set(hexa_map_new(), "kind", hexa_str("AssignStmt")), "name", hexa_str("")), "value", hexa_str("")), "op", hexa_str("")), "left", expr), "right", rhs), "cond", hexa_str("")), "then_body", hexa_str("")), "else_body", hexa_str("")), "params", hexa_str("")), "body", hexa_str("")), "args", hexa_str("")), "fields", hexa_str("")), "items", hexa_str("")), "variants", hexa_str("")), "arms", hexa_str("")), "iter_expr", hexa_str("")), "ret_type", hexa_str("")), "target", hexa_str("")), "trait_name", hexa_str("")), "methods", hexa_str(""));
    }
    return hexa_map_set(hexa_map_set(hexa_map_set(hexa_map_set(hexa_map_set(hexa_map_set(hexa_map_set(hexa_map_set(hexa_map_set(hexa_map_set(hexa_map_set(hexa_map_set(hexa_map_set(hexa_map_set(hexa_map_set(hexa_map_set(hexa_map_set(hexa_map_set(hexa_map_set(hexa_map_set(hexa_map_set(hexa_map_new(), "kind", hexa_str("ExprStmt")), "name", hexa_str("")), "value", hexa_str("")), "op", hexa_str("")), "left", expr), "right", hexa_str("")), "cond", hexa_str("")), "then_body", hexa_str("")), "else_body", hexa_str("")), "params", hexa_str("")), "body", hexa_str("")), "args", hexa_str("")), "fields", hexa_str("")), "items", hexa_str("")), "variants", hexa_str("")), "arms", hexa_str("")), "iter_expr", hexa_str("")), "ret_type", hexa_str("")), "target", hexa_str("")), "trait_name", hexa_str("")), "methods", hexa_str(""));
    return hexa_void();
}


HexaVal parse_let(void) {
    p_advance();
    HexaVal is_mut = hexa_bool(0);
    if (hexa_truthy(hexa_eq(p_peek_kind(), hexa_str("Mut")))) {
        p_advance();
        is_mut = hexa_bool(1);
    }
    HexaVal name = p_expect_ident();
    HexaVal typ = hexa_str("");
    if (hexa_truthy(hexa_eq(p_peek_kind(), hexa_str("Colon")))) {
        p_advance();
        typ = p_expect_ident();
    }
    p_expect(hexa_str("Eq"));
    HexaVal expr = parse_expr();
    HexaVal kind_str = hexa_str("LetStmt");
    if (hexa_truthy(is_mut)) {
        kind_str = hexa_str("LetMutStmt");
    }
    return hexa_map_set(hexa_map_set(hexa_map_set(hexa_map_set(hexa_map_set(hexa_map_set(hexa_map_set(hexa_map_set(hexa_map_set(hexa_map_set(hexa_map_set(hexa_map_set(hexa_map_set(hexa_map_set(hexa_map_set(hexa_map_set(hexa_map_set(hexa_map_set(hexa_map_set(hexa_map_set(hexa_map_set(hexa_map_new(), "kind", kind_str), "name", name), "value", typ), "op", hexa_str("")), "left", expr), "right", hexa_str("")), "cond", hexa_str("")), "then_body", hexa_str("")), "else_body", hexa_str("")), "params", hexa_str("")), "body", hexa_str("")), "args", hexa_str("")), "fields", hexa_str("")), "items", hexa_str("")), "variants", hexa_str("")), "arms", hexa_str("")), "iter_expr", hexa_str("")), "ret_type", hexa_str("")), "target", hexa_str("")), "trait_name", hexa_str("")), "methods", hexa_str(""));
    return hexa_void();
}


HexaVal parse_const(void) {
    p_advance();
    HexaVal name = p_expect_ident();
    HexaVal typ = hexa_str("");
    if (hexa_truthy(hexa_eq(p_peek_kind(), hexa_str("Colon")))) {
        p_advance();
        typ = p_expect_ident();
    }
    p_expect(hexa_str("Eq"));
    HexaVal expr = parse_expr();
    return hexa_map_set(hexa_map_set(hexa_map_set(hexa_map_set(hexa_map_set(hexa_map_set(hexa_map_set(hexa_map_set(hexa_map_set(hexa_map_set(hexa_map_set(hexa_map_set(hexa_map_set(hexa_map_set(hexa_map_set(hexa_map_set(hexa_map_set(hexa_map_set(hexa_map_set(hexa_map_set(hexa_map_set(hexa_map_new(), "kind", hexa_str("ConstStmt")), "name", name), "value", typ), "op", hexa_str("")), "left", expr), "right", hexa_str("")), "cond", hexa_str("")), "then_body", hexa_str("")), "else_body", hexa_str("")), "params", hexa_str("")), "body", hexa_str("")), "args", hexa_str("")), "fields", hexa_str("")), "items", hexa_str("")), "variants", hexa_str("")), "arms", hexa_str("")), "iter_expr", hexa_str("")), "ret_type", hexa_str("")), "target", hexa_str("")), "trait_name", hexa_str("")), "methods", hexa_str(""));
    return hexa_void();
}


HexaVal parse_static(void) {
    p_advance();
    HexaVal name = p_expect_ident();
    HexaVal typ = hexa_str("");
    if (hexa_truthy(hexa_eq(p_peek_kind(), hexa_str("Colon")))) {
        p_advance();
        typ = p_expect_ident();
    }
    p_expect(hexa_str("Eq"));
    HexaVal expr = parse_expr();
    return hexa_map_set(hexa_map_set(hexa_map_set(hexa_map_set(hexa_map_set(hexa_map_set(hexa_map_set(hexa_map_set(hexa_map_set(hexa_map_set(hexa_map_set(hexa_map_set(hexa_map_set(hexa_map_set(hexa_map_set(hexa_map_set(hexa_map_set(hexa_map_set(hexa_map_set(hexa_map_set(hexa_map_set(hexa_map_new(), "kind", hexa_str("StaticStmt")), "name", name), "value", typ), "op", hexa_str("")), "left", expr), "right", hexa_str("")), "cond", hexa_str("")), "then_body", hexa_str("")), "else_body", hexa_str("")), "params", hexa_str("")), "body", hexa_str("")), "args", hexa_str("")), "fields", hexa_str("")), "items", hexa_str("")), "variants", hexa_str("")), "arms", hexa_str("")), "iter_expr", hexa_str("")), "ret_type", hexa_str("")), "target", hexa_str("")), "trait_name", hexa_str("")), "methods", hexa_str(""));
    return hexa_void();
}


HexaVal parse_return(void) {
    p_advance();
    HexaVal k = p_peek_kind();
    if (hexa_truthy(hexa_bool(hexa_truthy(hexa_bool(hexa_truthy(hexa_eq(k, hexa_str("Newline"))) || hexa_truthy(hexa_eq(k, hexa_str("Eof"))))) || hexa_truthy(hexa_eq(k, hexa_str("RBrace")))))) {
        return hexa_map_set(hexa_map_set(hexa_map_set(hexa_map_set(hexa_map_set(hexa_map_set(hexa_map_set(hexa_map_set(hexa_map_set(hexa_map_set(hexa_map_set(hexa_map_set(hexa_map_set(hexa_map_set(hexa_map_set(hexa_map_set(hexa_map_set(hexa_map_set(hexa_map_set(hexa_map_set(hexa_map_set(hexa_map_new(), "kind", hexa_str("ReturnStmt")), "name", hexa_str("")), "value", hexa_str("")), "op", hexa_str("")), "left", hexa_str("")), "right", hexa_str("")), "cond", hexa_str("")), "then_body", hexa_str("")), "else_body", hexa_str("")), "params", hexa_str("")), "body", hexa_str("")), "args", hexa_str("")), "fields", hexa_str("")), "items", hexa_str("")), "variants", hexa_str("")), "arms", hexa_str("")), "iter_expr", hexa_str("")), "ret_type", hexa_str("")), "target", hexa_str("")), "trait_name", hexa_str("")), "methods", hexa_str(""));
    }
    HexaVal expr = parse_expr();
    return hexa_map_set(hexa_map_set(hexa_map_set(hexa_map_set(hexa_map_set(hexa_map_set(hexa_map_set(hexa_map_set(hexa_map_set(hexa_map_set(hexa_map_set(hexa_map_set(hexa_map_set(hexa_map_set(hexa_map_set(hexa_map_set(hexa_map_set(hexa_map_set(hexa_map_set(hexa_map_set(hexa_map_set(hexa_map_new(), "kind", hexa_str("ReturnStmt")), "name", hexa_str("")), "value", hexa_str("")), "op", hexa_str("")), "left", expr), "right", hexa_str("")), "cond", hexa_str("")), "then_body", hexa_str("")), "else_body", hexa_str("")), "params", hexa_str("")), "body", hexa_str("")), "args", hexa_str("")), "fields", hexa_str("")), "items", hexa_str("")), "variants", hexa_str("")), "arms", hexa_str("")), "iter_expr", hexa_str("")), "ret_type", hexa_str("")), "target", hexa_str("")), "trait_name", hexa_str("")), "methods", hexa_str(""));
    return hexa_void();
}


HexaVal parse_proof_stmt(void) {
    p_advance();
    HexaVal name = p_expect_ident();
    HexaVal body = parse_block();
    return hexa_map_set(hexa_map_set(hexa_map_set(hexa_map_set(hexa_map_set(hexa_map_set(hexa_map_set(hexa_map_set(hexa_map_set(hexa_map_set(hexa_map_set(hexa_map_set(hexa_map_set(hexa_map_set(hexa_map_set(hexa_map_set(hexa_map_set(hexa_map_set(hexa_map_set(hexa_map_set(hexa_map_set(hexa_map_new(), "kind", hexa_str("ProofStmt")), "name", name), "value", hexa_str("")), "op", hexa_str("")), "left", hexa_str("")), "right", hexa_str("")), "cond", hexa_str("")), "then_body", hexa_str("")), "else_body", hexa_str("")), "params", hexa_str("")), "body", body), "args", hexa_str("")), "fields", hexa_str("")), "items", hexa_str("")), "variants", hexa_str("")), "arms", hexa_str("")), "iter_expr", hexa_str("")), "ret_type", hexa_str("")), "target", hexa_str("")), "trait_name", hexa_str("")), "methods", hexa_str(""));
    return hexa_void();
}


HexaVal parse_assert_stmt(void) {
    p_advance();
    HexaVal expr = parse_expr();
    return hexa_map_set(hexa_map_set(hexa_map_set(hexa_map_set(hexa_map_set(hexa_map_set(hexa_map_set(hexa_map_set(hexa_map_set(hexa_map_set(hexa_map_set(hexa_map_set(hexa_map_set(hexa_map_set(hexa_map_set(hexa_map_set(hexa_map_set(hexa_map_set(hexa_map_set(hexa_map_set(hexa_map_set(hexa_map_new(), "kind", hexa_str("AssertStmt")), "name", hexa_str("")), "value", hexa_str("")), "op", hexa_str("")), "left", expr), "right", hexa_str("")), "cond", hexa_str("")), "then_body", hexa_str("")), "else_body", hexa_str("")), "params", hexa_str("")), "body", hexa_str("")), "args", hexa_str("")), "fields", hexa_str("")), "items", hexa_str("")), "variants", hexa_str("")), "arms", hexa_str("")), "iter_expr", hexa_str("")), "ret_type", hexa_str("")), "target", hexa_str("")), "trait_name", hexa_str("")), "methods", hexa_str(""));
    return hexa_void();
}


HexaVal parse_use_decl(void) {
    p_advance();
    HexaVal path = hexa_array_new();
    path = hexa_array_push(path, p_expect_ident());
    while (hexa_truthy(hexa_eq(p_peek_kind(), hexa_str("ColonColon")))) {
        p_advance();
        path = hexa_array_push(path, p_expect_ident());
    }
    return hexa_map_set(hexa_map_set(hexa_map_set(hexa_map_set(hexa_map_set(hexa_map_set(hexa_map_set(hexa_map_set(hexa_map_set(hexa_map_set(hexa_map_set(hexa_map_set(hexa_map_set(hexa_map_set(hexa_map_set(hexa_map_set(hexa_map_set(hexa_map_set(hexa_map_set(hexa_map_set(hexa_map_set(hexa_map_new(), "kind", hexa_str("UseStmt")), "name", hexa_str("")), "value", hexa_str("")), "op", hexa_str("")), "left", hexa_str("")), "right", hexa_str("")), "cond", hexa_str("")), "then_body", hexa_str("")), "else_body", hexa_str("")), "params", hexa_str("")), "body", hexa_str("")), "args", hexa_str("")), "fields", hexa_str("")), "items", path), "variants", hexa_str("")), "arms", hexa_str("")), "iter_expr", hexa_str("")), "ret_type", hexa_str("")), "target", hexa_str("")), "trait_name", hexa_str("")), "methods", hexa_str(""));
    return hexa_void();
}


HexaVal parse_mod_decl(void) {
    p_advance();
    HexaVal name = p_expect_ident();
    HexaVal body = parse_block();
    return hexa_map_set(hexa_map_set(hexa_map_set(hexa_map_set(hexa_map_set(hexa_map_set(hexa_map_set(hexa_map_set(hexa_map_set(hexa_map_set(hexa_map_set(hexa_map_set(hexa_map_set(hexa_map_set(hexa_map_set(hexa_map_set(hexa_map_set(hexa_map_set(hexa_map_set(hexa_map_set(hexa_map_set(hexa_map_new(), "kind", hexa_str("ModStmt")), "name", name), "value", hexa_str("")), "op", hexa_str("")), "left", hexa_str("")), "right", hexa_str("")), "cond", hexa_str("")), "then_body", hexa_str("")), "else_body", hexa_str("")), "params", hexa_str("")), "body", body), "args", hexa_str("")), "fields", hexa_str("")), "items", hexa_str("")), "variants", hexa_str("")), "arms", hexa_str("")), "iter_expr", hexa_str("")), "ret_type", hexa_str("")), "target", hexa_str("")), "trait_name", hexa_str("")), "methods", hexa_str(""));
    return hexa_void();
}


HexaVal parse_fn_decl(void) {
    p_advance();
    HexaVal name = p_expect_ident();
    HexaVal tparams = hexa_array_new();
    if (hexa_truthy(hexa_eq(p_peek_kind(), hexa_str("Lt")))) {
        tparams = parse_type_params();
    }
    p_expect(hexa_str("LParen"));
    HexaVal params = parse_params();
    p_expect(hexa_str("RParen"));
    HexaVal ret = hexa_str("");
    if (hexa_truthy(hexa_eq(p_peek_kind(), hexa_str("Arrow")))) {
        p_advance();
        ret = p_expect_ident();
    }
    HexaVal body = parse_block();
    HexaVal attrs = p_pending_attrs;
    p_pending_attrs = hexa_str("");
    return hexa_map_set(hexa_map_set(hexa_map_set(hexa_map_set(hexa_map_set(hexa_map_set(hexa_map_set(hexa_map_set(hexa_map_set(hexa_map_set(hexa_map_set(hexa_map_set(hexa_map_set(hexa_map_set(hexa_map_set(hexa_map_set(hexa_map_set(hexa_map_set(hexa_map_set(hexa_map_set(hexa_map_set(hexa_map_new(), "kind", hexa_str("FnDecl")), "name", name), "value", attrs), "op", hexa_str("")), "left", hexa_str("")), "right", hexa_str("")), "cond", hexa_str("")), "then_body", hexa_str("")), "else_body", hexa_str("")), "params", params), "body", body), "args", hexa_str("")), "fields", hexa_str("")), "items", tparams), "variants", hexa_str("")), "arms", hexa_str("")), "iter_expr", hexa_str("")), "ret_type", ret), "target", hexa_str("")), "trait_name", hexa_str("")), "methods", hexa_str(""));
    return hexa_void();
}


HexaVal parse_type_annotation(void) {
    if (hexa_truthy(hexa_eq(p_peek_kind(), hexa_str("Star")))) {
        p_advance();
        return hexa_add(hexa_str("*"), p_expect_ident());
    }
    if (hexa_truthy(hexa_eq(p_peek_kind(), hexa_str("LBracket")))) {
        p_advance();
        HexaVal inner = parse_type_annotation();
        p_expect(hexa_str("RBracket"));
        return hexa_add(hexa_add(hexa_str("["), inner), hexa_str("]"));
    }
    return p_expect_ident();
    return hexa_void();
}


HexaVal parse_params(void) {
    HexaVal params = hexa_array_new();
    if (hexa_truthy(hexa_eq(p_peek_kind(), hexa_str("RParen")))) {
        return params;
    }
    HexaVal name = p_expect_ident();
    HexaVal typ = hexa_str("");
    if (hexa_truthy(hexa_eq(p_peek_kind(), hexa_str("Colon")))) {
        p_advance();
        typ = parse_type_annotation();
    }
    params = hexa_array_push(params, hexa_map_set(hexa_map_set(hexa_map_set(hexa_map_set(hexa_map_set(hexa_map_set(hexa_map_set(hexa_map_set(hexa_map_set(hexa_map_set(hexa_map_set(hexa_map_set(hexa_map_set(hexa_map_set(hexa_map_set(hexa_map_set(hexa_map_set(hexa_map_set(hexa_map_set(hexa_map_set(hexa_map_set(hexa_map_new(), "kind", hexa_str("Param")), "name", name), "value", typ), "op", hexa_str("")), "left", hexa_str("")), "right", hexa_str("")), "cond", hexa_str("")), "then_body", hexa_str("")), "else_body", hexa_str("")), "params", hexa_str("")), "body", hexa_str("")), "args", hexa_str("")), "fields", hexa_str("")), "items", hexa_str("")), "variants", hexa_str("")), "arms", hexa_str("")), "iter_expr", hexa_str("")), "ret_type", hexa_str("")), "target", hexa_str("")), "trait_name", hexa_str("")), "methods", hexa_str("")));
    while (hexa_truthy(hexa_eq(p_peek_kind(), hexa_str("Comma")))) {
        p_advance();
        HexaVal pname = p_expect_ident();
        HexaVal ptyp = hexa_str("");
        if (hexa_truthy(hexa_eq(p_peek_kind(), hexa_str("Colon")))) {
            p_advance();
            ptyp = parse_type_annotation();
        }
        params = hexa_array_push(params, hexa_map_set(hexa_map_set(hexa_map_set(hexa_map_set(hexa_map_set(hexa_map_set(hexa_map_set(hexa_map_set(hexa_map_set(hexa_map_set(hexa_map_set(hexa_map_set(hexa_map_set(hexa_map_set(hexa_map_set(hexa_map_set(hexa_map_set(hexa_map_set(hexa_map_set(hexa_map_set(hexa_map_set(hexa_map_new(), "kind", hexa_str("Param")), "name", pname), "value", ptyp), "op", hexa_str("")), "left", hexa_str("")), "right", hexa_str("")), "cond", hexa_str("")), "then_body", hexa_str("")), "else_body", hexa_str("")), "params", hexa_str("")), "body", hexa_str("")), "args", hexa_str("")), "fields", hexa_str("")), "items", hexa_str("")), "variants", hexa_str("")), "arms", hexa_str("")), "iter_expr", hexa_str("")), "ret_type", hexa_str("")), "target", hexa_str("")), "trait_name", hexa_str("")), "methods", hexa_str("")));
    }
    return params;
    return hexa_void();
}


HexaVal parse_struct_decl(void) {
    p_advance();
    HexaVal name = p_expect_ident();
    HexaVal tparams = hexa_array_new();
    if (hexa_truthy(hexa_eq(p_peek_kind(), hexa_str("Lt")))) {
        tparams = parse_type_params();
    }
    p_expect(hexa_str("LBrace"));
    p_skip_newlines();
    HexaVal fields = hexa_array_new();
    while (hexa_truthy(hexa_bool(hexa_truthy(hexa_bool(!hexa_truthy(hexa_eq(p_peek_kind(), hexa_str("RBrace"))))) && hexa_truthy(hexa_bool(!hexa_truthy(hexa_eq(p_peek_kind(), hexa_str("Eof")))))))) {
        HexaVal fname = p_expect_ident();
        p_expect(hexa_str("Colon"));
        HexaVal ftype = p_expect_ident();
        fields = hexa_array_push(fields, hexa_map_set(hexa_map_set(hexa_map_set(hexa_map_set(hexa_map_set(hexa_map_set(hexa_map_set(hexa_map_set(hexa_map_set(hexa_map_set(hexa_map_set(hexa_map_set(hexa_map_set(hexa_map_set(hexa_map_set(hexa_map_set(hexa_map_set(hexa_map_set(hexa_map_set(hexa_map_set(hexa_map_set(hexa_map_new(), "kind", hexa_str("StructField")), "name", fname), "value", ftype), "op", hexa_str("")), "left", hexa_str("")), "right", hexa_str("")), "cond", hexa_str("")), "then_body", hexa_str("")), "else_body", hexa_str("")), "params", hexa_str("")), "body", hexa_str("")), "args", hexa_str("")), "fields", hexa_str("")), "items", hexa_str("")), "variants", hexa_str("")), "arms", hexa_str("")), "iter_expr", hexa_str("")), "ret_type", hexa_str("")), "target", hexa_str("")), "trait_name", hexa_str("")), "methods", hexa_str("")));
        if (hexa_truthy(hexa_eq(p_peek_kind(), hexa_str("Comma")))) {
            p_advance();
        }
        p_skip_newlines();
    }
    p_expect(hexa_str("RBrace"));
    return hexa_map_set(hexa_map_set(hexa_map_set(hexa_map_set(hexa_map_set(hexa_map_set(hexa_map_set(hexa_map_set(hexa_map_set(hexa_map_set(hexa_map_set(hexa_map_set(hexa_map_set(hexa_map_set(hexa_map_set(hexa_map_set(hexa_map_set(hexa_map_set(hexa_map_set(hexa_map_set(hexa_map_set(hexa_map_new(), "kind", hexa_str("StructDecl")), "name", name), "value", hexa_str("")), "op", hexa_str("")), "left", hexa_str("")), "right", hexa_str("")), "cond", hexa_str("")), "then_body", hexa_str("")), "else_body", hexa_str("")), "params", hexa_str("")), "body", hexa_str("")), "args", hexa_str("")), "fields", fields), "items", tparams), "variants", hexa_str("")), "arms", hexa_str("")), "iter_expr", hexa_str("")), "ret_type", hexa_str("")), "target", hexa_str("")), "trait_name", hexa_str("")), "methods", hexa_str(""));
    return hexa_void();
}


HexaVal parse_enum_decl(void) {
    p_advance();
    HexaVal name = p_expect_ident();
    p_expect(hexa_str("LBrace"));
    p_skip_newlines();
    HexaVal variants = hexa_array_new();
    while (hexa_truthy(hexa_bool(hexa_truthy(hexa_bool(!hexa_truthy(hexa_eq(p_peek_kind(), hexa_str("RBrace"))))) && hexa_truthy(hexa_bool(!hexa_truthy(hexa_eq(p_peek_kind(), hexa_str("Eof")))))))) {
        HexaVal vname = p_expect_ident();
        HexaVal vtypes = hexa_array_new();
        if (hexa_truthy(hexa_eq(p_peek_kind(), hexa_str("LParen")))) {
            p_advance();
            while (hexa_truthy(hexa_bool(hexa_truthy(hexa_bool(!hexa_truthy(hexa_eq(p_peek_kind(), hexa_str("RParen"))))) && hexa_truthy(hexa_bool(!hexa_truthy(hexa_eq(p_peek_kind(), hexa_str("Eof")))))))) {
                vtypes = hexa_array_push(vtypes, p_expect_ident());
                if (hexa_truthy(hexa_eq(p_peek_kind(), hexa_str("Comma")))) {
                    p_advance();
                }
            }
            p_expect(hexa_str("RParen"));
        }
        variants = hexa_array_push(variants, hexa_map_set(hexa_map_set(hexa_map_set(hexa_map_set(hexa_map_set(hexa_map_set(hexa_map_set(hexa_map_set(hexa_map_set(hexa_map_set(hexa_map_set(hexa_map_set(hexa_map_set(hexa_map_set(hexa_map_set(hexa_map_set(hexa_map_set(hexa_map_set(hexa_map_set(hexa_map_set(hexa_map_set(hexa_map_new(), "kind", hexa_str("EnumVariant")), "name", vname), "value", hexa_str("")), "op", hexa_str("")), "left", hexa_str("")), "right", hexa_str("")), "cond", hexa_str("")), "then_body", hexa_str("")), "else_body", hexa_str("")), "params", hexa_str("")), "body", hexa_str("")), "args", hexa_str("")), "fields", hexa_str("")), "items", vtypes), "variants", hexa_str("")), "arms", hexa_str("")), "iter_expr", hexa_str("")), "ret_type", hexa_str("")), "target", hexa_str("")), "trait_name", hexa_str("")), "methods", hexa_str("")));
        if (hexa_truthy(hexa_eq(p_peek_kind(), hexa_str("Comma")))) {
            p_advance();
        }
        p_skip_newlines();
    }
    p_expect(hexa_str("RBrace"));
    return hexa_map_set(hexa_map_set(hexa_map_set(hexa_map_set(hexa_map_set(hexa_map_set(hexa_map_set(hexa_map_set(hexa_map_set(hexa_map_set(hexa_map_set(hexa_map_set(hexa_map_set(hexa_map_set(hexa_map_set(hexa_map_set(hexa_map_set(hexa_map_set(hexa_map_set(hexa_map_set(hexa_map_set(hexa_map_new(), "kind", hexa_str("EnumDecl")), "name", name), "value", hexa_str("")), "op", hexa_str("")), "left", hexa_str("")), "right", hexa_str("")), "cond", hexa_str("")), "then_body", hexa_str("")), "else_body", hexa_str("")), "params", hexa_str("")), "body", hexa_str("")), "args", hexa_str("")), "fields", hexa_str("")), "items", hexa_str("")), "variants", variants), "arms", hexa_str("")), "iter_expr", hexa_str("")), "ret_type", hexa_str("")), "target", hexa_str("")), "trait_name", hexa_str("")), "methods", hexa_str(""));
    return hexa_void();
}


HexaVal parse_trait_decl(void) {
    p_advance();
    HexaVal name = p_expect_ident();
    p_expect(hexa_str("LBrace"));
    p_skip_newlines();
    HexaVal methods = hexa_array_new();
    while (hexa_truthy(hexa_bool(hexa_truthy(hexa_bool(!hexa_truthy(hexa_eq(p_peek_kind(), hexa_str("RBrace"))))) && hexa_truthy(hexa_bool(!hexa_truthy(hexa_eq(p_peek_kind(), hexa_str("Eof")))))))) {
        p_skip_newlines();
        if (hexa_truthy(hexa_eq(p_peek_kind(), hexa_str("RBrace")))) {
        } else {
            p_expect(hexa_str("Fn"));
            HexaVal mname = p_expect_ident();
            p_expect(hexa_str("LParen"));
            HexaVal mparams = parse_params();
            p_expect(hexa_str("RParen"));
            HexaVal mret = hexa_str("");
            if (hexa_truthy(hexa_eq(p_peek_kind(), hexa_str("Arrow")))) {
                p_advance();
                mret = p_expect_ident();
            }
            HexaVal mbody = hexa_array_new();
            if (hexa_truthy(hexa_eq(p_peek_kind(), hexa_str("LBrace")))) {
                mbody = parse_block();
            }
            methods = hexa_array_push(methods, hexa_map_set(hexa_map_set(hexa_map_set(hexa_map_set(hexa_map_set(hexa_map_set(hexa_map_set(hexa_map_set(hexa_map_set(hexa_map_set(hexa_map_set(hexa_map_set(hexa_map_set(hexa_map_set(hexa_map_set(hexa_map_set(hexa_map_set(hexa_map_set(hexa_map_set(hexa_map_set(hexa_map_set(hexa_map_new(), "kind", hexa_str("FnDecl")), "name", mname), "value", hexa_str("")), "op", hexa_str("")), "left", hexa_str("")), "right", hexa_str("")), "cond", hexa_str("")), "then_body", hexa_str("")), "else_body", hexa_str("")), "params", mparams), "body", mbody), "args", hexa_str("")), "fields", hexa_str("")), "items", hexa_str("")), "variants", hexa_str("")), "arms", hexa_str("")), "iter_expr", hexa_str("")), "ret_type", mret), "target", hexa_str("")), "trait_name", hexa_str("")), "methods", hexa_str("")));
            p_skip_newlines();
        }
    }
    p_expect(hexa_str("RBrace"));
    return hexa_map_set(hexa_map_set(hexa_map_set(hexa_map_set(hexa_map_set(hexa_map_set(hexa_map_set(hexa_map_set(hexa_map_set(hexa_map_set(hexa_map_set(hexa_map_set(hexa_map_set(hexa_map_set(hexa_map_set(hexa_map_set(hexa_map_set(hexa_map_set(hexa_map_set(hexa_map_set(hexa_map_set(hexa_map_new(), "kind", hexa_str("TraitDecl")), "name", name), "value", hexa_str("")), "op", hexa_str("")), "left", hexa_str("")), "right", hexa_str("")), "cond", hexa_str("")), "then_body", hexa_str("")), "else_body", hexa_str("")), "params", hexa_str("")), "body", hexa_str("")), "args", hexa_str("")), "fields", hexa_str("")), "items", hexa_str("")), "variants", hexa_str("")), "arms", hexa_str("")), "iter_expr", hexa_str("")), "ret_type", hexa_str("")), "target", hexa_str("")), "trait_name", hexa_str("")), "methods", methods);
    return hexa_void();
}


HexaVal parse_impl_block(void) {
    p_advance();
    HexaVal first_name = p_expect_ident();
    HexaVal trait_n = hexa_str("");
    HexaVal target_n = first_name;
    if (hexa_truthy(hexa_eq(p_peek_kind(), hexa_str("For")))) {
        p_advance();
        trait_n = first_name;
        target_n = p_expect_ident();
    }
    p_expect(hexa_str("LBrace"));
    p_skip_newlines();
    HexaVal methods = hexa_array_new();
    while (hexa_truthy(hexa_bool(hexa_truthy(hexa_bool(!hexa_truthy(hexa_eq(p_peek_kind(), hexa_str("RBrace"))))) && hexa_truthy(hexa_bool(!hexa_truthy(hexa_eq(p_peek_kind(), hexa_str("Eof")))))))) {
        p_skip_newlines();
        if (hexa_truthy(hexa_eq(p_peek_kind(), hexa_str("RBrace")))) {
        } else {
            p_expect(hexa_str("Fn"));
            HexaVal mname = p_expect_ident();
            p_expect(hexa_str("LParen"));
            HexaVal mparams = parse_params();
            p_expect(hexa_str("RParen"));
            HexaVal mret = hexa_str("");
            if (hexa_truthy(hexa_eq(p_peek_kind(), hexa_str("Arrow")))) {
                p_advance();
                mret = p_expect_ident();
            }
            HexaVal mbody = parse_block();
            methods = hexa_array_push(methods, hexa_map_set(hexa_map_set(hexa_map_set(hexa_map_set(hexa_map_set(hexa_map_set(hexa_map_set(hexa_map_set(hexa_map_set(hexa_map_set(hexa_map_set(hexa_map_set(hexa_map_set(hexa_map_set(hexa_map_set(hexa_map_set(hexa_map_set(hexa_map_set(hexa_map_set(hexa_map_set(hexa_map_set(hexa_map_new(), "kind", hexa_str("FnDecl")), "name", mname), "value", hexa_str("")), "op", hexa_str("")), "left", hexa_str("")), "right", hexa_str("")), "cond", hexa_str("")), "then_body", hexa_str("")), "else_body", hexa_str("")), "params", mparams), "body", mbody), "args", hexa_str("")), "fields", hexa_str("")), "items", hexa_str("")), "variants", hexa_str("")), "arms", hexa_str("")), "iter_expr", hexa_str("")), "ret_type", mret), "target", hexa_str("")), "trait_name", hexa_str("")), "methods", hexa_str("")));
            p_skip_newlines();
        }
    }
    p_expect(hexa_str("RBrace"));
    return hexa_map_set(hexa_map_set(hexa_map_set(hexa_map_set(hexa_map_set(hexa_map_set(hexa_map_set(hexa_map_set(hexa_map_set(hexa_map_set(hexa_map_set(hexa_map_set(hexa_map_set(hexa_map_set(hexa_map_set(hexa_map_set(hexa_map_set(hexa_map_set(hexa_map_set(hexa_map_set(hexa_map_set(hexa_map_new(), "kind", hexa_str("ImplBlock")), "name", hexa_str("")), "value", hexa_str("")), "op", hexa_str("")), "left", hexa_str("")), "right", hexa_str("")), "cond", hexa_str("")), "then_body", hexa_str("")), "else_body", hexa_str("")), "params", hexa_str("")), "body", hexa_str("")), "args", hexa_str("")), "fields", hexa_str("")), "items", hexa_str("")), "variants", hexa_str("")), "arms", hexa_str("")), "iter_expr", hexa_str("")), "ret_type", hexa_str("")), "target", target_n), "trait_name", trait_n), "methods", methods);
    return hexa_void();
}


HexaVal parse_for_stmt(void) {
    p_advance();
    HexaVal var = p_expect_ident();
    HexaVal in_tok = p_advance();
    if (hexa_truthy(hexa_bool(!hexa_truthy(hexa_eq(hexa_map_get(in_tok, "value"), hexa_str("in")))))) {
        HexaVal for_msg = hexa_format_n(hexa_str("expected 'in' after for variable, got '{}'"), hexa_array_push(hexa_array_new(), hexa_map_get(in_tok, "value")));
        p_record_error(hexa_map_get(in_tok, "line"), hexa_map_get(in_tok, "col"), for_msg);
        hexa_println(hexa_add(hexa_str("Parse error: "), for_msg));
    }
    HexaVal iter = parse_expr();
    HexaVal body = parse_block();
    return hexa_map_set(hexa_map_set(hexa_map_set(hexa_map_set(hexa_map_set(hexa_map_set(hexa_map_set(hexa_map_set(hexa_map_set(hexa_map_set(hexa_map_set(hexa_map_set(hexa_map_set(hexa_map_set(hexa_map_set(hexa_map_set(hexa_map_set(hexa_map_set(hexa_map_set(hexa_map_set(hexa_map_set(hexa_map_new(), "kind", hexa_str("ForStmt")), "name", var), "value", hexa_str("")), "op", hexa_str("")), "left", hexa_str("")), "right", hexa_str("")), "cond", hexa_str("")), "then_body", hexa_str("")), "else_body", hexa_str("")), "params", hexa_str("")), "body", body), "args", hexa_str("")), "fields", hexa_str("")), "items", hexa_str("")), "variants", hexa_str("")), "arms", hexa_str("")), "iter_expr", iter), "ret_type", hexa_str("")), "target", hexa_str("")), "trait_name", hexa_str("")), "methods", hexa_str(""));
    return hexa_void();
}


HexaVal parse_while_stmt(void) {
    p_advance();
    HexaVal cond = parse_expr();
    HexaVal body = parse_block();
    return hexa_map_set(hexa_map_set(hexa_map_set(hexa_map_set(hexa_map_set(hexa_map_set(hexa_map_set(hexa_map_set(hexa_map_set(hexa_map_set(hexa_map_set(hexa_map_set(hexa_map_set(hexa_map_set(hexa_map_set(hexa_map_set(hexa_map_set(hexa_map_set(hexa_map_set(hexa_map_set(hexa_map_set(hexa_map_new(), "kind", hexa_str("WhileStmt")), "name", hexa_str("")), "value", hexa_str("")), "op", hexa_str("")), "left", hexa_str("")), "right", hexa_str("")), "cond", cond), "then_body", hexa_str("")), "else_body", hexa_str("")), "params", hexa_str("")), "body", body), "args", hexa_str("")), "fields", hexa_str("")), "items", hexa_str("")), "variants", hexa_str("")), "arms", hexa_str("")), "iter_expr", hexa_str("")), "ret_type", hexa_str("")), "target", hexa_str("")), "trait_name", hexa_str("")), "methods", hexa_str(""));
    return hexa_void();
}


HexaVal parse_loop_stmt(void) {
    p_advance();
    HexaVal body = parse_block();
    return hexa_map_set(hexa_map_set(hexa_map_set(hexa_map_set(hexa_map_set(hexa_map_set(hexa_map_set(hexa_map_set(hexa_map_set(hexa_map_set(hexa_map_set(hexa_map_set(hexa_map_set(hexa_map_set(hexa_map_set(hexa_map_set(hexa_map_set(hexa_map_set(hexa_map_set(hexa_map_set(hexa_map_set(hexa_map_new(), "kind", hexa_str("LoopStmt")), "name", hexa_str("")), "value", hexa_str("")), "op", hexa_str("")), "left", hexa_str("")), "right", hexa_str("")), "cond", hexa_str("")), "then_body", hexa_str("")), "else_body", hexa_str("")), "params", hexa_str("")), "body", body), "args", hexa_str("")), "fields", hexa_str("")), "items", hexa_str("")), "variants", hexa_str("")), "arms", hexa_str("")), "iter_expr", hexa_str("")), "ret_type", hexa_str("")), "target", hexa_str("")), "trait_name", hexa_str("")), "methods", hexa_str(""));
    return hexa_void();
}


HexaVal parse_if_expr(void) {
    p_advance();
    HexaVal cond = parse_expr();
    HexaVal then_b = parse_block();
    HexaVal saved = p_pos;
    p_skip_newlines();
    HexaVal else_b = hexa_array_new();
    if (hexa_truthy(hexa_eq(p_peek_kind(), hexa_str("Else")))) {
        p_advance();
        if (hexa_truthy(hexa_eq(p_peek_kind(), hexa_str("If")))) {
            HexaVal nested = parse_if_expr();
            else_b = hexa_array_push(hexa_array_new(), hexa_map_set(hexa_map_set(hexa_map_set(hexa_map_set(hexa_map_set(hexa_map_set(hexa_map_set(hexa_map_set(hexa_map_set(hexa_map_set(hexa_map_set(hexa_map_set(hexa_map_set(hexa_map_set(hexa_map_set(hexa_map_set(hexa_map_set(hexa_map_set(hexa_map_set(hexa_map_set(hexa_map_set(hexa_map_new(), "kind", hexa_str("ExprStmt")), "name", hexa_str("")), "value", hexa_str("")), "op", hexa_str("")), "left", nested), "right", hexa_str("")), "cond", hexa_str("")), "then_body", hexa_str("")), "else_body", hexa_str("")), "params", hexa_str("")), "body", hexa_str("")), "args", hexa_str("")), "fields", hexa_str("")), "items", hexa_str("")), "variants", hexa_str("")), "arms", hexa_str("")), "iter_expr", hexa_str("")), "ret_type", hexa_str("")), "target", hexa_str("")), "trait_name", hexa_str("")), "methods", hexa_str("")));
        } else {
            else_b = parse_block();
        }
    } else {
        p_pos = saved;
    }
    return hexa_map_set(hexa_map_set(hexa_map_set(hexa_map_set(hexa_map_set(hexa_map_set(hexa_map_set(hexa_map_set(hexa_map_set(hexa_map_set(hexa_map_set(hexa_map_set(hexa_map_set(hexa_map_set(hexa_map_set(hexa_map_set(hexa_map_set(hexa_map_set(hexa_map_set(hexa_map_set(hexa_map_set(hexa_map_new(), "kind", hexa_str("IfExpr")), "name", hexa_str("")), "value", hexa_str("")), "op", hexa_str("")), "left", hexa_str("")), "right", hexa_str("")), "cond", cond), "then_body", then_b), "else_body", else_b), "params", hexa_str("")), "body", hexa_str("")), "args", hexa_str("")), "fields", hexa_str("")), "items", hexa_str("")), "variants", hexa_str("")), "arms", hexa_str("")), "iter_expr", hexa_str("")), "ret_type", hexa_str("")), "target", hexa_str("")), "trait_name", hexa_str("")), "methods", hexa_str(""));
    return hexa_void();
}


HexaVal parse_match_expr(void) {
    p_advance();
    HexaVal scrutinee = parse_expr();
    p_expect(hexa_str("LBrace"));
    p_skip_newlines();
    HexaVal arms = hexa_array_new();
    while (hexa_truthy(hexa_bool(hexa_truthy(hexa_bool(!hexa_truthy(hexa_eq(p_peek_kind(), hexa_str("RBrace"))))) && hexa_truthy(hexa_bool(!hexa_truthy(hexa_eq(p_peek_kind(), hexa_str("Eof")))))))) {
        HexaVal pattern = parse_match_pattern();
        HexaVal guard = hexa_str("");
        if (hexa_truthy(hexa_eq(p_peek_kind(), hexa_str("If")))) {
            p_advance();
            guard = parse_expr();
        }
        p_expect(hexa_str("Arrow"));
        HexaVal arm_body = hexa_array_new();
        if (hexa_truthy(hexa_eq(p_peek_kind(), hexa_str("LBrace")))) {
            arm_body = parse_block();
        } else {
            HexaVal arm_expr = parse_expr();
            arm_body = hexa_array_push(hexa_array_new(), hexa_map_set(hexa_map_set(hexa_map_set(hexa_map_set(hexa_map_set(hexa_map_set(hexa_map_set(hexa_map_set(hexa_map_set(hexa_map_set(hexa_map_set(hexa_map_set(hexa_map_set(hexa_map_set(hexa_map_set(hexa_map_set(hexa_map_set(hexa_map_set(hexa_map_set(hexa_map_set(hexa_map_set(hexa_map_new(), "kind", hexa_str("ExprStmt")), "name", hexa_str("")), "value", hexa_str("")), "op", hexa_str("")), "left", arm_expr), "right", hexa_str("")), "cond", hexa_str("")), "then_body", hexa_str("")), "else_body", hexa_str("")), "params", hexa_str("")), "body", hexa_str("")), "args", hexa_str("")), "fields", hexa_str("")), "items", hexa_str("")), "variants", hexa_str("")), "arms", hexa_str("")), "iter_expr", hexa_str("")), "ret_type", hexa_str("")), "target", hexa_str("")), "trait_name", hexa_str("")), "methods", hexa_str("")));
        }
        arms = hexa_array_push(arms, hexa_map_set(hexa_map_set(hexa_map_set(hexa_map_set(hexa_map_set(hexa_map_set(hexa_map_set(hexa_map_set(hexa_map_set(hexa_map_set(hexa_map_set(hexa_map_set(hexa_map_set(hexa_map_set(hexa_map_set(hexa_map_set(hexa_map_set(hexa_map_set(hexa_map_set(hexa_map_set(hexa_map_set(hexa_map_new(), "kind", hexa_str("MatchArm")), "name", hexa_str("")), "value", hexa_str("")), "op", hexa_str("")), "left", pattern), "right", hexa_str("")), "cond", guard), "then_body", hexa_str("")), "else_body", hexa_str("")), "params", hexa_str("")), "body", arm_body), "args", hexa_str("")), "fields", hexa_str("")), "items", hexa_str("")), "variants", hexa_str("")), "arms", hexa_str("")), "iter_expr", hexa_str("")), "ret_type", hexa_str("")), "target", hexa_str("")), "trait_name", hexa_str("")), "methods", hexa_str("")));
        if (hexa_truthy(hexa_eq(p_peek_kind(), hexa_str("Comma")))) {
            p_advance();
        }
        p_skip_newlines();
    }
    p_expect(hexa_str("RBrace"));
    return hexa_map_set(hexa_map_set(hexa_map_set(hexa_map_set(hexa_map_set(hexa_map_set(hexa_map_set(hexa_map_set(hexa_map_set(hexa_map_set(hexa_map_set(hexa_map_set(hexa_map_set(hexa_map_set(hexa_map_set(hexa_map_set(hexa_map_set(hexa_map_set(hexa_map_set(hexa_map_set(hexa_map_set(hexa_map_new(), "kind", hexa_str("MatchExpr")), "name", hexa_str("")), "value", hexa_str("")), "op", hexa_str("")), "left", scrutinee), "right", hexa_str("")), "cond", hexa_str("")), "then_body", hexa_str("")), "else_body", hexa_str("")), "params", hexa_str("")), "body", hexa_str("")), "args", hexa_str("")), "fields", hexa_str("")), "items", hexa_str("")), "variants", hexa_str("")), "arms", arms), "iter_expr", hexa_str("")), "ret_type", hexa_str("")), "target", hexa_str("")), "trait_name", hexa_str("")), "methods", hexa_str(""));
    return hexa_void();
}


HexaVal parse_match_pattern(void) {
    HexaVal tok = p_peek();
    if (hexa_truthy(hexa_bool(hexa_truthy(hexa_eq(hexa_map_get(tok, "kind"), hexa_str("Ident"))) && hexa_truthy(hexa_eq(hexa_map_get(tok, "value"), hexa_str("_")))))) {
        p_advance();
        return node_wildcard();
    }
    if (hexa_truthy(hexa_bool(hexa_truthy(hexa_eq(hexa_map_get(tok, "kind"), hexa_str("Ident"))) && hexa_truthy(hexa_eq(hexa_map_get(p_peek_ahead(hexa_int(1)), "kind"), hexa_str("ColonColon")))))) {
        HexaVal ename = hexa_map_get(tok, "value");
        p_advance();
        p_advance();
        HexaVal vname = p_expect_ident();
        HexaVal data = hexa_str("");
        HexaVal pat_items = hexa_str("");
        if (hexa_truthy(hexa_eq(p_peek_kind(), hexa_str("LParen")))) {
            p_advance();
            HexaVal plist = hexa_array_new();
            while (hexa_truthy(hexa_bool(hexa_truthy(hexa_bool(!hexa_truthy(hexa_eq(p_peek_kind(), hexa_str("RParen"))))) && hexa_truthy(hexa_bool(!hexa_truthy(hexa_eq(p_peek_kind(), hexa_str("Eof")))))))) {
                plist = hexa_array_push(plist, parse_match_pattern());
                if (hexa_truthy(hexa_eq(p_peek_kind(), hexa_str("Comma")))) {
                    p_advance();
                }
            }
            p_expect(hexa_str("RParen"));
            if (hexa_truthy(hexa_eq(hexa_int(hexa_len(plist)), hexa_int(1)))) {
                data = hexa_index_get(plist, hexa_int(0));
            } else {
                pat_items = plist;
            }
        }
        return hexa_map_set(hexa_map_set(hexa_map_set(hexa_map_set(hexa_map_set(hexa_map_set(hexa_map_set(hexa_map_set(hexa_map_set(hexa_map_set(hexa_map_set(hexa_map_set(hexa_map_set(hexa_map_set(hexa_map_set(hexa_map_set(hexa_map_set(hexa_map_set(hexa_map_set(hexa_map_set(hexa_map_set(hexa_map_new(), "kind", hexa_str("EnumPath")), "name", ename), "value", vname), "op", hexa_str("")), "left", data), "right", hexa_str("")), "cond", hexa_str("")), "then_body", hexa_str("")), "else_body", hexa_str("")), "params", hexa_str("")), "body", hexa_str("")), "args", hexa_str("")), "fields", hexa_str("")), "items", pat_items), "variants", hexa_str("")), "arms", hexa_str("")), "iter_expr", hexa_str("")), "ret_type", hexa_str("")), "target", hexa_str("")), "trait_name", hexa_str("")), "methods", hexa_str(""));
    }
    return parse_expr();
    return hexa_void();
}


HexaVal parse_block(void) {
    p_skip_newlines();
    p_expect(hexa_str("LBrace"));
    p_skip_newlines();
    HexaVal stmts = hexa_array_new();
    while (hexa_truthy(hexa_bool(hexa_truthy(hexa_bool(!hexa_truthy(hexa_eq(p_peek_kind(), hexa_str("RBrace"))))) && hexa_truthy(hexa_bool(!hexa_truthy(hexa_eq(p_peek_kind(), hexa_str("Eof")))))))) {
        stmts = hexa_array_push(stmts, parse_stmt());
        p_skip_newlines();
    }
    p_expect(hexa_str("RBrace"));
    return stmts;
    return hexa_void();
}


HexaVal parse_expr(void) {
    return parse_null_coal();
    return hexa_void();
}


HexaVal parse_null_coal(void) {
    HexaVal left = parse_or();
    while (hexa_truthy(hexa_eq(p_peek_kind(), hexa_str("NullCoal")))) {
        HexaVal op_tok = p_advance();
        HexaVal right = parse_or();
        left = hexa_map_set(hexa_map_set(hexa_map_set(hexa_map_set(hexa_map_set(hexa_map_set(hexa_map_set(hexa_map_set(hexa_map_set(hexa_map_set(hexa_map_set(hexa_map_set(hexa_map_set(hexa_map_set(hexa_map_set(hexa_map_set(hexa_map_set(hexa_map_set(hexa_map_set(hexa_map_set(hexa_map_set(hexa_map_new(), "kind", hexa_str("BinOp")), "name", hexa_str("")), "value", hexa_str("")), "op", hexa_map_get(op_tok, "value")), "left", left), "right", right), "cond", hexa_str("")), "then_body", hexa_str("")), "else_body", hexa_str("")), "params", hexa_str("")), "body", hexa_str("")), "args", hexa_str("")), "fields", hexa_str("")), "items", hexa_str("")), "variants", hexa_str("")), "arms", hexa_str("")), "iter_expr", hexa_str("")), "ret_type", hexa_str("")), "target", hexa_str("")), "trait_name", hexa_str("")), "methods", hexa_str(""));
    }
    return left;
    return hexa_void();
}


HexaVal parse_or(void) {
    HexaVal left = parse_and();
    while (hexa_truthy(hexa_bool(hexa_truthy(hexa_eq(p_peek_kind(), hexa_str("Or"))) || hexa_truthy(hexa_eq(p_peek_kind(), hexa_str("Xor")))))) {
        HexaVal op_tok = p_advance();
        HexaVal right = parse_and();
        left = hexa_map_set(hexa_map_set(hexa_map_set(hexa_map_set(hexa_map_set(hexa_map_set(hexa_map_set(hexa_map_set(hexa_map_set(hexa_map_set(hexa_map_set(hexa_map_set(hexa_map_set(hexa_map_set(hexa_map_set(hexa_map_set(hexa_map_set(hexa_map_set(hexa_map_set(hexa_map_set(hexa_map_set(hexa_map_new(), "kind", hexa_str("BinOp")), "name", hexa_str("")), "value", hexa_str("")), "op", hexa_map_get(op_tok, "value")), "left", left), "right", right), "cond", hexa_str("")), "then_body", hexa_str("")), "else_body", hexa_str("")), "params", hexa_str("")), "body", hexa_str("")), "args", hexa_str("")), "fields", hexa_str("")), "items", hexa_str("")), "variants", hexa_str("")), "arms", hexa_str("")), "iter_expr", hexa_str("")), "ret_type", hexa_str("")), "target", hexa_str("")), "trait_name", hexa_str("")), "methods", hexa_str(""));
    }
    return left;
    return hexa_void();
}


HexaVal parse_and(void) {
    HexaVal left = parse_comparison();
    while (hexa_truthy(hexa_eq(p_peek_kind(), hexa_str("And")))) {
        HexaVal op_tok = p_advance();
        HexaVal right = parse_comparison();
        left = hexa_map_set(hexa_map_set(hexa_map_set(hexa_map_set(hexa_map_set(hexa_map_set(hexa_map_set(hexa_map_set(hexa_map_set(hexa_map_set(hexa_map_set(hexa_map_set(hexa_map_set(hexa_map_set(hexa_map_set(hexa_map_set(hexa_map_set(hexa_map_set(hexa_map_set(hexa_map_set(hexa_map_set(hexa_map_new(), "kind", hexa_str("BinOp")), "name", hexa_str("")), "value", hexa_str("")), "op", hexa_map_get(op_tok, "value")), "left", left), "right", right), "cond", hexa_str("")), "then_body", hexa_str("")), "else_body", hexa_str("")), "params", hexa_str("")), "body", hexa_str("")), "args", hexa_str("")), "fields", hexa_str("")), "items", hexa_str("")), "variants", hexa_str("")), "arms", hexa_str("")), "iter_expr", hexa_str("")), "ret_type", hexa_str("")), "target", hexa_str("")), "trait_name", hexa_str("")), "methods", hexa_str(""));
    }
    return left;
    return hexa_void();
}


HexaVal parse_comparison(void) {
    HexaVal left = parse_addition();
    while (hexa_truthy(hexa_bool(hexa_truthy(hexa_bool(hexa_truthy(hexa_bool(hexa_truthy(hexa_bool(hexa_truthy(hexa_bool(hexa_truthy(hexa_eq(p_peek_kind(), hexa_str("EqEq"))) || hexa_truthy(hexa_eq(p_peek_kind(), hexa_str("NotEq"))))) || hexa_truthy(hexa_eq(p_peek_kind(), hexa_str("Lt"))))) || hexa_truthy(hexa_eq(p_peek_kind(), hexa_str("Gt"))))) || hexa_truthy(hexa_eq(p_peek_kind(), hexa_str("LtEq"))))) || hexa_truthy(hexa_eq(p_peek_kind(), hexa_str("GtEq")))))) {
        HexaVal op_tok = p_advance();
        HexaVal right = parse_addition();
        left = hexa_map_set(hexa_map_set(hexa_map_set(hexa_map_set(hexa_map_set(hexa_map_set(hexa_map_set(hexa_map_set(hexa_map_set(hexa_map_set(hexa_map_set(hexa_map_set(hexa_map_set(hexa_map_set(hexa_map_set(hexa_map_set(hexa_map_set(hexa_map_set(hexa_map_set(hexa_map_set(hexa_map_set(hexa_map_new(), "kind", hexa_str("BinOp")), "name", hexa_str("")), "value", hexa_str("")), "op", hexa_map_get(op_tok, "value")), "left", left), "right", right), "cond", hexa_str("")), "then_body", hexa_str("")), "else_body", hexa_str("")), "params", hexa_str("")), "body", hexa_str("")), "args", hexa_str("")), "fields", hexa_str("")), "items", hexa_str("")), "variants", hexa_str("")), "arms", hexa_str("")), "iter_expr", hexa_str("")), "ret_type", hexa_str("")), "target", hexa_str("")), "trait_name", hexa_str("")), "methods", hexa_str(""));
    }
    return left;
    return hexa_void();
}


HexaVal parse_addition(void) {
    HexaVal left = parse_multiplication();
    while (hexa_truthy(hexa_bool(hexa_truthy(hexa_eq(p_peek_kind(), hexa_str("Plus"))) || hexa_truthy(hexa_eq(p_peek_kind(), hexa_str("Minus")))))) {
        HexaVal op_tok = p_advance();
        HexaVal right = parse_multiplication();
        left = hexa_map_set(hexa_map_set(hexa_map_set(hexa_map_set(hexa_map_set(hexa_map_set(hexa_map_set(hexa_map_set(hexa_map_set(hexa_map_set(hexa_map_set(hexa_map_set(hexa_map_set(hexa_map_set(hexa_map_set(hexa_map_set(hexa_map_set(hexa_map_set(hexa_map_set(hexa_map_set(hexa_map_set(hexa_map_new(), "kind", hexa_str("BinOp")), "name", hexa_str("")), "value", hexa_str("")), "op", hexa_map_get(op_tok, "value")), "left", left), "right", right), "cond", hexa_str("")), "then_body", hexa_str("")), "else_body", hexa_str("")), "params", hexa_str("")), "body", hexa_str("")), "args", hexa_str("")), "fields", hexa_str("")), "items", hexa_str("")), "variants", hexa_str("")), "arms", hexa_str("")), "iter_expr", hexa_str("")), "ret_type", hexa_str("")), "target", hexa_str("")), "trait_name", hexa_str("")), "methods", hexa_str(""));
    }
    return left;
    return hexa_void();
}


HexaVal parse_multiplication(void) {
    HexaVal left = parse_unary();
    while (hexa_truthy(hexa_bool(hexa_truthy(hexa_bool(hexa_truthy(hexa_bool(hexa_truthy(hexa_eq(p_peek_kind(), hexa_str("Star"))) || hexa_truthy(hexa_eq(p_peek_kind(), hexa_str("Slash"))))) || hexa_truthy(hexa_eq(p_peek_kind(), hexa_str("Percent"))))) || hexa_truthy(hexa_eq(p_peek_kind(), hexa_str("Power")))))) {
        HexaVal op_tok = p_advance();
        HexaVal right = parse_unary();
        left = hexa_map_set(hexa_map_set(hexa_map_set(hexa_map_set(hexa_map_set(hexa_map_set(hexa_map_set(hexa_map_set(hexa_map_set(hexa_map_set(hexa_map_set(hexa_map_set(hexa_map_set(hexa_map_set(hexa_map_set(hexa_map_set(hexa_map_set(hexa_map_set(hexa_map_set(hexa_map_set(hexa_map_set(hexa_map_new(), "kind", hexa_str("BinOp")), "name", hexa_str("")), "value", hexa_str("")), "op", hexa_map_get(op_tok, "value")), "left", left), "right", right), "cond", hexa_str("")), "then_body", hexa_str("")), "else_body", hexa_str("")), "params", hexa_str("")), "body", hexa_str("")), "args", hexa_str("")), "fields", hexa_str("")), "items", hexa_str("")), "variants", hexa_str("")), "arms", hexa_str("")), "iter_expr", hexa_str("")), "ret_type", hexa_str("")), "target", hexa_str("")), "trait_name", hexa_str("")), "methods", hexa_str(""));
    }
    return left;
    return hexa_void();
}


HexaVal parse_unary(void) {
    HexaVal k = p_peek_kind();
    if (hexa_truthy(hexa_bool(hexa_truthy(hexa_bool(hexa_truthy(hexa_eq(k, hexa_str("Not"))) || hexa_truthy(hexa_eq(k, hexa_str("Minus"))))) || hexa_truthy(hexa_eq(k, hexa_str("BitNot")))))) {
        HexaVal op_tok = p_advance();
        HexaVal operand = parse_unary();
        return hexa_map_set(hexa_map_set(hexa_map_set(hexa_map_set(hexa_map_set(hexa_map_set(hexa_map_set(hexa_map_set(hexa_map_set(hexa_map_set(hexa_map_set(hexa_map_set(hexa_map_set(hexa_map_set(hexa_map_set(hexa_map_set(hexa_map_set(hexa_map_set(hexa_map_set(hexa_map_set(hexa_map_set(hexa_map_new(), "kind", hexa_str("UnaryOp")), "name", hexa_str("")), "value", hexa_str("")), "op", hexa_map_get(op_tok, "value")), "left", operand), "right", hexa_str("")), "cond", hexa_str("")), "then_body", hexa_str("")), "else_body", hexa_str("")), "params", hexa_str("")), "body", hexa_str("")), "args", hexa_str("")), "fields", hexa_str("")), "items", hexa_str("")), "variants", hexa_str("")), "arms", hexa_str("")), "iter_expr", hexa_str("")), "ret_type", hexa_str("")), "target", hexa_str("")), "trait_name", hexa_str("")), "methods", hexa_str(""));
    }
    return parse_postfix();
    return hexa_void();
}


HexaVal parse_postfix(void) {
    HexaVal expr = parse_primary();
    HexaVal cont = hexa_bool(1);
    while (hexa_truthy(cont)) {
        HexaVal k = p_peek_kind();
        if (hexa_truthy(hexa_eq(k, hexa_str("LParen")))) {
            p_advance();
            HexaVal args = parse_args();
            p_expect(hexa_str("RParen"));
            expr = hexa_map_set(hexa_map_set(hexa_map_set(hexa_map_set(hexa_map_set(hexa_map_set(hexa_map_set(hexa_map_set(hexa_map_set(hexa_map_set(hexa_map_set(hexa_map_set(hexa_map_set(hexa_map_set(hexa_map_set(hexa_map_set(hexa_map_set(hexa_map_set(hexa_map_set(hexa_map_set(hexa_map_set(hexa_map_new(), "kind", hexa_str("Call")), "name", hexa_str("")), "value", hexa_str("")), "op", hexa_str("")), "left", expr), "right", hexa_str("")), "cond", hexa_str("")), "then_body", hexa_str("")), "else_body", hexa_str("")), "params", hexa_str("")), "body", hexa_str("")), "args", args), "fields", hexa_str("")), "items", hexa_str("")), "variants", hexa_str("")), "arms", hexa_str("")), "iter_expr", hexa_str("")), "ret_type", hexa_str("")), "target", hexa_str("")), "trait_name", hexa_str("")), "methods", hexa_str(""));
        } else {
            if (hexa_truthy(hexa_eq(k, hexa_str("Dot")))) {
                p_advance();
                HexaVal field_name = p_expect_ident();
                expr = hexa_map_set(hexa_map_set(hexa_map_set(hexa_map_set(hexa_map_set(hexa_map_set(hexa_map_set(hexa_map_set(hexa_map_set(hexa_map_set(hexa_map_set(hexa_map_set(hexa_map_set(hexa_map_set(hexa_map_set(hexa_map_set(hexa_map_set(hexa_map_set(hexa_map_set(hexa_map_set(hexa_map_set(hexa_map_new(), "kind", hexa_str("Field")), "name", field_name), "value", hexa_str("")), "op", hexa_str("")), "left", expr), "right", hexa_str("")), "cond", hexa_str("")), "then_body", hexa_str("")), "else_body", hexa_str("")), "params", hexa_str("")), "body", hexa_str("")), "args", hexa_str("")), "fields", hexa_str("")), "items", hexa_str("")), "variants", hexa_str("")), "arms", hexa_str("")), "iter_expr", hexa_str("")), "ret_type", hexa_str("")), "target", hexa_str("")), "trait_name", hexa_str("")), "methods", hexa_str(""));
            } else {
                if (hexa_truthy(hexa_eq(k, hexa_str("LBracket")))) {
                    p_advance();
                    HexaVal index = parse_expr();
                    p_expect(hexa_str("RBracket"));
                    expr = hexa_map_set(hexa_map_set(hexa_map_set(hexa_map_set(hexa_map_set(hexa_map_set(hexa_map_set(hexa_map_set(hexa_map_set(hexa_map_set(hexa_map_set(hexa_map_set(hexa_map_set(hexa_map_set(hexa_map_set(hexa_map_set(hexa_map_set(hexa_map_set(hexa_map_set(hexa_map_set(hexa_map_set(hexa_map_new(), "kind", hexa_str("Index")), "name", hexa_str("")), "value", hexa_str("")), "op", hexa_str("")), "left", expr), "right", index), "cond", hexa_str("")), "then_body", hexa_str("")), "else_body", hexa_str("")), "params", hexa_str("")), "body", hexa_str("")), "args", hexa_str("")), "fields", hexa_str("")), "items", hexa_str("")), "variants", hexa_str("")), "arms", hexa_str("")), "iter_expr", hexa_str("")), "ret_type", hexa_str("")), "target", hexa_str("")), "trait_name", hexa_str("")), "methods", hexa_str(""));
                } else {
                    if (hexa_truthy(hexa_eq(k, hexa_str("DotDot")))) {
                        p_advance();
                        HexaVal end = parse_addition();
                        expr = hexa_map_set(hexa_map_set(hexa_map_set(hexa_map_set(hexa_map_set(hexa_map_set(hexa_map_set(hexa_map_set(hexa_map_set(hexa_map_set(hexa_map_set(hexa_map_set(hexa_map_set(hexa_map_set(hexa_map_set(hexa_map_set(hexa_map_set(hexa_map_set(hexa_map_set(hexa_map_set(hexa_map_set(hexa_map_new(), "kind", hexa_str("Range")), "name", hexa_str("")), "value", hexa_str("exclusive")), "op", hexa_str("")), "left", expr), "right", end), "cond", hexa_str("")), "then_body", hexa_str("")), "else_body", hexa_str("")), "params", hexa_str("")), "body", hexa_str("")), "args", hexa_str("")), "fields", hexa_str("")), "items", hexa_str("")), "variants", hexa_str("")), "arms", hexa_str("")), "iter_expr", hexa_str("")), "ret_type", hexa_str("")), "target", hexa_str("")), "trait_name", hexa_str("")), "methods", hexa_str(""));
                    } else {
                        if (hexa_truthy(hexa_eq(k, hexa_str("DotDotEq")))) {
                            p_advance();
                            HexaVal end = parse_addition();
                            expr = hexa_map_set(hexa_map_set(hexa_map_set(hexa_map_set(hexa_map_set(hexa_map_set(hexa_map_set(hexa_map_set(hexa_map_set(hexa_map_set(hexa_map_set(hexa_map_set(hexa_map_set(hexa_map_set(hexa_map_set(hexa_map_set(hexa_map_set(hexa_map_set(hexa_map_set(hexa_map_set(hexa_map_set(hexa_map_new(), "kind", hexa_str("Range")), "name", hexa_str("")), "value", hexa_str("inclusive")), "op", hexa_str("")), "left", expr), "right", end), "cond", hexa_str("")), "then_body", hexa_str("")), "else_body", hexa_str("")), "params", hexa_str("")), "body", hexa_str("")), "args", hexa_str("")), "fields", hexa_str("")), "items", hexa_str("")), "variants", hexa_str("")), "arms", hexa_str("")), "iter_expr", hexa_str("")), "ret_type", hexa_str("")), "target", hexa_str("")), "trait_name", hexa_str("")), "methods", hexa_str(""));
                        } else {
                            cont = hexa_bool(0);
                        }
                    }
                }
            }
        }
    }
    return expr;
    return hexa_void();
}


HexaVal parse_args(void) {
    HexaVal args = hexa_array_new();
    if (hexa_truthy(hexa_eq(p_peek_kind(), hexa_str("RParen")))) {
        return args;
    }
    args = hexa_array_push(args, parse_expr());
    while (hexa_truthy(hexa_eq(p_peek_kind(), hexa_str("Comma")))) {
        p_advance();
        args = hexa_array_push(args, parse_expr());
    }
    return args;
    return hexa_void();
}


HexaVal parse_primary(void) {
    HexaVal tok = p_peek();
    HexaVal k = hexa_map_get(tok, "kind");
    if (hexa_truthy(hexa_eq(k, hexa_str("IntLit")))) {
        p_advance();
        return node_int_lit(hexa_map_get(tok, "value"));
    }
    if (hexa_truthy(hexa_eq(k, hexa_str("FloatLit")))) {
        p_advance();
        return node_float_lit(hexa_map_get(tok, "value"));
    }
    if (hexa_truthy(hexa_eq(k, hexa_str("BoolLit")))) {
        p_advance();
        return node_bool_lit(hexa_map_get(tok, "value"));
    }
    if (hexa_truthy(hexa_eq(k, hexa_str("StringLit")))) {
        p_advance();
        return node_string_lit(hexa_map_get(tok, "value"));
    }
    if (hexa_truthy(hexa_eq(k, hexa_str("CharLit")))) {
        p_advance();
        return node_char_lit(hexa_map_get(tok, "value"));
    }
    if (hexa_truthy(hexa_eq(k, hexa_str("Ident")))) {
        p_advance();
        HexaVal name = hexa_map_get(tok, "value");
        if (hexa_truthy(hexa_eq(p_peek_kind(), hexa_str("ColonColon")))) {
            p_advance();
            HexaVal variant = p_expect_ident();
            return hexa_map_set(hexa_map_set(hexa_map_set(hexa_map_set(hexa_map_set(hexa_map_set(hexa_map_set(hexa_map_set(hexa_map_set(hexa_map_set(hexa_map_set(hexa_map_set(hexa_map_set(hexa_map_set(hexa_map_set(hexa_map_set(hexa_map_set(hexa_map_set(hexa_map_set(hexa_map_set(hexa_map_set(hexa_map_new(), "kind", hexa_str("EnumPath")), "name", name), "value", variant), "op", hexa_str("")), "left", hexa_str("")), "right", hexa_str("")), "cond", hexa_str("")), "then_body", hexa_str("")), "else_body", hexa_str("")), "params", hexa_str("")), "body", hexa_str("")), "args", hexa_str("")), "fields", hexa_str("")), "items", hexa_str("")), "variants", hexa_str("")), "arms", hexa_str("")), "iter_expr", hexa_str("")), "ret_type", hexa_str("")), "target", hexa_str("")), "trait_name", hexa_str("")), "methods", hexa_str(""));
        }
        HexaVal type_args = hexa_array_new();
        if (hexa_truthy(hexa_eq(p_peek_kind(), hexa_str("Lt")))) {
            HexaVal chars = hexa_str_chars(name);
            if (hexa_truthy(hexa_bool((hexa_int(hexa_len(chars))).i > (hexa_int(0)).i))) {
                HexaVal first_ch = hexa_index_get(chars, hexa_int(0));
                if (hexa_truthy(hexa_bool(hexa_truthy(hexa_bool((first_ch.tag==TAG_STR && first_ch.s && isalpha((unsigned char)first_ch.s[0])) || (first_ch.tag==TAG_CHAR && isalpha((unsigned char)first_ch.i)))) && hexa_truthy(hexa_eq(hexa_to_string(first_ch), hexa_str_to_upper(hexa_to_string(first_ch))))))) {
                    type_args = parse_type_params();
                }
            }
        }
        if (hexa_truthy(hexa_eq(p_peek_kind(), hexa_str("LBrace")))) {
            HexaVal chars = hexa_str_chars(name);
            if (hexa_truthy(hexa_bool((hexa_int(hexa_len(chars))).i > (hexa_int(0)).i))) {
                HexaVal first_ch = hexa_index_get(chars, hexa_int(0));
                if (hexa_truthy(hexa_bool(hexa_truthy(hexa_bool((first_ch.tag==TAG_STR && first_ch.s && isalpha((unsigned char)first_ch.s[0])) || (first_ch.tag==TAG_CHAR && isalpha((unsigned char)first_ch.i)))) && hexa_truthy(hexa_eq(hexa_to_string(first_ch), hexa_str_to_upper(hexa_to_string(first_ch))))))) {
                    p_advance();
                    p_skip_newlines();
                    HexaVal fields = hexa_array_new();
                    while (hexa_truthy(hexa_bool(hexa_truthy(hexa_bool(!hexa_truthy(hexa_eq(p_peek_kind(), hexa_str("RBrace"))))) && hexa_truthy(hexa_bool(!hexa_truthy(hexa_eq(p_peek_kind(), hexa_str("Eof")))))))) {
                        HexaVal fname = p_expect_ident();
                        p_expect(hexa_str("Colon"));
                        HexaVal fval = parse_expr();
                        fields = hexa_array_push(fields, hexa_map_set(hexa_map_set(hexa_map_set(hexa_map_set(hexa_map_set(hexa_map_set(hexa_map_set(hexa_map_set(hexa_map_set(hexa_map_set(hexa_map_set(hexa_map_set(hexa_map_set(hexa_map_set(hexa_map_set(hexa_map_set(hexa_map_set(hexa_map_set(hexa_map_set(hexa_map_set(hexa_map_set(hexa_map_new(), "kind", hexa_str("FieldInit")), "name", fname), "value", hexa_str("")), "op", hexa_str("")), "left", fval), "right", hexa_str("")), "cond", hexa_str("")), "then_body", hexa_str("")), "else_body", hexa_str("")), "params", hexa_str("")), "body", hexa_str("")), "args", hexa_str("")), "fields", hexa_str("")), "items", hexa_str("")), "variants", hexa_str("")), "arms", hexa_str("")), "iter_expr", hexa_str("")), "ret_type", hexa_str("")), "target", hexa_str("")), "trait_name", hexa_str("")), "methods", hexa_str("")));
                        if (hexa_truthy(hexa_eq(p_peek_kind(), hexa_str("Comma")))) {
                            p_advance();
                        }
                        p_skip_newlines();
                    }
                    p_expect(hexa_str("RBrace"));
                    return hexa_map_set(hexa_map_set(hexa_map_set(hexa_map_set(hexa_map_set(hexa_map_set(hexa_map_set(hexa_map_set(hexa_map_set(hexa_map_set(hexa_map_set(hexa_map_set(hexa_map_set(hexa_map_set(hexa_map_set(hexa_map_set(hexa_map_set(hexa_map_set(hexa_map_set(hexa_map_set(hexa_map_set(hexa_map_new(), "kind", hexa_str("StructInit")), "name", name), "value", hexa_str("")), "op", hexa_str("")), "left", hexa_str("")), "right", hexa_str("")), "cond", hexa_str("")), "then_body", hexa_str("")), "else_body", hexa_str("")), "params", hexa_str("")), "body", hexa_str("")), "args", hexa_str("")), "fields", fields), "items", type_args), "variants", hexa_str("")), "arms", hexa_str("")), "iter_expr", hexa_str("")), "ret_type", hexa_str("")), "target", hexa_str("")), "trait_name", hexa_str("")), "methods", hexa_str(""));
                }
            }
        }
        return node_ident(name);
    }
    if (hexa_truthy(hexa_eq(k, hexa_str("LParen")))) {
        p_advance();
        HexaVal expr = parse_expr();
        if (hexa_truthy(hexa_eq(p_peek_kind(), hexa_str("Comma")))) {
            HexaVal items = hexa_array_push(hexa_array_new(), expr);
            while (hexa_truthy(hexa_eq(p_peek_kind(), hexa_str("Comma")))) {
                p_advance();
                if (hexa_truthy(hexa_eq(p_peek_kind(), hexa_str("RParen")))) {
                } else {
                    items = hexa_array_push(items, parse_expr());
                }
            }
            p_expect(hexa_str("RParen"));
            return hexa_map_set(hexa_map_set(hexa_map_set(hexa_map_set(hexa_map_set(hexa_map_set(hexa_map_set(hexa_map_set(hexa_map_set(hexa_map_set(hexa_map_set(hexa_map_set(hexa_map_set(hexa_map_set(hexa_map_set(hexa_map_set(hexa_map_set(hexa_map_set(hexa_map_set(hexa_map_set(hexa_map_set(hexa_map_new(), "kind", hexa_str("Tuple")), "name", hexa_str("")), "value", hexa_str("")), "op", hexa_str("")), "left", hexa_str("")), "right", hexa_str("")), "cond", hexa_str("")), "then_body", hexa_str("")), "else_body", hexa_str("")), "params", hexa_str("")), "body", hexa_str("")), "args", hexa_str("")), "fields", hexa_str("")), "items", items), "variants", hexa_str("")), "arms", hexa_str("")), "iter_expr", hexa_str("")), "ret_type", hexa_str("")), "target", hexa_str("")), "trait_name", hexa_str("")), "methods", hexa_str(""));
        }
        p_expect(hexa_str("RParen"));
        return expr;
    }
    if (hexa_truthy(hexa_eq(k, hexa_str("LBracket")))) {
        p_advance();
        HexaVal items = hexa_array_new();
        while (hexa_truthy(hexa_bool(hexa_truthy(hexa_bool(!hexa_truthy(hexa_eq(p_peek_kind(), hexa_str("RBracket"))))) && hexa_truthy(hexa_bool(!hexa_truthy(hexa_eq(p_peek_kind(), hexa_str("Eof")))))))) {
            items = hexa_array_push(items, parse_expr());
            if (hexa_truthy(hexa_eq(p_peek_kind(), hexa_str("Comma")))) {
                p_advance();
            }
        }
        p_expect(hexa_str("RBracket"));
        return hexa_map_set(hexa_map_set(hexa_map_set(hexa_map_set(hexa_map_set(hexa_map_set(hexa_map_set(hexa_map_set(hexa_map_set(hexa_map_set(hexa_map_set(hexa_map_set(hexa_map_set(hexa_map_set(hexa_map_set(hexa_map_set(hexa_map_set(hexa_map_set(hexa_map_set(hexa_map_set(hexa_map_set(hexa_map_new(), "kind", hexa_str("Array")), "name", hexa_str("")), "value", hexa_str("")), "op", hexa_str("")), "left", hexa_str("")), "right", hexa_str("")), "cond", hexa_str("")), "then_body", hexa_str("")), "else_body", hexa_str("")), "params", hexa_str("")), "body", hexa_str("")), "args", hexa_str("")), "fields", hexa_str("")), "items", items), "variants", hexa_str("")), "arms", hexa_str("")), "iter_expr", hexa_str("")), "ret_type", hexa_str("")), "target", hexa_str("")), "trait_name", hexa_str("")), "methods", hexa_str(""));
    }
    if (hexa_truthy(hexa_eq(k, hexa_str("HashLBrace")))) {
        p_advance();
        p_skip_newlines();
        HexaVal items = hexa_array_new();
        while (hexa_truthy(hexa_bool(hexa_truthy(hexa_bool(!hexa_truthy(hexa_eq(p_peek_kind(), hexa_str("RBrace"))))) && hexa_truthy(hexa_bool(!hexa_truthy(hexa_eq(p_peek_kind(), hexa_str("Eof")))))))) {
            HexaVal key_expr = parse_expr();
            p_expect(hexa_str("Colon"));
            HexaVal val_expr = parse_expr();
            items = hexa_array_push(items, hexa_map_set(hexa_map_set(hexa_map_set(hexa_map_set(hexa_map_set(hexa_map_set(hexa_map_set(hexa_map_set(hexa_map_set(hexa_map_set(hexa_map_set(hexa_map_set(hexa_map_set(hexa_map_set(hexa_map_set(hexa_map_set(hexa_map_set(hexa_map_set(hexa_map_set(hexa_map_set(hexa_map_set(hexa_map_new(), "kind", hexa_str("MapEntry")), "name", hexa_str("")), "value", hexa_str("")), "op", hexa_str("")), "left", key_expr), "right", val_expr), "cond", hexa_str("")), "then_body", hexa_str("")), "else_body", hexa_str("")), "params", hexa_str("")), "body", hexa_str("")), "args", hexa_str("")), "fields", hexa_str("")), "items", hexa_str("")), "variants", hexa_str("")), "arms", hexa_str("")), "iter_expr", hexa_str("")), "ret_type", hexa_str("")), "target", hexa_str("")), "trait_name", hexa_str("")), "methods", hexa_str("")));
            if (hexa_truthy(hexa_eq(p_peek_kind(), hexa_str("Comma")))) {
                p_advance();
            }
            p_skip_newlines();
        }
        p_expect(hexa_str("RBrace"));
        return hexa_map_set(hexa_map_set(hexa_map_set(hexa_map_set(hexa_map_set(hexa_map_set(hexa_map_set(hexa_map_set(hexa_map_set(hexa_map_set(hexa_map_set(hexa_map_set(hexa_map_set(hexa_map_set(hexa_map_set(hexa_map_set(hexa_map_set(hexa_map_set(hexa_map_set(hexa_map_set(hexa_map_set(hexa_map_new(), "kind", hexa_str("MapLit")), "name", hexa_str("")), "value", hexa_str("")), "op", hexa_str("")), "left", hexa_str("")), "right", hexa_str("")), "cond", hexa_str("")), "then_body", hexa_str("")), "else_body", hexa_str("")), "params", hexa_str("")), "body", hexa_str("")), "args", hexa_str("")), "fields", hexa_str("")), "items", items), "variants", hexa_str("")), "arms", hexa_str("")), "iter_expr", hexa_str("")), "ret_type", hexa_str("")), "target", hexa_str("")), "trait_name", hexa_str("")), "methods", hexa_str(""));
    }
    if (hexa_truthy(hexa_eq(k, hexa_str("If")))) {
        return parse_if_expr();
    }
    if (hexa_truthy(hexa_eq(k, hexa_str("Match")))) {
        return parse_match_expr();
    }
    if (hexa_truthy(hexa_eq(k, hexa_str("BitOr")))) {
        p_advance();
        HexaVal lparams = hexa_array_new();
        if (hexa_truthy(hexa_bool(!hexa_truthy(hexa_eq(p_peek_kind(), hexa_str("BitOr")))))) {
            lparams = hexa_array_push(lparams, p_expect_ident());
            while (hexa_truthy(hexa_eq(p_peek_kind(), hexa_str("Comma")))) {
                p_advance();
                lparams = hexa_array_push(lparams, p_expect_ident());
            }
        }
        p_expect(hexa_str("BitOr"));
        HexaVal lbody = hexa_str("");
        if (hexa_truthy(hexa_eq(p_peek_kind(), hexa_str("LBrace")))) {
            lbody = parse_block();
        } else {
            lbody = parse_expr();
        }
        return hexa_map_set(hexa_map_set(hexa_map_set(hexa_map_set(hexa_map_set(hexa_map_set(hexa_map_set(hexa_map_set(hexa_map_set(hexa_map_set(hexa_map_set(hexa_map_set(hexa_map_set(hexa_map_set(hexa_map_set(hexa_map_set(hexa_map_set(hexa_map_set(hexa_map_set(hexa_map_set(hexa_map_set(hexa_map_new(), "kind", hexa_str("Lambda")), "name", hexa_str("")), "value", hexa_str("")), "op", hexa_str("")), "left", lbody), "right", hexa_str("")), "cond", hexa_str("")), "then_body", hexa_str("")), "else_body", hexa_str("")), "params", lparams), "body", hexa_str("")), "args", hexa_str("")), "fields", hexa_str("")), "items", hexa_str("")), "variants", hexa_str("")), "arms", hexa_str("")), "iter_expr", hexa_str("")), "ret_type", hexa_str("")), "target", hexa_str("")), "trait_name", hexa_str("")), "methods", hexa_str(""));
    }
    HexaVal msg3 = hexa_add(hexa_add(hexa_add(hexa_add(hexa_str("unexpected token "), hexa_map_get(tok, "kind")), hexa_str(" ('")), hexa_map_get(tok, "value")), hexa_str("')"));
    p_record_error(hexa_map_get(tok, "line"), hexa_map_get(tok, "col"), msg3);
    hexa_println(hexa_add(hexa_add(hexa_add(hexa_add(hexa_add(hexa_str("Parse error at "), hexa_to_string(hexa_map_get(tok, "line"))), hexa_str(":")), hexa_to_string(hexa_map_get(tok, "col"))), hexa_str(": ")), msg3));
    p_advance();
    return empty_node();
    return hexa_void();
}


HexaVal parse_try_catch(void) {
    p_advance();
    HexaVal try_body = parse_block();
    p_skip_newlines();
    p_expect(hexa_str("Catch"));
    HexaVal catch_var = hexa_str("_");
    if (hexa_truthy(hexa_eq(p_peek_kind(), hexa_str("LParen")))) {
        p_advance();
        catch_var = p_expect_ident();
        p_expect(hexa_str("RParen"));
    } else {
        if (hexa_truthy(hexa_eq(p_peek_kind(), hexa_str("Ident")))) {
            catch_var = p_expect_ident();
        }
    }
    HexaVal catch_body = parse_block();
    return hexa_map_set(hexa_map_set(hexa_map_set(hexa_map_set(hexa_map_set(hexa_map_set(hexa_map_set(hexa_map_set(hexa_map_set(hexa_map_set(hexa_map_set(hexa_map_set(hexa_map_set(hexa_map_set(hexa_map_set(hexa_map_set(hexa_map_set(hexa_map_set(hexa_map_set(hexa_map_set(hexa_map_set(hexa_map_new(), "kind", hexa_str("TryCatch")), "name", catch_var), "value", hexa_str("")), "op", hexa_str("")), "left", try_body), "right", catch_body), "cond", hexa_str("")), "then_body", hexa_str("")), "else_body", hexa_str("")), "params", hexa_str("")), "body", hexa_str("")), "args", hexa_str("")), "fields", hexa_str("")), "items", hexa_str("")), "variants", hexa_str("")), "arms", hexa_str("")), "iter_expr", hexa_str("")), "ret_type", hexa_str("")), "target", hexa_str("")), "trait_name", hexa_str("")), "methods", hexa_str(""));
    return hexa_void();
}


HexaVal parse_throw_stmt(void) {
    p_advance();
    HexaVal expr = parse_expr();
    return hexa_map_set(hexa_map_set(hexa_map_set(hexa_map_set(hexa_map_set(hexa_map_set(hexa_map_set(hexa_map_set(hexa_map_set(hexa_map_set(hexa_map_set(hexa_map_set(hexa_map_set(hexa_map_set(hexa_map_set(hexa_map_set(hexa_map_set(hexa_map_set(hexa_map_set(hexa_map_set(hexa_map_set(hexa_map_new(), "kind", hexa_str("ThrowStmt")), "name", hexa_str("")), "value", hexa_str("")), "op", hexa_str("")), "left", expr), "right", hexa_str("")), "cond", hexa_str("")), "then_body", hexa_str("")), "else_body", hexa_str("")), "params", hexa_str("")), "body", hexa_str("")), "args", hexa_str("")), "fields", hexa_str("")), "items", hexa_str("")), "variants", hexa_str("")), "arms", hexa_str("")), "iter_expr", hexa_str("")), "ret_type", hexa_str("")), "target", hexa_str("")), "trait_name", hexa_str("")), "methods", hexa_str(""));
    return hexa_void();
}


HexaVal parse_panic_stmt(void) {
    p_advance();
    p_expect(hexa_str("LParen"));
    HexaVal msg = parse_expr();
    p_expect(hexa_str("RParen"));
    return hexa_map_set(hexa_map_set(hexa_map_set(hexa_map_set(hexa_map_set(hexa_map_set(hexa_map_set(hexa_map_set(hexa_map_set(hexa_map_set(hexa_map_set(hexa_map_set(hexa_map_set(hexa_map_set(hexa_map_set(hexa_map_set(hexa_map_set(hexa_map_set(hexa_map_set(hexa_map_set(hexa_map_set(hexa_map_new(), "kind", hexa_str("PanicStmt")), "name", hexa_str("")), "value", hexa_str("")), "op", hexa_str("")), "left", msg), "right", hexa_str("")), "cond", hexa_str("")), "then_body", hexa_str("")), "else_body", hexa_str("")), "params", hexa_str("")), "body", hexa_str("")), "args", hexa_str("")), "fields", hexa_str("")), "items", hexa_str("")), "variants", hexa_str("")), "arms", hexa_str("")), "iter_expr", hexa_str("")), "ret_type", hexa_str("")), "target", hexa_str("")), "trait_name", hexa_str("")), "methods", hexa_str(""));
    return hexa_void();
}


HexaVal parse_recover_stmt(void) {
    p_advance();
    HexaVal catch_var = hexa_str("_");
    if (hexa_truthy(hexa_eq(p_peek_kind(), hexa_str("BitOr")))) {
        p_advance();
        catch_var = p_expect_ident();
        p_expect(hexa_str("BitOr"));
    }
    HexaVal body = parse_block();
    return hexa_map_set(hexa_map_set(hexa_map_set(hexa_map_set(hexa_map_set(hexa_map_set(hexa_map_set(hexa_map_set(hexa_map_set(hexa_map_set(hexa_map_set(hexa_map_set(hexa_map_set(hexa_map_set(hexa_map_set(hexa_map_set(hexa_map_set(hexa_map_set(hexa_map_set(hexa_map_set(hexa_map_set(hexa_map_new(), "kind", hexa_str("RecoverStmt")), "name", catch_var), "value", hexa_str("")), "op", hexa_str("")), "left", body), "right", hexa_str("")), "cond", hexa_str("")), "then_body", hexa_str("")), "else_body", hexa_str("")), "params", hexa_str("")), "body", hexa_str("")), "args", hexa_str("")), "fields", hexa_str("")), "items", hexa_str("")), "variants", hexa_str("")), "arms", hexa_str("")), "iter_expr", hexa_str("")), "ret_type", hexa_str("")), "target", hexa_str("")), "trait_name", hexa_str("")), "methods", hexa_str(""));
    return hexa_void();
}


HexaVal parse_drop_stmt(void) {
    p_advance();
    p_expect(hexa_str("LParen"));
    HexaVal var_name = p_expect_ident();
    p_expect(hexa_str("RParen"));
    return hexa_map_set(hexa_map_set(hexa_map_set(hexa_map_set(hexa_map_set(hexa_map_set(hexa_map_set(hexa_map_set(hexa_map_set(hexa_map_set(hexa_map_set(hexa_map_set(hexa_map_set(hexa_map_set(hexa_map_set(hexa_map_set(hexa_map_set(hexa_map_set(hexa_map_set(hexa_map_set(hexa_map_set(hexa_map_new(), "kind", hexa_str("DropStmt")), "name", var_name), "value", hexa_str("")), "op", hexa_str("")), "left", hexa_str("")), "right", hexa_str("")), "cond", hexa_str("")), "then_body", hexa_str("")), "else_body", hexa_str("")), "params", hexa_str("")), "body", hexa_str("")), "args", hexa_str("")), "fields", hexa_str("")), "items", hexa_str("")), "variants", hexa_str("")), "arms", hexa_str("")), "iter_expr", hexa_str("")), "ret_type", hexa_str("")), "target", hexa_str("")), "trait_name", hexa_str("")), "methods", hexa_str(""));
    return hexa_void();
}


HexaVal parse_spawn_stmt(void) {
    p_advance();
    HexaVal body = parse_block();
    return hexa_map_set(hexa_map_set(hexa_map_set(hexa_map_set(hexa_map_set(hexa_map_set(hexa_map_set(hexa_map_set(hexa_map_set(hexa_map_set(hexa_map_set(hexa_map_set(hexa_map_set(hexa_map_set(hexa_map_set(hexa_map_set(hexa_map_set(hexa_map_set(hexa_map_set(hexa_map_set(hexa_map_set(hexa_map_new(), "kind", hexa_str("SpawnStmt")), "name", hexa_str("")), "value", hexa_str("")), "op", hexa_str("")), "left", hexa_str("")), "right", hexa_str("")), "cond", hexa_str("")), "then_body", hexa_str("")), "else_body", hexa_str("")), "params", hexa_str("")), "body", body), "args", hexa_str("")), "fields", hexa_str("")), "items", hexa_str("")), "variants", hexa_str("")), "arms", hexa_str("")), "iter_expr", hexa_str("")), "ret_type", hexa_str("")), "target", hexa_str("")), "trait_name", hexa_str("")), "methods", hexa_str(""));
    return hexa_void();
}


HexaVal parse_scope_stmt(void) {
    p_advance();
    HexaVal body = parse_block();
    return hexa_map_set(hexa_map_set(hexa_map_set(hexa_map_set(hexa_map_set(hexa_map_set(hexa_map_set(hexa_map_set(hexa_map_set(hexa_map_set(hexa_map_set(hexa_map_set(hexa_map_set(hexa_map_set(hexa_map_set(hexa_map_set(hexa_map_set(hexa_map_set(hexa_map_set(hexa_map_set(hexa_map_set(hexa_map_new(), "kind", hexa_str("ScopeStmt")), "name", hexa_str("")), "value", hexa_str("")), "op", hexa_str("")), "left", hexa_str("")), "right", hexa_str("")), "cond", hexa_str("")), "then_body", hexa_str("")), "else_body", hexa_str("")), "params", hexa_str("")), "body", body), "args", hexa_str("")), "fields", hexa_str("")), "items", hexa_str("")), "variants", hexa_str("")), "arms", hexa_str("")), "iter_expr", hexa_str("")), "ret_type", hexa_str("")), "target", hexa_str("")), "trait_name", hexa_str("")), "methods", hexa_str(""));
    return hexa_void();
}


HexaVal parse_select_stmt(void) {
    p_advance();
    p_expect(hexa_str("LBrace"));
    p_skip_newlines();
    HexaVal arms = hexa_array_new();
    while (hexa_truthy(hexa_bool(hexa_truthy(hexa_bool(!hexa_truthy(hexa_eq(p_peek_kind(), hexa_str("RBrace"))))) && hexa_truthy(hexa_bool(!hexa_truthy(hexa_eq(p_peek_kind(), hexa_str("Eof")))))))) {
        HexaVal expr = parse_expr();
        p_expect(hexa_str("Arrow"));
        HexaVal body = parse_block();
        arms = hexa_array_push(arms, hexa_map_set(hexa_map_set(hexa_map_set(hexa_map_set(hexa_map_set(hexa_map_set(hexa_map_set(hexa_map_set(hexa_map_set(hexa_map_set(hexa_map_set(hexa_map_set(hexa_map_set(hexa_map_set(hexa_map_set(hexa_map_set(hexa_map_set(hexa_map_set(hexa_map_set(hexa_map_set(hexa_map_set(hexa_map_new(), "kind", hexa_str("SelectArm")), "name", hexa_str("")), "value", hexa_str("")), "op", hexa_str("")), "left", expr), "right", hexa_str("")), "cond", hexa_str("")), "then_body", hexa_str("")), "else_body", hexa_str("")), "params", hexa_str("")), "body", body), "args", hexa_str("")), "fields", hexa_str("")), "items", hexa_str("")), "variants", hexa_str("")), "arms", hexa_str("")), "iter_expr", hexa_str("")), "ret_type", hexa_str("")), "target", hexa_str("")), "trait_name", hexa_str("")), "methods", hexa_str("")));
        p_skip_newlines();
    }
    p_expect(hexa_str("RBrace"));
    return hexa_map_set(hexa_map_set(hexa_map_set(hexa_map_set(hexa_map_set(hexa_map_set(hexa_map_set(hexa_map_set(hexa_map_set(hexa_map_set(hexa_map_set(hexa_map_set(hexa_map_set(hexa_map_set(hexa_map_set(hexa_map_set(hexa_map_set(hexa_map_set(hexa_map_set(hexa_map_set(hexa_map_set(hexa_map_new(), "kind", hexa_str("SelectStmt")), "name", hexa_str("")), "value", hexa_str("")), "op", hexa_str("")), "left", hexa_str("")), "right", hexa_str("")), "cond", hexa_str("")), "then_body", hexa_str("")), "else_body", hexa_str("")), "params", hexa_str("")), "body", hexa_str("")), "args", hexa_str("")), "fields", hexa_str("")), "items", hexa_str("")), "variants", hexa_str("")), "arms", arms), "iter_expr", hexa_str("")), "ret_type", hexa_str("")), "target", hexa_str("")), "trait_name", hexa_str("")), "methods", hexa_str(""));
    return hexa_void();
}


HexaVal parse_async_fn(void) {
    p_advance();
    p_expect(hexa_str("Fn"));
    HexaVal name = p_expect_ident();
    p_expect(hexa_str("LParen"));
    HexaVal params = parse_params();
    p_expect(hexa_str("RParen"));
    HexaVal ret = hexa_str("");
    if (hexa_truthy(hexa_eq(p_peek_kind(), hexa_str("Arrow")))) {
        p_advance();
        ret = p_expect_ident();
    }
    HexaVal body = parse_block();
    return hexa_map_set(hexa_map_set(hexa_map_set(hexa_map_set(hexa_map_set(hexa_map_set(hexa_map_set(hexa_map_set(hexa_map_set(hexa_map_set(hexa_map_set(hexa_map_set(hexa_map_set(hexa_map_set(hexa_map_set(hexa_map_set(hexa_map_set(hexa_map_set(hexa_map_set(hexa_map_set(hexa_map_set(hexa_map_new(), "kind", hexa_str("AsyncFnDecl")), "name", name), "value", hexa_str("")), "op", hexa_str("")), "left", hexa_str("")), "right", hexa_str("")), "cond", hexa_str("")), "then_body", hexa_str("")), "else_body", hexa_str("")), "params", params), "body", body), "args", hexa_str("")), "fields", hexa_str("")), "items", hexa_str("")), "variants", hexa_str("")), "arms", hexa_str("")), "iter_expr", hexa_str("")), "ret_type", ret), "target", hexa_str("")), "trait_name", hexa_str("")), "methods", hexa_str(""));
    return hexa_void();
}


HexaVal parse_attribute_prefix(void) {
    HexaVal attr = p_advance();
    HexaVal attr_name = hexa_map_get(attr, "value");
    if (hexa_truthy(hexa_bool(hexa_truthy(hexa_eq(attr_name, hexa_str("symbol"))) || hexa_truthy(hexa_eq(attr_name, hexa_str("link")))))) {
        p_expect(hexa_str("LParen"));
        HexaVal tok = p_advance();
        HexaVal val = hexa_map_get(tok, "value");
        p_expect(hexa_str("RParen"));
        if (hexa_truthy(hexa_eq(attr_name, hexa_str("symbol")))) {
            p_pending_symbol = val;
        } else {
            p_pending_link = val;
        }
        p_skip_newlines();
        return parse_stmt();
    }
    if (hexa_truthy(hexa_eq(p_peek_kind(), hexa_str("LParen")))) {
        p_advance();
        HexaVal depth = hexa_int(1);
        while (hexa_truthy(hexa_bool(hexa_truthy(hexa_bool((depth).i > (hexa_int(0)).i)) && hexa_truthy(hexa_bool(!hexa_truthy(hexa_eq(p_peek_kind(), hexa_str("Eof")))))))) {
            if (hexa_truthy(hexa_eq(p_peek_kind(), hexa_str("LParen")))) {
                depth = hexa_add(depth, hexa_int(1));
            }
            if (hexa_truthy(hexa_eq(p_peek_kind(), hexa_str("RParen")))) {
                depth = hexa_int((depth).i - (hexa_int(1)).i);
            }
            p_advance();
        }
    }
    p_skip_newlines();
    return parse_stmt();
    return hexa_void();
}


HexaVal parse_extern_fn(void) {
    p_advance();
    p_expect(hexa_str("Fn"));
    HexaVal name = p_expect_ident();
    p_expect(hexa_str("LParen"));
    HexaVal params = parse_params();
    p_expect(hexa_str("RParen"));
    HexaVal ret = hexa_str("");
    if (hexa_truthy(hexa_eq(p_peek_kind(), hexa_str("Arrow")))) {
        p_advance();
        ret = parse_type_annotation();
    }
    HexaVal body = hexa_array_new();
    if (hexa_truthy(hexa_eq(p_peek_kind(), hexa_str("LBrace")))) {
        body = parse_block();
    }
    HexaVal sym = p_pending_symbol;
    HexaVal link = p_pending_link;
    p_pending_symbol = hexa_str("");
    p_pending_link = hexa_str("");
    return hexa_map_set(hexa_map_set(hexa_map_set(hexa_map_set(hexa_map_set(hexa_map_set(hexa_map_set(hexa_map_set(hexa_map_set(hexa_map_set(hexa_map_set(hexa_map_set(hexa_map_set(hexa_map_set(hexa_map_set(hexa_map_set(hexa_map_set(hexa_map_set(hexa_map_set(hexa_map_set(hexa_map_set(hexa_map_new(), "kind", hexa_str("ExternFnDecl")), "name", name), "value", sym), "op", link), "left", hexa_str("")), "right", hexa_str("")), "cond", hexa_str("")), "then_body", hexa_str("")), "else_body", hexa_str("")), "params", params), "body", body), "args", hexa_str("")), "fields", hexa_str("")), "items", hexa_str("")), "variants", hexa_str("")), "arms", hexa_str("")), "iter_expr", hexa_str("")), "ret_type", ret), "target", hexa_str("")), "trait_name", hexa_str("")), "methods", hexa_str(""));
    return hexa_void();
}


HexaVal parse_type_alias(void) {
    p_advance();
    HexaVal name = p_expect_ident();
    p_expect(hexa_str("Eq"));
    HexaVal typ = p_expect_ident();
    return hexa_map_set(hexa_map_set(hexa_map_set(hexa_map_set(hexa_map_set(hexa_map_set(hexa_map_set(hexa_map_set(hexa_map_set(hexa_map_set(hexa_map_set(hexa_map_set(hexa_map_set(hexa_map_set(hexa_map_set(hexa_map_set(hexa_map_set(hexa_map_set(hexa_map_set(hexa_map_set(hexa_map_set(hexa_map_new(), "kind", hexa_str("TypeAlias")), "name", name), "value", typ), "op", hexa_str("")), "left", hexa_str("")), "right", hexa_str("")), "cond", hexa_str("")), "then_body", hexa_str("")), "else_body", hexa_str("")), "params", hexa_str("")), "body", hexa_str("")), "args", hexa_str("")), "fields", hexa_str("")), "items", hexa_str("")), "variants", hexa_str("")), "arms", hexa_str("")), "iter_expr", hexa_str("")), "ret_type", hexa_str("")), "target", hexa_str("")), "trait_name", hexa_str("")), "methods", hexa_str(""));
    return hexa_void();
}


HexaVal parse_atomic_let(void) {
    p_advance();
    p_expect(hexa_str("Let"));
    HexaVal name = p_expect_ident();
    p_expect(hexa_str("Eq"));
    HexaVal expr = parse_expr();
    return hexa_map_set(hexa_map_set(hexa_map_set(hexa_map_set(hexa_map_set(hexa_map_set(hexa_map_set(hexa_map_set(hexa_map_set(hexa_map_set(hexa_map_set(hexa_map_set(hexa_map_set(hexa_map_set(hexa_map_set(hexa_map_set(hexa_map_set(hexa_map_set(hexa_map_set(hexa_map_set(hexa_map_set(hexa_map_new(), "kind", hexa_str("AtomicLet")), "name", name), "value", hexa_str("")), "op", hexa_str("")), "left", expr), "right", hexa_str("")), "cond", hexa_str("")), "then_body", hexa_str("")), "else_body", hexa_str("")), "params", hexa_str("")), "body", hexa_str("")), "args", hexa_str("")), "fields", hexa_str("")), "items", hexa_str("")), "variants", hexa_str("")), "arms", hexa_str("")), "iter_expr", hexa_str("")), "ret_type", hexa_str("")), "target", hexa_str("")), "trait_name", hexa_str("")), "methods", hexa_str(""));
    return hexa_void();
}


HexaVal parse_break_stmt(void) {
    p_advance();
    return hexa_map_set(hexa_map_set(hexa_map_set(hexa_map_set(hexa_map_set(hexa_map_set(hexa_map_set(hexa_map_set(hexa_map_set(hexa_map_set(hexa_map_set(hexa_map_set(hexa_map_set(hexa_map_set(hexa_map_set(hexa_map_set(hexa_map_set(hexa_map_set(hexa_map_set(hexa_map_set(hexa_map_set(hexa_map_new(), "kind", hexa_str("BreakStmt")), "name", hexa_str("")), "value", hexa_str("")), "op", hexa_str("")), "left", hexa_str("")), "right", hexa_str("")), "cond", hexa_str("")), "then_body", hexa_str("")), "else_body", hexa_str("")), "params", hexa_str("")), "body", hexa_str("")), "args", hexa_str("")), "fields", hexa_str("")), "items", hexa_str("")), "variants", hexa_str("")), "arms", hexa_str("")), "iter_expr", hexa_str("")), "ret_type", hexa_str("")), "target", hexa_str("")), "trait_name", hexa_str("")), "methods", hexa_str(""));
    return hexa_void();
}


HexaVal parse_continue_stmt(void) {
    p_advance();
    return hexa_map_set(hexa_map_set(hexa_map_set(hexa_map_set(hexa_map_set(hexa_map_set(hexa_map_set(hexa_map_set(hexa_map_set(hexa_map_set(hexa_map_set(hexa_map_set(hexa_map_set(hexa_map_set(hexa_map_set(hexa_map_set(hexa_map_set(hexa_map_set(hexa_map_set(hexa_map_set(hexa_map_set(hexa_map_new(), "kind", hexa_str("ContinueStmt")), "name", hexa_str("")), "value", hexa_str("")), "op", hexa_str("")), "left", hexa_str("")), "right", hexa_str("")), "cond", hexa_str("")), "then_body", hexa_str("")), "else_body", hexa_str("")), "params", hexa_str("")), "body", hexa_str("")), "args", hexa_str("")), "fields", hexa_str("")), "items", hexa_str("")), "variants", hexa_str("")), "arms", hexa_str("")), "iter_expr", hexa_str("")), "ret_type", hexa_str("")), "target", hexa_str("")), "trait_name", hexa_str("")), "methods", hexa_str(""));
    return hexa_void();
}


HexaVal parse_yield_stmt(void) {
    p_advance();
    HexaVal expr = hexa_str("");
    if (hexa_truthy(hexa_bool(hexa_truthy(hexa_bool(hexa_truthy(hexa_bool(!hexa_truthy(hexa_eq(p_peek_kind(), hexa_str("Newline"))))) && hexa_truthy(hexa_bool(!hexa_truthy(hexa_eq(p_peek_kind(), hexa_str("RBrace"))))))) && hexa_truthy(hexa_bool(!hexa_truthy(hexa_eq(p_peek_kind(), hexa_str("Eof")))))))) {
        expr = parse_expr();
    }
    return hexa_map_set(hexa_map_set(hexa_map_set(hexa_map_set(hexa_map_set(hexa_map_set(hexa_map_set(hexa_map_set(hexa_map_set(hexa_map_set(hexa_map_set(hexa_map_set(hexa_map_set(hexa_map_set(hexa_map_set(hexa_map_set(hexa_map_set(hexa_map_set(hexa_map_set(hexa_map_set(hexa_map_set(hexa_map_new(), "kind", hexa_str("YieldStmt")), "name", hexa_str("")), "value", hexa_str("")), "op", hexa_str("")), "left", expr), "right", hexa_str("")), "cond", hexa_str("")), "then_body", hexa_str("")), "else_body", hexa_str("")), "params", hexa_str("")), "body", hexa_str("")), "args", hexa_str("")), "fields", hexa_str("")), "items", hexa_str("")), "variants", hexa_str("")), "arms", hexa_str("")), "iter_expr", hexa_str("")), "ret_type", hexa_str("")), "target", hexa_str("")), "trait_name", hexa_str("")), "methods", hexa_str(""));
    return hexa_void();
}


HexaVal parse_comptime_stmt(void) {
    p_advance();
    HexaVal next = p_peek_kind();
    if (hexa_truthy(hexa_eq(next, hexa_str("Fn")))) {
        p_advance();
        HexaVal name = p_expect_ident();
        p_expect(hexa_str("LParen"));
        HexaVal params = parse_params();
        p_expect(hexa_str("RParen"));
        HexaVal ret = hexa_str("");
        if (hexa_truthy(hexa_eq(p_peek_kind(), hexa_str("Arrow")))) {
            p_advance();
            ret = p_expect_ident();
        }
        HexaVal body = parse_block();
        return hexa_map_set(hexa_map_set(hexa_map_set(hexa_map_set(hexa_map_set(hexa_map_set(hexa_map_set(hexa_map_set(hexa_map_set(hexa_map_set(hexa_map_set(hexa_map_set(hexa_map_set(hexa_map_set(hexa_map_set(hexa_map_set(hexa_map_set(hexa_map_set(hexa_map_set(hexa_map_set(hexa_map_set(hexa_map_new(), "kind", hexa_str("ComptimeFnDecl")), "name", name), "value", hexa_str("")), "op", hexa_str("")), "left", hexa_str("")), "right", hexa_str("")), "cond", hexa_str("")), "then_body", hexa_str("")), "else_body", hexa_str("")), "params", params), "body", body), "args", hexa_str("")), "fields", hexa_str("")), "items", hexa_str("")), "variants", hexa_str("")), "arms", hexa_str("")), "iter_expr", hexa_str("")), "ret_type", ret), "target", hexa_str("")), "trait_name", hexa_str("")), "methods", hexa_str(""));
    }
    if (hexa_truthy(hexa_eq(next, hexa_str("Const")))) {
        p_advance();
        HexaVal name = p_expect_ident();
        HexaVal typ = hexa_str("");
        if (hexa_truthy(hexa_eq(p_peek_kind(), hexa_str("Colon")))) {
            p_advance();
            typ = p_expect_ident();
        }
        p_expect(hexa_str("Eq"));
        HexaVal expr = parse_expr();
        return hexa_map_set(hexa_map_set(hexa_map_set(hexa_map_set(hexa_map_set(hexa_map_set(hexa_map_set(hexa_map_set(hexa_map_set(hexa_map_set(hexa_map_set(hexa_map_set(hexa_map_set(hexa_map_set(hexa_map_set(hexa_map_set(hexa_map_set(hexa_map_set(hexa_map_set(hexa_map_set(hexa_map_set(hexa_map_new(), "kind", hexa_str("ComptimeConst")), "name", name), "value", typ), "op", hexa_str("")), "left", expr), "right", hexa_str("")), "cond", hexa_str("")), "then_body", hexa_str("")), "else_body", hexa_str("")), "params", hexa_str("")), "body", hexa_str("")), "args", hexa_str("")), "fields", hexa_str("")), "items", hexa_str("")), "variants", hexa_str("")), "arms", hexa_str("")), "iter_expr", hexa_str("")), "ret_type", hexa_str("")), "target", hexa_str("")), "trait_name", hexa_str("")), "methods", hexa_str(""));
    }
    if (hexa_truthy(hexa_eq(next, hexa_str("Let")))) {
        p_advance();
        if (hexa_truthy(hexa_eq(p_peek_kind(), hexa_str("Mut")))) {
            p_advance();
        }
        HexaVal name = p_expect_ident();
        HexaVal typ = hexa_str("");
        if (hexa_truthy(hexa_eq(p_peek_kind(), hexa_str("Colon")))) {
            p_advance();
            typ = p_expect_ident();
        }
        p_expect(hexa_str("Eq"));
        HexaVal expr = parse_expr();
        return hexa_map_set(hexa_map_set(hexa_map_set(hexa_map_set(hexa_map_set(hexa_map_set(hexa_map_set(hexa_map_set(hexa_map_set(hexa_map_set(hexa_map_set(hexa_map_set(hexa_map_set(hexa_map_set(hexa_map_set(hexa_map_set(hexa_map_set(hexa_map_set(hexa_map_set(hexa_map_set(hexa_map_set(hexa_map_new(), "kind", hexa_str("ComptimeLet")), "name", name), "value", typ), "op", hexa_str("")), "left", expr), "right", hexa_str("")), "cond", hexa_str("")), "then_body", hexa_str("")), "else_body", hexa_str("")), "params", hexa_str("")), "body", hexa_str("")), "args", hexa_str("")), "fields", hexa_str("")), "items", hexa_str("")), "variants", hexa_str("")), "arms", hexa_str("")), "iter_expr", hexa_str("")), "ret_type", hexa_str("")), "target", hexa_str("")), "trait_name", hexa_str("")), "methods", hexa_str(""));
    }
    if (hexa_truthy(hexa_eq(next, hexa_str("Assert")))) {
        p_advance();
        HexaVal expr = parse_expr();
        return hexa_map_set(hexa_map_set(hexa_map_set(hexa_map_set(hexa_map_set(hexa_map_set(hexa_map_set(hexa_map_set(hexa_map_set(hexa_map_set(hexa_map_set(hexa_map_set(hexa_map_set(hexa_map_set(hexa_map_set(hexa_map_set(hexa_map_set(hexa_map_set(hexa_map_set(hexa_map_set(hexa_map_set(hexa_map_new(), "kind", hexa_str("ComptimeAssert")), "name", hexa_str("")), "value", hexa_str("")), "op", hexa_str("")), "left", expr), "right", hexa_str("")), "cond", hexa_str("")), "then_body", hexa_str("")), "else_body", hexa_str("")), "params", hexa_str("")), "body", hexa_str("")), "args", hexa_str("")), "fields", hexa_str("")), "items", hexa_str("")), "variants", hexa_str("")), "arms", hexa_str("")), "iter_expr", hexa_str("")), "ret_type", hexa_str("")), "target", hexa_str("")), "trait_name", hexa_str("")), "methods", hexa_str(""));
    }
    HexaVal body = parse_block();
    return hexa_map_set(hexa_map_set(hexa_map_set(hexa_map_set(hexa_map_set(hexa_map_set(hexa_map_set(hexa_map_set(hexa_map_set(hexa_map_set(hexa_map_set(hexa_map_set(hexa_map_set(hexa_map_set(hexa_map_set(hexa_map_set(hexa_map_set(hexa_map_set(hexa_map_set(hexa_map_set(hexa_map_set(hexa_map_new(), "kind", hexa_str("ComptimeBlock")), "name", hexa_str("")), "value", hexa_str("")), "op", hexa_str("")), "left", hexa_str("")), "right", hexa_str("")), "cond", hexa_str("")), "then_body", hexa_str("")), "else_body", hexa_str("")), "params", hexa_str("")), "body", body), "args", hexa_str("")), "fields", hexa_str("")), "items", hexa_str("")), "variants", hexa_str("")), "arms", hexa_str("")), "iter_expr", hexa_str("")), "ret_type", hexa_str("")), "target", hexa_str("")), "trait_name", hexa_str("")), "methods", hexa_str(""));
    return hexa_void();
}


HexaVal parse_intent_stmt(void) {
    p_advance();
    HexaVal desc = hexa_str("");
    if (hexa_truthy(hexa_eq(p_peek_kind(), hexa_str("StringLit")))) {
        desc = hexa_map_get(p_advance(), "value");
    } else {
        desc = p_expect_ident();
    }
    p_expect(hexa_str("LBrace"));
    p_skip_newlines();
    HexaVal fields = hexa_array_new();
    while (hexa_truthy(hexa_bool(hexa_truthy(hexa_bool(!hexa_truthy(hexa_eq(p_peek_kind(), hexa_str("RBrace"))))) && hexa_truthy(hexa_bool(!hexa_truthy(hexa_eq(p_peek_kind(), hexa_str("Eof")))))))) {
        HexaVal key = p_expect_ident();
        p_expect(hexa_str("Colon"));
        HexaVal val = parse_expr();
        fields = hexa_array_push(fields, hexa_map_set(hexa_map_set(hexa_map_set(hexa_map_set(hexa_map_set(hexa_map_set(hexa_map_set(hexa_map_set(hexa_map_set(hexa_map_set(hexa_map_set(hexa_map_set(hexa_map_set(hexa_map_set(hexa_map_set(hexa_map_set(hexa_map_set(hexa_map_set(hexa_map_set(hexa_map_set(hexa_map_set(hexa_map_new(), "kind", hexa_str("IntentField")), "name", key), "value", hexa_str("")), "op", hexa_str("")), "left", val), "right", hexa_str("")), "cond", hexa_str("")), "then_body", hexa_str("")), "else_body", hexa_str("")), "params", hexa_str("")), "body", hexa_str("")), "args", hexa_str("")), "fields", hexa_str("")), "items", hexa_str("")), "variants", hexa_str("")), "arms", hexa_str("")), "iter_expr", hexa_str("")), "ret_type", hexa_str("")), "target", hexa_str("")), "trait_name", hexa_str("")), "methods", hexa_str("")));
        if (hexa_truthy(hexa_eq(p_peek_kind(), hexa_str("Comma")))) {
            p_advance();
        }
        p_skip_newlines();
    }
    p_expect(hexa_str("RBrace"));
    return hexa_map_set(hexa_map_set(hexa_map_set(hexa_map_set(hexa_map_set(hexa_map_set(hexa_map_set(hexa_map_set(hexa_map_set(hexa_map_set(hexa_map_set(hexa_map_set(hexa_map_set(hexa_map_set(hexa_map_set(hexa_map_set(hexa_map_set(hexa_map_set(hexa_map_set(hexa_map_set(hexa_map_set(hexa_map_new(), "kind", hexa_str("IntentStmt")), "name", desc), "value", hexa_str("")), "op", hexa_str("")), "left", hexa_str("")), "right", hexa_str("")), "cond", hexa_str("")), "then_body", hexa_str("")), "else_body", hexa_str("")), "params", hexa_str("")), "body", hexa_str("")), "args", hexa_str("")), "fields", fields), "items", hexa_str("")), "variants", hexa_str("")), "arms", hexa_str("")), "iter_expr", hexa_str("")), "ret_type", hexa_str("")), "target", hexa_str("")), "trait_name", hexa_str("")), "methods", hexa_str(""));
    return hexa_void();
}


HexaVal parse_verify_stmt(void) {
    p_advance();
    HexaVal name = hexa_str("");
    if (hexa_truthy(hexa_eq(p_peek_kind(), hexa_str("StringLit")))) {
        name = hexa_map_get(p_advance(), "value");
    } else {
        name = p_expect_ident();
    }
    HexaVal body = parse_block();
    return hexa_map_set(hexa_map_set(hexa_map_set(hexa_map_set(hexa_map_set(hexa_map_set(hexa_map_set(hexa_map_set(hexa_map_set(hexa_map_set(hexa_map_set(hexa_map_set(hexa_map_set(hexa_map_set(hexa_map_set(hexa_map_set(hexa_map_set(hexa_map_set(hexa_map_set(hexa_map_set(hexa_map_set(hexa_map_new(), "kind", hexa_str("VerifyStmt")), "name", name), "value", hexa_str("")), "op", hexa_str("")), "left", hexa_str("")), "right", hexa_str("")), "cond", hexa_str("")), "then_body", hexa_str("")), "else_body", hexa_str("")), "params", hexa_str("")), "body", body), "args", hexa_str("")), "fields", hexa_str("")), "items", hexa_str("")), "variants", hexa_str("")), "arms", hexa_str("")), "iter_expr", hexa_str("")), "ret_type", hexa_str("")), "target", hexa_str("")), "trait_name", hexa_str("")), "methods", hexa_str(""));
    return hexa_void();
}


HexaVal parse_generate_stmt(void) {
    p_advance();
    if (hexa_truthy(hexa_eq(p_peek_kind(), hexa_str("Fn")))) {
        p_advance();
        HexaVal name = p_expect_ident();
        p_expect(hexa_str("LParen"));
        HexaVal params = parse_params();
        p_expect(hexa_str("RParen"));
        HexaVal ret = hexa_str("");
        if (hexa_truthy(hexa_eq(p_peek_kind(), hexa_str("Arrow")))) {
            p_advance();
            ret = p_expect_ident();
        }
        p_expect(hexa_str("LBrace"));
        p_skip_newlines();
        HexaVal desc = hexa_str("");
        if (hexa_truthy(hexa_eq(p_peek_kind(), hexa_str("StringLit")))) {
            desc = hexa_map_get(p_advance(), "value");
        }
        p_skip_newlines();
        p_expect(hexa_str("RBrace"));
        return hexa_map_set(hexa_map_set(hexa_map_set(hexa_map_set(hexa_map_set(hexa_map_set(hexa_map_set(hexa_map_set(hexa_map_set(hexa_map_set(hexa_map_set(hexa_map_set(hexa_map_set(hexa_map_set(hexa_map_set(hexa_map_set(hexa_map_set(hexa_map_set(hexa_map_set(hexa_map_set(hexa_map_set(hexa_map_new(), "kind", hexa_str("GenerateFnStmt")), "name", name), "value", desc), "op", hexa_str("")), "left", hexa_str("")), "right", hexa_str("")), "cond", hexa_str("")), "then_body", hexa_str("")), "else_body", hexa_str("")), "params", params), "body", hexa_str("")), "args", hexa_str("")), "fields", hexa_str("")), "items", hexa_str("")), "variants", hexa_str("")), "arms", hexa_str("")), "iter_expr", hexa_str("")), "ret_type", ret), "target", hexa_str("")), "trait_name", hexa_str("")), "methods", hexa_str(""));
    }
    HexaVal type_hint = hexa_str("");
    if (hexa_truthy(hexa_bool(!hexa_truthy(hexa_eq(p_peek_kind(), hexa_str("LBrace")))))) {
        type_hint = p_expect_ident();
    }
    p_expect(hexa_str("LBrace"));
    p_skip_newlines();
    HexaVal desc = hexa_str("");
    if (hexa_truthy(hexa_eq(p_peek_kind(), hexa_str("StringLit")))) {
        desc = hexa_map_get(p_advance(), "value");
    }
    p_skip_newlines();
    p_expect(hexa_str("RBrace"));
    return hexa_map_set(hexa_map_set(hexa_map_set(hexa_map_set(hexa_map_set(hexa_map_set(hexa_map_set(hexa_map_set(hexa_map_set(hexa_map_set(hexa_map_set(hexa_map_set(hexa_map_set(hexa_map_set(hexa_map_set(hexa_map_set(hexa_map_set(hexa_map_set(hexa_map_set(hexa_map_set(hexa_map_set(hexa_map_new(), "kind", hexa_str("GenerateStmt")), "name", type_hint), "value", desc), "op", hexa_str("")), "left", hexa_str("")), "right", hexa_str("")), "cond", hexa_str("")), "then_body", hexa_str("")), "else_body", hexa_str("")), "params", hexa_str("")), "body", hexa_str("")), "args", hexa_str("")), "fields", hexa_str("")), "items", hexa_str("")), "variants", hexa_str("")), "arms", hexa_str("")), "iter_expr", hexa_str("")), "ret_type", hexa_str("")), "target", hexa_str("")), "trait_name", hexa_str("")), "methods", hexa_str(""));
    return hexa_void();
}


HexaVal parse_optimize_stmt(void) {
    p_advance();
    p_expect(hexa_str("Fn"));
    HexaVal name = p_expect_ident();
    p_expect(hexa_str("LParen"));
    HexaVal params = parse_params();
    p_expect(hexa_str("RParen"));
    HexaVal ret = hexa_str("");
    if (hexa_truthy(hexa_eq(p_peek_kind(), hexa_str("Arrow")))) {
        p_advance();
        ret = p_expect_ident();
    }
    HexaVal body = parse_block();
    return hexa_map_set(hexa_map_set(hexa_map_set(hexa_map_set(hexa_map_set(hexa_map_set(hexa_map_set(hexa_map_set(hexa_map_set(hexa_map_set(hexa_map_set(hexa_map_set(hexa_map_set(hexa_map_set(hexa_map_set(hexa_map_set(hexa_map_set(hexa_map_set(hexa_map_set(hexa_map_set(hexa_map_set(hexa_map_new(), "kind", hexa_str("OptimizeFnStmt")), "name", name), "value", hexa_str("")), "op", hexa_str("")), "left", hexa_str("")), "right", hexa_str("")), "cond", hexa_str("")), "then_body", hexa_str("")), "else_body", hexa_str("")), "params", params), "body", body), "args", hexa_str("")), "fields", hexa_str("")), "items", hexa_str("")), "variants", hexa_str("")), "arms", hexa_str("")), "iter_expr", hexa_str("")), "ret_type", ret), "target", hexa_str("")), "trait_name", hexa_str("")), "methods", hexa_str(""));
    return hexa_void();
}


HexaVal parse_effect_decl(void) {
    p_advance();
    HexaVal name = p_expect_ident();
    HexaVal tparams = hexa_array_new();
    if (hexa_truthy(hexa_eq(p_peek_kind(), hexa_str("Lt")))) {
        tparams = parse_type_params();
    }
    p_skip_newlines();
    p_expect(hexa_str("LBrace"));
    p_skip_newlines();
    HexaVal ops = hexa_array_new();
    while (hexa_truthy(hexa_bool(hexa_truthy(hexa_bool(!hexa_truthy(hexa_eq(p_peek_kind(), hexa_str("RBrace"))))) && hexa_truthy(hexa_bool(!hexa_truthy(hexa_eq(p_peek_kind(), hexa_str("Eof")))))))) {
        p_expect(hexa_str("Fn"));
        HexaVal op_name = p_expect_ident();
        p_expect(hexa_str("LParen"));
        HexaVal op_params = parse_params();
        p_expect(hexa_str("RParen"));
        HexaVal op_ret = hexa_str("");
        if (hexa_truthy(hexa_eq(p_peek_kind(), hexa_str("Arrow")))) {
            p_advance();
            op_ret = p_expect_ident();
        }
        ops = hexa_array_push(ops, hexa_map_set(hexa_map_set(hexa_map_set(hexa_map_set(hexa_map_set(hexa_map_set(hexa_map_set(hexa_map_set(hexa_map_set(hexa_map_set(hexa_map_set(hexa_map_set(hexa_map_set(hexa_map_set(hexa_map_set(hexa_map_set(hexa_map_set(hexa_map_set(hexa_map_set(hexa_map_set(hexa_map_set(hexa_map_new(), "kind", hexa_str("EffectOp")), "name", op_name), "value", hexa_str("")), "op", hexa_str("")), "left", hexa_str("")), "right", hexa_str("")), "cond", hexa_str("")), "then_body", hexa_str("")), "else_body", hexa_str("")), "params", op_params), "body", hexa_str("")), "args", hexa_str("")), "fields", hexa_str("")), "items", hexa_str("")), "variants", hexa_str("")), "arms", hexa_str("")), "iter_expr", hexa_str("")), "ret_type", op_ret), "target", hexa_str("")), "trait_name", hexa_str("")), "methods", hexa_str("")));
        p_skip_newlines();
    }
    p_expect(hexa_str("RBrace"));
    return hexa_map_set(hexa_map_set(hexa_map_set(hexa_map_set(hexa_map_set(hexa_map_set(hexa_map_set(hexa_map_set(hexa_map_set(hexa_map_set(hexa_map_set(hexa_map_set(hexa_map_set(hexa_map_set(hexa_map_set(hexa_map_set(hexa_map_set(hexa_map_set(hexa_map_set(hexa_map_set(hexa_map_set(hexa_map_new(), "kind", hexa_str("EffectDecl")), "name", name), "value", hexa_str("")), "op", hexa_str("")), "left", hexa_str("")), "right", hexa_str("")), "cond", hexa_str("")), "then_body", hexa_str("")), "else_body", hexa_str("")), "params", tparams), "body", hexa_str("")), "args", hexa_str("")), "fields", hexa_str("")), "items", ops), "variants", hexa_str("")), "arms", hexa_str("")), "iter_expr", hexa_str("")), "ret_type", hexa_str("")), "target", hexa_str("")), "trait_name", hexa_str("")), "methods", hexa_str(""));
    return hexa_void();
}


HexaVal parse_pure_fn(void) {
    p_advance();
    p_expect(hexa_str("Fn"));
    HexaVal name = p_expect_ident();
    p_expect(hexa_str("LParen"));
    HexaVal params = parse_params();
    p_expect(hexa_str("RParen"));
    HexaVal ret = hexa_str("");
    if (hexa_truthy(hexa_eq(p_peek_kind(), hexa_str("Arrow")))) {
        p_advance();
        ret = p_expect_ident();
    }
    HexaVal body = parse_block();
    return hexa_map_set(hexa_map_set(hexa_map_set(hexa_map_set(hexa_map_set(hexa_map_set(hexa_map_set(hexa_map_set(hexa_map_set(hexa_map_set(hexa_map_set(hexa_map_set(hexa_map_set(hexa_map_set(hexa_map_set(hexa_map_set(hexa_map_set(hexa_map_set(hexa_map_set(hexa_map_set(hexa_map_set(hexa_map_new(), "kind", hexa_str("PureFnDecl")), "name", name), "value", hexa_str("")), "op", hexa_str("")), "left", hexa_str("")), "right", hexa_str("")), "cond", hexa_str("")), "then_body", hexa_str("")), "else_body", hexa_str("")), "params", params), "body", body), "args", hexa_str("")), "fields", hexa_str("")), "items", hexa_str("")), "variants", hexa_str("")), "arms", hexa_str("")), "iter_expr", hexa_str("")), "ret_type", ret), "target", hexa_str("")), "trait_name", hexa_str("")), "methods", hexa_str(""));
    return hexa_void();
}


HexaVal parse_macro_def(void) {
    p_advance();
    if (hexa_truthy(hexa_eq(p_peek_kind(), hexa_str("Not")))) {
        p_advance();
    }
    HexaVal name = p_expect_ident();
    p_expect(hexa_str("LBrace"));
    p_skip_newlines();
    HexaVal rules = hexa_array_new();
    while (hexa_truthy(hexa_bool(hexa_truthy(hexa_bool(!hexa_truthy(hexa_eq(p_peek_kind(), hexa_str("RBrace"))))) && hexa_truthy(hexa_bool(!hexa_truthy(hexa_eq(p_peek_kind(), hexa_str("Eof")))))))) {
        p_expect(hexa_str("LParen"));
        p_skip_newlines();
        HexaVal pat_tokens = hexa_array_new();
        while (hexa_truthy(hexa_bool(hexa_truthy(hexa_bool(!hexa_truthy(hexa_eq(p_peek_kind(), hexa_str("RParen"))))) && hexa_truthy(hexa_bool(!hexa_truthy(hexa_eq(p_peek_kind(), hexa_str("Eof")))))))) {
            HexaVal tok = p_advance();
            pat_tokens = hexa_array_push(pat_tokens, hexa_map_get(tok, "value"));
            p_skip_newlines();
        }
        p_expect(hexa_str("RParen"));
        if (hexa_truthy(hexa_eq(p_peek_kind(), hexa_str("Eq")))) {
            p_advance();
            if (hexa_truthy(hexa_eq(p_peek_kind(), hexa_str("Gt")))) {
                p_advance();
            }
        }
        HexaVal body = parse_block();
        rules = hexa_array_push(rules, hexa_map_set(hexa_map_set(hexa_map_set(hexa_map_set(hexa_map_set(hexa_map_set(hexa_map_set(hexa_map_set(hexa_map_set(hexa_map_set(hexa_map_set(hexa_map_set(hexa_map_set(hexa_map_set(hexa_map_set(hexa_map_set(hexa_map_set(hexa_map_set(hexa_map_set(hexa_map_set(hexa_map_set(hexa_map_new(), "kind", hexa_str("MacroRule")), "name", hexa_str("")), "value", hexa_str("")), "op", hexa_str("")), "left", hexa_str("")), "right", hexa_str("")), "cond", hexa_str("")), "then_body", hexa_str("")), "else_body", hexa_str("")), "params", pat_tokens), "body", body), "args", hexa_str("")), "fields", hexa_str("")), "items", hexa_str("")), "variants", hexa_str("")), "arms", hexa_str("")), "iter_expr", hexa_str("")), "ret_type", hexa_str("")), "target", hexa_str("")), "trait_name", hexa_str("")), "methods", hexa_str("")));
        if (hexa_truthy(hexa_bool(hexa_truthy(hexa_eq(p_peek_kind(), hexa_str("Comma"))) || hexa_truthy(hexa_eq(p_peek_kind(), hexa_str("Semicolon")))))) {
            p_advance();
        }
        p_skip_newlines();
    }
    p_expect(hexa_str("RBrace"));
    return hexa_map_set(hexa_map_set(hexa_map_set(hexa_map_set(hexa_map_set(hexa_map_set(hexa_map_set(hexa_map_set(hexa_map_set(hexa_map_set(hexa_map_set(hexa_map_set(hexa_map_set(hexa_map_set(hexa_map_set(hexa_map_set(hexa_map_set(hexa_map_set(hexa_map_set(hexa_map_set(hexa_map_set(hexa_map_new(), "kind", hexa_str("MacroDef")), "name", name), "value", hexa_str("")), "op", hexa_str("")), "left", hexa_str("")), "right", hexa_str("")), "cond", hexa_str("")), "then_body", hexa_str("")), "else_body", hexa_str("")), "params", hexa_str("")), "body", hexa_str("")), "args", hexa_str("")), "fields", hexa_str("")), "items", rules), "variants", hexa_str("")), "arms", hexa_str("")), "iter_expr", hexa_str("")), "ret_type", hexa_str("")), "target", hexa_str("")), "trait_name", hexa_str("")), "methods", hexa_str(""));
    return hexa_void();
}


HexaVal parse_derive_decl(void) {
    p_advance();
    p_expect(hexa_str("LParen"));
    HexaVal traits = hexa_array_new();
    traits = hexa_array_push(traits, p_expect_ident());
    while (hexa_truthy(hexa_eq(p_peek_kind(), hexa_str("Comma")))) {
        p_advance();
        traits = hexa_array_push(traits, p_expect_ident());
    }
    p_expect(hexa_str("RParen"));
    if (hexa_truthy(hexa_eq(p_peek_kind(), hexa_str("For")))) {
        p_advance();
    } else {
        p_expect_ident();
    }
    HexaVal type_name = p_expect_ident();
    return hexa_map_set(hexa_map_set(hexa_map_set(hexa_map_set(hexa_map_set(hexa_map_set(hexa_map_set(hexa_map_set(hexa_map_set(hexa_map_set(hexa_map_set(hexa_map_set(hexa_map_set(hexa_map_set(hexa_map_set(hexa_map_set(hexa_map_set(hexa_map_set(hexa_map_set(hexa_map_set(hexa_map_set(hexa_map_new(), "kind", hexa_str("DeriveDecl")), "name", type_name), "value", hexa_str("")), "op", hexa_str("")), "left", hexa_str("")), "right", hexa_str("")), "cond", hexa_str("")), "then_body", hexa_str("")), "else_body", hexa_str("")), "params", hexa_str("")), "body", hexa_str("")), "args", hexa_str("")), "fields", hexa_str("")), "items", traits), "variants", hexa_str("")), "arms", hexa_str("")), "iter_expr", hexa_str("")), "ret_type", hexa_str("")), "target", hexa_str("")), "trait_name", hexa_str("")), "methods", hexa_str(""));
    return hexa_void();
}


HexaVal parse_theorem_stmt(void) {
    p_advance();
    HexaVal name = p_expect_ident();
    p_expect(hexa_str("LBrace"));
    p_skip_newlines();
    HexaVal stmts = hexa_array_new();
    while (hexa_truthy(hexa_bool(hexa_truthy(hexa_bool(!hexa_truthy(hexa_eq(p_peek_kind(), hexa_str("RBrace"))))) && hexa_truthy(hexa_bool(!hexa_truthy(hexa_eq(p_peek_kind(), hexa_str("Eof")))))))) {
        stmts = hexa_array_push(stmts, parse_stmt());
        p_skip_newlines();
    }
    p_expect(hexa_str("RBrace"));
    return hexa_map_set(hexa_map_set(hexa_map_set(hexa_map_set(hexa_map_set(hexa_map_set(hexa_map_set(hexa_map_set(hexa_map_set(hexa_map_set(hexa_map_set(hexa_map_set(hexa_map_set(hexa_map_set(hexa_map_set(hexa_map_set(hexa_map_set(hexa_map_set(hexa_map_set(hexa_map_set(hexa_map_set(hexa_map_new(), "kind", hexa_str("TheoremStmt")), "name", name), "value", hexa_str("")), "op", hexa_str("")), "left", hexa_str("")), "right", hexa_str("")), "cond", hexa_str("")), "then_body", hexa_str("")), "else_body", hexa_str("")), "params", hexa_str("")), "body", stmts), "args", hexa_str("")), "fields", hexa_str("")), "items", hexa_str("")), "variants", hexa_str("")), "arms", hexa_str("")), "iter_expr", hexa_str("")), "ret_type", hexa_str("")), "target", hexa_str("")), "trait_name", hexa_str("")), "methods", hexa_str(""));
    return hexa_void();
}


HexaVal parse_handle_stmt(void) {
    p_advance();
    HexaVal body = parse_block();
    p_skip_newlines();
    p_expect_ident();
    p_skip_newlines();
    p_expect(hexa_str("LBrace"));
    p_skip_newlines();
    HexaVal handlers = hexa_array_new();
    while (hexa_truthy(hexa_bool(hexa_truthy(hexa_bool(!hexa_truthy(hexa_eq(p_peek_kind(), hexa_str("RBrace"))))) && hexa_truthy(hexa_bool(!hexa_truthy(hexa_eq(p_peek_kind(), hexa_str("Eof")))))))) {
        HexaVal effect_name = p_expect_ident();
        p_expect(hexa_str("Dot"));
        HexaVal op_name = p_expect_ident();
        HexaVal hparams = hexa_array_new();
        if (hexa_truthy(hexa_eq(p_peek_kind(), hexa_str("LParen")))) {
            p_advance();
            while (hexa_truthy(hexa_bool(hexa_truthy(hexa_bool(!hexa_truthy(hexa_eq(p_peek_kind(), hexa_str("RParen"))))) && hexa_truthy(hexa_bool(!hexa_truthy(hexa_eq(p_peek_kind(), hexa_str("Eof")))))))) {
                hparams = hexa_array_push(hparams, p_expect_ident());
                if (hexa_truthy(hexa_eq(p_peek_kind(), hexa_str("Comma")))) {
                    p_advance();
                }
            }
            p_expect(hexa_str("RParen"));
        }
        if (hexa_truthy(hexa_eq(p_peek_kind(), hexa_str("Eq")))) {
            p_advance();
            if (hexa_truthy(hexa_eq(p_peek_kind(), hexa_str("Gt")))) {
                p_advance();
            }
        }
        HexaVal hbody = parse_block();
        handlers = hexa_array_push(handlers, hexa_map_set(hexa_map_set(hexa_map_set(hexa_map_set(hexa_map_set(hexa_map_set(hexa_map_set(hexa_map_set(hexa_map_set(hexa_map_set(hexa_map_set(hexa_map_set(hexa_map_set(hexa_map_set(hexa_map_set(hexa_map_set(hexa_map_set(hexa_map_set(hexa_map_set(hexa_map_set(hexa_map_set(hexa_map_new(), "kind", hexa_str("EffectHandler")), "name", op_name), "value", hexa_str("")), "op", hexa_str("")), "left", hexa_str("")), "right", hexa_str("")), "cond", hexa_str("")), "then_body", hexa_str("")), "else_body", hexa_str("")), "params", hparams), "body", hbody), "args", hexa_str("")), "fields", hexa_str("")), "items", hexa_str("")), "variants", hexa_str("")), "arms", hexa_str("")), "iter_expr", hexa_str("")), "ret_type", hexa_str("")), "target", effect_name), "trait_name", hexa_str("")), "methods", hexa_str("")));
        p_skip_newlines();
    }
    p_expect(hexa_str("RBrace"));
    return hexa_map_set(hexa_map_set(hexa_map_set(hexa_map_set(hexa_map_set(hexa_map_set(hexa_map_set(hexa_map_set(hexa_map_set(hexa_map_set(hexa_map_set(hexa_map_set(hexa_map_set(hexa_map_set(hexa_map_set(hexa_map_set(hexa_map_set(hexa_map_set(hexa_map_set(hexa_map_set(hexa_map_set(hexa_map_new(), "kind", hexa_str("HandleWithStmt")), "name", hexa_str("")), "value", hexa_str("")), "op", hexa_str("")), "left", hexa_str("")), "right", hexa_str("")), "cond", hexa_str("")), "then_body", hexa_str("")), "else_body", hexa_str("")), "params", hexa_str("")), "body", body), "args", hexa_str("")), "fields", hexa_str("")), "items", handlers), "variants", hexa_str("")), "arms", hexa_str("")), "iter_expr", hexa_str("")), "ret_type", hexa_str("")), "target", hexa_str("")), "trait_name", hexa_str("")), "methods", hexa_str(""));
    return hexa_void();
}


HexaVal parse_visibility(void) {
    if (hexa_truthy(hexa_eq(p_peek_kind(), hexa_str("Pub")))) {
        p_advance();
        if (hexa_truthy(hexa_eq(p_peek_kind(), hexa_str("LParen")))) {
            p_advance();
            HexaVal vis_scope = p_expect_ident();
            p_expect(hexa_str("RParen"));
            return vis_scope;
        }
        return hexa_str("pub");
    }
    return hexa_str("private");
    return hexa_void();
}


HexaVal parse_type_params(void) {
    if (hexa_truthy(hexa_bool(!hexa_truthy(hexa_eq(p_peek_kind(), hexa_str("Lt")))))) {
        return hexa_array_new();
    }
    p_advance();
    HexaVal tparams = hexa_array_new();
    HexaVal name = p_expect_ident();
    HexaVal bound = hexa_str("");
    if (hexa_truthy(hexa_eq(p_peek_kind(), hexa_str("Colon")))) {
        p_advance();
        bound = p_expect_ident();
    }
    tparams = hexa_array_push(tparams, hexa_map_set(hexa_map_set(hexa_map_set(hexa_map_set(hexa_map_set(hexa_map_set(hexa_map_set(hexa_map_set(hexa_map_set(hexa_map_set(hexa_map_set(hexa_map_set(hexa_map_set(hexa_map_set(hexa_map_set(hexa_map_set(hexa_map_set(hexa_map_set(hexa_map_set(hexa_map_set(hexa_map_set(hexa_map_new(), "kind", hexa_str("TypeParam")), "name", name), "value", bound), "op", hexa_str("")), "left", hexa_str("")), "right", hexa_str("")), "cond", hexa_str("")), "then_body", hexa_str("")), "else_body", hexa_str("")), "params", hexa_str("")), "body", hexa_str("")), "args", hexa_str("")), "fields", hexa_str("")), "items", hexa_str("")), "variants", hexa_str("")), "arms", hexa_str("")), "iter_expr", hexa_str("")), "ret_type", hexa_str("")), "target", hexa_str("")), "trait_name", hexa_str("")), "methods", hexa_str("")));
    while (hexa_truthy(hexa_eq(p_peek_kind(), hexa_str("Comma")))) {
        p_advance();
        HexaVal pname = p_expect_ident();
        HexaVal pbound = hexa_str("");
        if (hexa_truthy(hexa_eq(p_peek_kind(), hexa_str("Colon")))) {
            p_advance();
            pbound = p_expect_ident();
        }
        tparams = hexa_array_push(tparams, hexa_map_set(hexa_map_set(hexa_map_set(hexa_map_set(hexa_map_set(hexa_map_set(hexa_map_set(hexa_map_set(hexa_map_set(hexa_map_set(hexa_map_set(hexa_map_set(hexa_map_set(hexa_map_set(hexa_map_set(hexa_map_set(hexa_map_set(hexa_map_set(hexa_map_set(hexa_map_set(hexa_map_set(hexa_map_new(), "kind", hexa_str("TypeParam")), "name", pname), "value", pbound), "op", hexa_str("")), "left", hexa_str("")), "right", hexa_str("")), "cond", hexa_str("")), "then_body", hexa_str("")), "else_body", hexa_str("")), "params", hexa_str("")), "body", hexa_str("")), "args", hexa_str("")), "fields", hexa_str("")), "items", hexa_str("")), "variants", hexa_str("")), "arms", hexa_str("")), "iter_expr", hexa_str("")), "ret_type", hexa_str("")), "target", hexa_str("")), "trait_name", hexa_str("")), "methods", hexa_str("")));
    }
    p_expect(hexa_str("Gt"));
    return tparams;
    return hexa_void();
}


HexaVal parse_where_clauses(void) {
    if (hexa_truthy(hexa_bool(!hexa_truthy(hexa_eq(p_peek_kind(), hexa_str("Where")))))) {
        return hexa_array_new();
    }
    p_advance();
    HexaVal clauses = hexa_array_new();
    HexaVal tname = p_expect_ident();
    p_expect(hexa_str("Colon"));
    HexaVal tbound = p_expect_ident();
    clauses = hexa_array_push(clauses, hexa_map_set(hexa_map_set(hexa_map_set(hexa_map_set(hexa_map_set(hexa_map_set(hexa_map_set(hexa_map_set(hexa_map_set(hexa_map_set(hexa_map_set(hexa_map_set(hexa_map_set(hexa_map_set(hexa_map_set(hexa_map_set(hexa_map_set(hexa_map_set(hexa_map_set(hexa_map_set(hexa_map_set(hexa_map_new(), "kind", hexa_str("WhereClause")), "name", tname), "value", tbound), "op", hexa_str("")), "left", hexa_str("")), "right", hexa_str("")), "cond", hexa_str("")), "then_body", hexa_str("")), "else_body", hexa_str("")), "params", hexa_str("")), "body", hexa_str("")), "args", hexa_str("")), "fields", hexa_str("")), "items", hexa_str("")), "variants", hexa_str("")), "arms", hexa_str("")), "iter_expr", hexa_str("")), "ret_type", hexa_str("")), "target", hexa_str("")), "trait_name", hexa_str("")), "methods", hexa_str("")));
    while (hexa_truthy(hexa_eq(p_peek_kind(), hexa_str("Comma")))) {
        p_advance();
        HexaVal wname = p_expect_ident();
        p_expect(hexa_str("Colon"));
        HexaVal wbound = p_expect_ident();
        clauses = hexa_array_push(clauses, hexa_map_set(hexa_map_set(hexa_map_set(hexa_map_set(hexa_map_set(hexa_map_set(hexa_map_set(hexa_map_set(hexa_map_set(hexa_map_set(hexa_map_set(hexa_map_set(hexa_map_set(hexa_map_set(hexa_map_set(hexa_map_set(hexa_map_set(hexa_map_set(hexa_map_set(hexa_map_set(hexa_map_set(hexa_map_new(), "kind", hexa_str("WhereClause")), "name", wname), "value", wbound), "op", hexa_str("")), "left", hexa_str("")), "right", hexa_str("")), "cond", hexa_str("")), "then_body", hexa_str("")), "else_body", hexa_str("")), "params", hexa_str("")), "body", hexa_str("")), "args", hexa_str("")), "fields", hexa_str("")), "items", hexa_str("")), "variants", hexa_str("")), "arms", hexa_str("")), "iter_expr", hexa_str("")), "ret_type", hexa_str("")), "target", hexa_str("")), "trait_name", hexa_str("")), "methods", hexa_str("")));
    }
    return clauses;
    return hexa_void();
}


HexaVal ast_to_string(HexaVal node, HexaVal indent) {
    HexaVal pad = hexa_str("");
    HexaVal i = hexa_int(0);
    while (hexa_truthy(hexa_bool((i).i < (indent).i))) {
        pad = hexa_add(pad, hexa_str("  "));
        i = hexa_add(i, hexa_int(1));
    }
    HexaVal k = hexa_map_get(node, "kind");
    if (hexa_truthy(hexa_eq(k, hexa_str("IntLit")))) {
        return hexa_add(hexa_add(hexa_add(pad, hexa_str("IntLit(")), hexa_map_get(node, "value")), hexa_str(")"));
    }
    if (hexa_truthy(hexa_eq(k, hexa_str("FloatLit")))) {
        return hexa_add(hexa_add(hexa_add(pad, hexa_str("FloatLit(")), hexa_map_get(node, "value")), hexa_str(")"));
    }
    if (hexa_truthy(hexa_eq(k, hexa_str("BoolLit")))) {
        return hexa_add(hexa_add(hexa_add(pad, hexa_str("BoolLit(")), hexa_map_get(node, "value")), hexa_str(")"));
    }
    if (hexa_truthy(hexa_eq(k, hexa_str("StringLit")))) {
        return hexa_add(hexa_add(hexa_add(pad, hexa_str("StringLit(\"")), hexa_map_get(node, "value")), hexa_str("\")"));
    }
    if (hexa_truthy(hexa_eq(k, hexa_str("CharLit")))) {
        return hexa_add(hexa_add(hexa_add(pad, hexa_str("CharLit('")), hexa_map_get(node, "value")), hexa_str("')"));
    }
    if (hexa_truthy(hexa_eq(k, hexa_str("Ident")))) {
        return hexa_add(hexa_add(hexa_add(pad, hexa_str("Ident(")), hexa_map_get(node, "name")), hexa_str(")"));
    }
    if (hexa_truthy(hexa_eq(k, hexa_str("Wildcard")))) {
        return hexa_add(pad, hexa_str("Wildcard"));
    }
    if (hexa_truthy(hexa_eq(k, hexa_str("BinOp")))) {
        HexaVal l = ast_to_string(hexa_map_get(node, "left"), hexa_int(0));
        HexaVal r = ast_to_string(hexa_map_get(node, "right"), hexa_int(0));
        return hexa_add(hexa_add(hexa_add(hexa_add(hexa_add(hexa_add(hexa_add(pad, hexa_str("BinOp(")), hexa_map_get(node, "op")), hexa_str(", ")), l), hexa_str(", ")), r), hexa_str(")"));
    }
    if (hexa_truthy(hexa_eq(k, hexa_str("UnaryOp")))) {
        HexaVal operand = ast_to_string(hexa_map_get(node, "left"), hexa_int(0));
        return hexa_add(hexa_add(hexa_add(hexa_add(hexa_add(pad, hexa_str("UnaryOp(")), hexa_map_get(node, "op")), hexa_str(", ")), operand), hexa_str(")"));
    }
    if (hexa_truthy(hexa_eq(k, hexa_str("Call")))) {
        HexaVal callee = ast_to_string(hexa_map_get(node, "left"), hexa_int(0));
        return hexa_add(hexa_add(hexa_add(hexa_add(hexa_add(pad, hexa_str("Call(")), callee), hexa_str(", [")), hexa_to_string(hexa_int(hexa_len(hexa_map_get(node, "args"))))), hexa_str(" args])"));
    }
    if (hexa_truthy(hexa_eq(k, hexa_str("Field")))) {
        HexaVal obj = ast_to_string(hexa_map_get(node, "left"), hexa_int(0));
        return hexa_add(hexa_add(hexa_add(hexa_add(hexa_add(pad, hexa_str("Field(")), obj), hexa_str(".")), hexa_map_get(node, "name")), hexa_str(")"));
    }
    if (hexa_truthy(hexa_eq(k, hexa_str("Index")))) {
        HexaVal obj = ast_to_string(hexa_map_get(node, "left"), hexa_int(0));
        HexaVal idx = ast_to_string(hexa_map_get(node, "right"), hexa_int(0));
        return hexa_add(hexa_add(hexa_add(hexa_add(hexa_add(pad, hexa_str("Index(")), obj), hexa_str("[")), idx), hexa_str("])"));
    }
    if (hexa_truthy(hexa_eq(k, hexa_str("IfExpr")))) {
        HexaVal c = ast_to_string(hexa_map_get(node, "cond"), hexa_int(0));
        return hexa_add(hexa_add(hexa_add(hexa_add(hexa_add(hexa_add(hexa_add(pad, hexa_str("IfExpr(")), c), hexa_str(", then=[")), hexa_to_string(hexa_int(hexa_len(hexa_map_get(node, "then_body"))))), hexa_str("], else=[")), hexa_to_string(hexa_int(hexa_len(hexa_map_get(node, "else_body"))))), hexa_str("])"));
    }
    if (hexa_truthy(hexa_eq(k, hexa_str("MatchExpr")))) {
        return hexa_add(hexa_add(hexa_add(pad, hexa_str("MatchExpr([")), hexa_to_string(hexa_int(hexa_len(hexa_map_get(node, "arms"))))), hexa_str(" arms])"));
    }
    if (hexa_truthy(hexa_eq(k, hexa_str("Array")))) {
        return hexa_add(hexa_add(hexa_add(pad, hexa_str("Array([")), hexa_to_string(hexa_int(hexa_len(hexa_map_get(node, "items"))))), hexa_str(" items])"));
    }
    if (hexa_truthy(hexa_eq(k, hexa_str("StructInit")))) {
        return hexa_add(hexa_add(hexa_add(hexa_add(hexa_add(pad, hexa_str("StructInit(")), hexa_map_get(node, "name")), hexa_str(", [")), hexa_to_string(hexa_int(hexa_len(hexa_map_get(node, "fields"))))), hexa_str(" fields])"));
    }
    if (hexa_truthy(hexa_eq(k, hexa_str("Range")))) {
        HexaVal s = ast_to_string(hexa_map_get(node, "left"), hexa_int(0));
        HexaVal e = ast_to_string(hexa_map_get(node, "right"), hexa_int(0));
        return hexa_add(hexa_add(hexa_add(hexa_add(hexa_add(hexa_add(hexa_add(pad, hexa_str("Range(")), s), hexa_str("..")), e), hexa_str(", ")), hexa_map_get(node, "value")), hexa_str(")"));
    }
    if (hexa_truthy(hexa_eq(k, hexa_str("EnumPath")))) {
        return hexa_add(hexa_add(hexa_add(hexa_add(hexa_add(pad, hexa_str("EnumPath(")), hexa_map_get(node, "name")), hexa_str("::")), hexa_map_get(node, "value")), hexa_str(")"));
    }
    if (hexa_truthy(hexa_eq(k, hexa_str("Lambda")))) {
        return hexa_add(hexa_add(hexa_add(pad, hexa_str("Lambda([")), hexa_to_string(hexa_int(hexa_len(hexa_map_get(node, "params"))))), hexa_str(" params])"));
    }
    if (hexa_truthy(hexa_eq(k, hexa_str("Tuple")))) {
        return hexa_add(hexa_add(hexa_add(pad, hexa_str("Tuple([")), hexa_to_string(hexa_int(hexa_len(hexa_map_get(node, "items"))))), hexa_str(" items])"));
    }
    if (hexa_truthy(hexa_bool(hexa_truthy(hexa_eq(k, hexa_str("LetStmt"))) || hexa_truthy(hexa_eq(k, hexa_str("LetMutStmt")))))) {
        HexaVal v = ast_to_string(hexa_map_get(node, "left"), hexa_int(0));
        return hexa_add(hexa_add(hexa_add(hexa_add(hexa_add(hexa_add(pad, k), hexa_str("(")), hexa_map_get(node, "name")), hexa_str(" = ")), v), hexa_str(")"));
    }
    if (hexa_truthy(hexa_bool(hexa_truthy(hexa_eq(k, hexa_str("ConstStmt"))) || hexa_truthy(hexa_eq(k, hexa_str("StaticStmt")))))) {
        HexaVal v = ast_to_string(hexa_map_get(node, "left"), hexa_int(0));
        return hexa_add(hexa_add(hexa_add(hexa_add(hexa_add(hexa_add(pad, k), hexa_str("(")), hexa_map_get(node, "name")), hexa_str(" = ")), v), hexa_str(")"));
    }
    if (hexa_truthy(hexa_eq(k, hexa_str("ReturnStmt")))) {
        if (hexa_truthy(hexa_eq(hexa_map_get(node, "left"), hexa_str("")))) {
            return hexa_add(pad, hexa_str("ReturnStmt()"));
        }
        HexaVal v = ast_to_string(hexa_map_get(node, "left"), hexa_int(0));
        return hexa_add(hexa_add(hexa_add(pad, hexa_str("ReturnStmt(")), v), hexa_str(")"));
    }
    if (hexa_truthy(hexa_eq(k, hexa_str("FnDecl")))) {
        return hexa_add(hexa_add(hexa_add(hexa_add(hexa_add(hexa_add(hexa_add(pad, hexa_str("FnDecl(")), hexa_map_get(node, "name")), hexa_str(", [")), hexa_to_string(hexa_int(hexa_len(hexa_map_get(node, "params"))))), hexa_str(" params], [")), hexa_to_string(hexa_int(hexa_len(hexa_map_get(node, "body"))))), hexa_str(" stmts])"));
    }
    if (hexa_truthy(hexa_eq(k, hexa_str("StructDecl")))) {
        return hexa_add(hexa_add(hexa_add(hexa_add(hexa_add(pad, hexa_str("StructDecl(")), hexa_map_get(node, "name")), hexa_str(", [")), hexa_to_string(hexa_int(hexa_len(hexa_map_get(node, "fields"))))), hexa_str(" fields])"));
    }
    if (hexa_truthy(hexa_eq(k, hexa_str("EnumDecl")))) {
        return hexa_add(hexa_add(hexa_add(hexa_add(hexa_add(pad, hexa_str("EnumDecl(")), hexa_map_get(node, "name")), hexa_str(", [")), hexa_to_string(hexa_int(hexa_len(hexa_map_get(node, "variants"))))), hexa_str(" variants])"));
    }
    if (hexa_truthy(hexa_eq(k, hexa_str("ForStmt")))) {
        return hexa_add(hexa_add(hexa_add(hexa_add(hexa_add(pad, hexa_str("ForStmt(")), hexa_map_get(node, "name")), hexa_str(" in ..., [")), hexa_to_string(hexa_int(hexa_len(hexa_map_get(node, "body"))))), hexa_str(" stmts])"));
    }
    if (hexa_truthy(hexa_eq(k, hexa_str("WhileStmt")))) {
        return hexa_add(hexa_add(hexa_add(pad, hexa_str("WhileStmt(..., [")), hexa_to_string(hexa_int(hexa_len(hexa_map_get(node, "body"))))), hexa_str(" stmts])"));
    }
    if (hexa_truthy(hexa_eq(k, hexa_str("LoopStmt")))) {
        return hexa_add(hexa_add(hexa_add(pad, hexa_str("LoopStmt([")), hexa_to_string(hexa_int(hexa_len(hexa_map_get(node, "body"))))), hexa_str(" stmts])"));
    }
    if (hexa_truthy(hexa_eq(k, hexa_str("ExprStmt")))) {
        HexaVal v = ast_to_string(hexa_map_get(node, "left"), hexa_int(0));
        return hexa_add(hexa_add(hexa_add(pad, hexa_str("ExprStmt(")), v), hexa_str(")"));
    }
    if (hexa_truthy(hexa_eq(k, hexa_str("AssignStmt")))) {
        HexaVal l = ast_to_string(hexa_map_get(node, "left"), hexa_int(0));
        HexaVal r = ast_to_string(hexa_map_get(node, "right"), hexa_int(0));
        return hexa_add(hexa_add(hexa_add(hexa_add(hexa_add(pad, hexa_str("AssignStmt(")), l), hexa_str(" = ")), r), hexa_str(")"));
    }
    if (hexa_truthy(hexa_eq(k, hexa_str("AssertStmt")))) {
        HexaVal v = ast_to_string(hexa_map_get(node, "left"), hexa_int(0));
        return hexa_add(hexa_add(hexa_add(pad, hexa_str("AssertStmt(")), v), hexa_str(")"));
    }
    if (hexa_truthy(hexa_eq(k, hexa_str("ProofStmt")))) {
        return hexa_add(hexa_add(hexa_add(hexa_add(hexa_add(pad, hexa_str("ProofStmt(")), hexa_map_get(node, "name")), hexa_str(", [")), hexa_to_string(hexa_int(hexa_len(hexa_map_get(node, "body"))))), hexa_str(" stmts])"));
    }
    if (hexa_truthy(hexa_eq(k, hexa_str("ImplBlock")))) {
        return hexa_add(hexa_add(hexa_add(hexa_add(hexa_add(pad, hexa_str("ImplBlock(")), hexa_map_get(node, "target")), hexa_str(", [")), hexa_to_string(hexa_int(hexa_len(hexa_map_get(node, "methods"))))), hexa_str(" methods])"));
    }
    if (hexa_truthy(hexa_eq(k, hexa_str("TraitDecl")))) {
        return hexa_add(hexa_add(hexa_add(hexa_add(hexa_add(pad, hexa_str("TraitDecl(")), hexa_map_get(node, "name")), hexa_str(", [")), hexa_to_string(hexa_int(hexa_len(hexa_map_get(node, "methods"))))), hexa_str(" methods])"));
    }
    if (hexa_truthy(hexa_eq(k, hexa_str("UseStmt")))) {
        return hexa_add(hexa_add(hexa_add(pad, hexa_str("UseStmt([")), hexa_to_string(hexa_int(hexa_len(hexa_map_get(node, "items"))))), hexa_str(" segments])"));
    }
    if (hexa_truthy(hexa_eq(k, hexa_str("ModStmt")))) {
        return hexa_add(hexa_add(hexa_add(pad, hexa_str("ModStmt(")), hexa_map_get(node, "name")), hexa_str(")"));
    }
    if (hexa_truthy(hexa_eq(k, hexa_str("BreakStmt")))) {
        return hexa_add(pad, hexa_str("BreakStmt"));
    }
    if (hexa_truthy(hexa_eq(k, hexa_str("ContinueStmt")))) {
        return hexa_add(pad, hexa_str("ContinueStmt"));
    }
    if (hexa_truthy(hexa_eq(k, hexa_str("YieldStmt")))) {
        if (hexa_truthy(hexa_eq(hexa_map_get(node, "left"), hexa_str("")))) {
            return hexa_add(pad, hexa_str("YieldStmt()"));
        }
        return hexa_add(hexa_add(hexa_add(pad, hexa_str("YieldStmt(")), ast_to_string(hexa_map_get(node, "left"), hexa_int(0))), hexa_str(")"));
    }
    if (hexa_truthy(hexa_eq(k, hexa_str("ComptimeFnDecl")))) {
        return hexa_add(hexa_add(hexa_add(hexa_add(hexa_add(pad, hexa_str("ComptimeFnDecl(")), hexa_map_get(node, "name")), hexa_str(", [")), hexa_to_string(hexa_int(hexa_len(hexa_map_get(node, "params"))))), hexa_str(" params])"));
    }
    if (hexa_truthy(hexa_bool(hexa_truthy(hexa_eq(k, hexa_str("ComptimeConst"))) || hexa_truthy(hexa_eq(k, hexa_str("ComptimeLet")))))) {
        HexaVal v = ast_to_string(hexa_map_get(node, "left"), hexa_int(0));
        return hexa_add(hexa_add(hexa_add(hexa_add(hexa_add(hexa_add(pad, k), hexa_str("(")), hexa_map_get(node, "name")), hexa_str(" = ")), v), hexa_str(")"));
    }
    if (hexa_truthy(hexa_eq(k, hexa_str("ComptimeBlock")))) {
        return hexa_add(hexa_add(hexa_add(pad, hexa_str("ComptimeBlock([")), hexa_to_string(hexa_int(hexa_len(hexa_map_get(node, "body"))))), hexa_str(" stmts])"));
    }
    if (hexa_truthy(hexa_eq(k, hexa_str("ComptimeAssert")))) {
        return hexa_add(hexa_add(hexa_add(pad, hexa_str("ComptimeAssert(")), ast_to_string(hexa_map_get(node, "left"), hexa_int(0))), hexa_str(")"));
    }
    if (hexa_truthy(hexa_eq(k, hexa_str("IntentStmt")))) {
        return hexa_add(hexa_add(hexa_add(hexa_add(hexa_add(pad, hexa_str("IntentStmt(")), hexa_map_get(node, "name")), hexa_str(", [")), hexa_to_string(hexa_int(hexa_len(hexa_map_get(node, "fields"))))), hexa_str(" fields])"));
    }
    if (hexa_truthy(hexa_eq(k, hexa_str("VerifyStmt")))) {
        return hexa_add(hexa_add(hexa_add(hexa_add(hexa_add(pad, hexa_str("VerifyStmt(")), hexa_map_get(node, "name")), hexa_str(", [")), hexa_to_string(hexa_int(hexa_len(hexa_map_get(node, "body"))))), hexa_str(" stmts])"));
    }
    if (hexa_truthy(hexa_bool(hexa_truthy(hexa_eq(k, hexa_str("GenerateFnStmt"))) || hexa_truthy(hexa_eq(k, hexa_str("GenerateStmt")))))) {
        return hexa_add(hexa_add(hexa_add(hexa_add(pad, k), hexa_str("(")), hexa_map_get(node, "name")), hexa_str(")"));
    }
    if (hexa_truthy(hexa_eq(k, hexa_str("OptimizeFnStmt")))) {
        return hexa_add(hexa_add(hexa_add(hexa_add(hexa_add(pad, hexa_str("OptimizeFnStmt(")), hexa_map_get(node, "name")), hexa_str(", [")), hexa_to_string(hexa_int(hexa_len(hexa_map_get(node, "params"))))), hexa_str(" params])"));
    }
    if (hexa_truthy(hexa_eq(k, hexa_str("EffectDecl")))) {
        return hexa_add(hexa_add(hexa_add(hexa_add(hexa_add(pad, hexa_str("EffectDecl(")), hexa_map_get(node, "name")), hexa_str(", [")), hexa_to_string(hexa_int(hexa_len(hexa_map_get(node, "items"))))), hexa_str(" ops])"));
    }
    if (hexa_truthy(hexa_eq(k, hexa_str("PureFnDecl")))) {
        return hexa_add(hexa_add(hexa_add(hexa_add(hexa_add(pad, hexa_str("PureFnDecl(")), hexa_map_get(node, "name")), hexa_str(", [")), hexa_to_string(hexa_int(hexa_len(hexa_map_get(node, "params"))))), hexa_str(" params])"));
    }
    if (hexa_truthy(hexa_eq(k, hexa_str("MacroDef")))) {
        return hexa_add(hexa_add(hexa_add(hexa_add(hexa_add(pad, hexa_str("MacroDef(")), hexa_map_get(node, "name")), hexa_str(", [")), hexa_to_string(hexa_int(hexa_len(hexa_map_get(node, "items"))))), hexa_str(" rules])"));
    }
    if (hexa_truthy(hexa_eq(k, hexa_str("DeriveDecl")))) {
        return hexa_add(hexa_add(hexa_add(hexa_add(hexa_add(pad, hexa_str("DeriveDecl(")), hexa_map_get(node, "name")), hexa_str(", [")), hexa_to_string(hexa_int(hexa_len(hexa_map_get(node, "items"))))), hexa_str(" traits])"));
    }
    if (hexa_truthy(hexa_eq(k, hexa_str("TheoremStmt")))) {
        return hexa_add(hexa_add(hexa_add(hexa_add(hexa_add(pad, hexa_str("TheoremStmt(")), hexa_map_get(node, "name")), hexa_str(", [")), hexa_to_string(hexa_int(hexa_len(hexa_map_get(node, "body"))))), hexa_str(" stmts])"));
    }
    if (hexa_truthy(hexa_eq(k, hexa_str("HandleWithStmt")))) {
        return hexa_add(hexa_add(hexa_add(pad, hexa_str("HandleWithStmt([")), hexa_to_string(hexa_int(hexa_len(hexa_map_get(node, "items"))))), hexa_str(" handlers])"));
    }
    if (hexa_truthy(hexa_eq(k, hexa_str("TryCatch")))) {
        return hexa_add(hexa_add(hexa_add(pad, hexa_str("TryCatch(")), hexa_map_get(node, "name")), hexa_str(")"));
    }
    if (hexa_truthy(hexa_eq(k, hexa_str("ThrowStmt")))) {
        return hexa_add(hexa_add(hexa_add(pad, hexa_str("ThrowStmt(")), ast_to_string(hexa_map_get(node, "left"), hexa_int(0))), hexa_str(")"));
    }
    if (hexa_truthy(hexa_eq(k, hexa_str("PanicStmt")))) {
        return hexa_add(hexa_add(hexa_add(pad, hexa_str("PanicStmt(")), ast_to_string(hexa_map_get(node, "left"), hexa_int(0))), hexa_str(")"));
    }
    if (hexa_truthy(hexa_eq(k, hexa_str("DropStmt")))) {
        return hexa_add(hexa_add(hexa_add(pad, hexa_str("DropStmt(")), hexa_map_get(node, "name")), hexa_str(")"));
    }
    if (hexa_truthy(hexa_eq(k, hexa_str("SpawnStmt")))) {
        return hexa_add(hexa_add(hexa_add(pad, hexa_str("SpawnStmt([")), hexa_to_string(hexa_int(hexa_len(hexa_map_get(node, "body"))))), hexa_str(" stmts])"));
    }
    if (hexa_truthy(hexa_eq(k, hexa_str("ScopeStmt")))) {
        return hexa_add(hexa_add(hexa_add(pad, hexa_str("ScopeStmt([")), hexa_to_string(hexa_int(hexa_len(hexa_map_get(node, "body"))))), hexa_str(" stmts])"));
    }
    if (hexa_truthy(hexa_eq(k, hexa_str("SelectStmt")))) {
        return hexa_add(hexa_add(hexa_add(pad, hexa_str("SelectStmt([")), hexa_to_string(hexa_int(hexa_len(hexa_map_get(node, "arms"))))), hexa_str(" arms])"));
    }
    if (hexa_truthy(hexa_eq(k, hexa_str("AsyncFnDecl")))) {
        return hexa_add(hexa_add(hexa_add(hexa_add(hexa_add(pad, hexa_str("AsyncFnDecl(")), hexa_map_get(node, "name")), hexa_str(", [")), hexa_to_string(hexa_int(hexa_len(hexa_map_get(node, "params"))))), hexa_str(" params])"));
    }
    if (hexa_truthy(hexa_eq(k, hexa_str("ExternFnDecl")))) {
        HexaVal sym_info = hexa_str("");
        if (hexa_truthy(hexa_bool(!hexa_truthy(hexa_eq(hexa_map_get(node, "value"), hexa_str("")))))) {
            sym_info = hexa_add(hexa_add(hexa_str(", @symbol(\""), hexa_map_get(node, "value")), hexa_str("\")"));
        }
        return hexa_add(hexa_add(hexa_add(hexa_add(hexa_add(hexa_add(hexa_add(pad, hexa_str("ExternFnDecl(")), hexa_map_get(node, "name")), hexa_str(", [")), hexa_to_string(hexa_int(hexa_len(hexa_map_get(node, "params"))))), hexa_str(" params]")), sym_info), hexa_str(")"));
    }
    if (hexa_truthy(hexa_eq(k, hexa_str("TypeAlias")))) {
        return hexa_add(hexa_add(hexa_add(hexa_add(hexa_add(pad, hexa_str("TypeAlias(")), hexa_map_get(node, "name")), hexa_str(" = ")), hexa_map_get(node, "value")), hexa_str(")"));
    }
    if (hexa_truthy(hexa_eq(k, hexa_str("AtomicLet")))) {
        return hexa_add(hexa_add(hexa_add(pad, hexa_str("AtomicLet(")), hexa_map_get(node, "name")), hexa_str(")"));
    }
    return hexa_add(hexa_add(hexa_add(pad, hexa_str("Unknown(")), k), hexa_str(")"));
    return hexa_void();
}


HexaVal print_ast(HexaVal stmts) {
    {
        HexaVal __iter_arr = stmts;
        for (int __fi = 0; __fi < hexa_len(__iter_arr); __fi++) {
            HexaVal s = hexa_array_get(__iter_arr, __fi);
            hexa_println(ast_to_string(s, hexa_int(0)));
        }
    }
    return hexa_void();
}


HexaVal is_keyword(HexaVal word) {
    if (hexa_truthy(hexa_eq(word, hexa_str("if")))) {
        return hexa_bool(1);
    }
    if (hexa_truthy(hexa_eq(word, hexa_str("else")))) {
        return hexa_bool(1);
    }
    if (hexa_truthy(hexa_eq(word, hexa_str("match")))) {
        return hexa_bool(1);
    }
    if (hexa_truthy(hexa_eq(word, hexa_str("for")))) {
        return hexa_bool(1);
    }
    if (hexa_truthy(hexa_eq(word, hexa_str("while")))) {
        return hexa_bool(1);
    }
    if (hexa_truthy(hexa_eq(word, hexa_str("loop")))) {
        return hexa_bool(1);
    }
    if (hexa_truthy(hexa_eq(word, hexa_str("type")))) {
        return hexa_bool(1);
    }
    if (hexa_truthy(hexa_eq(word, hexa_str("struct")))) {
        return hexa_bool(1);
    }
    if (hexa_truthy(hexa_eq(word, hexa_str("enum")))) {
        return hexa_bool(1);
    }
    if (hexa_truthy(hexa_eq(word, hexa_str("trait")))) {
        return hexa_bool(1);
    }
    if (hexa_truthy(hexa_eq(word, hexa_str("impl")))) {
        return hexa_bool(1);
    }
    if (hexa_truthy(hexa_eq(word, hexa_str("fn")))) {
        return hexa_bool(1);
    }
    if (hexa_truthy(hexa_eq(word, hexa_str("return")))) {
        return hexa_bool(1);
    }
    if (hexa_truthy(hexa_eq(word, hexa_str("yield")))) {
        return hexa_bool(1);
    }
    if (hexa_truthy(hexa_eq(word, hexa_str("async")))) {
        return hexa_bool(1);
    }
    if (hexa_truthy(hexa_eq(word, hexa_str("await")))) {
        return hexa_bool(1);
    }
    if (hexa_truthy(hexa_eq(word, hexa_str("let")))) {
        return hexa_bool(1);
    }
    if (hexa_truthy(hexa_eq(word, hexa_str("mut")))) {
        return hexa_bool(1);
    }
    if (hexa_truthy(hexa_eq(word, hexa_str("const")))) {
        return hexa_bool(1);
    }
    if (hexa_truthy(hexa_eq(word, hexa_str("static")))) {
        return hexa_bool(1);
    }
    if (hexa_truthy(hexa_eq(word, hexa_str("mod")))) {
        return hexa_bool(1);
    }
    if (hexa_truthy(hexa_eq(word, hexa_str("use")))) {
        return hexa_bool(1);
    }
    if (hexa_truthy(hexa_eq(word, hexa_str("pub")))) {
        return hexa_bool(1);
    }
    if (hexa_truthy(hexa_eq(word, hexa_str("crate")))) {
        return hexa_bool(1);
    }
    if (hexa_truthy(hexa_eq(word, hexa_str("own")))) {
        return hexa_bool(1);
    }
    if (hexa_truthy(hexa_eq(word, hexa_str("borrow")))) {
        return hexa_bool(1);
    }
    if (hexa_truthy(hexa_eq(word, hexa_str("move")))) {
        return hexa_bool(1);
    }
    if (hexa_truthy(hexa_eq(word, hexa_str("drop")))) {
        return hexa_bool(1);
    }
    if (hexa_truthy(hexa_eq(word, hexa_str("spawn")))) {
        return hexa_bool(1);
    }
    if (hexa_truthy(hexa_eq(word, hexa_str("channel")))) {
        return hexa_bool(1);
    }
    if (hexa_truthy(hexa_eq(word, hexa_str("select")))) {
        return hexa_bool(1);
    }
    if (hexa_truthy(hexa_eq(word, hexa_str("atomic")))) {
        return hexa_bool(1);
    }
    if (hexa_truthy(hexa_eq(word, hexa_str("effect")))) {
        return hexa_bool(1);
    }
    if (hexa_truthy(hexa_eq(word, hexa_str("handle")))) {
        return hexa_bool(1);
    }
    if (hexa_truthy(hexa_eq(word, hexa_str("resume")))) {
        return hexa_bool(1);
    }
    if (hexa_truthy(hexa_eq(word, hexa_str("pure")))) {
        return hexa_bool(1);
    }
    if (hexa_truthy(hexa_eq(word, hexa_str("proof")))) {
        return hexa_bool(1);
    }
    if (hexa_truthy(hexa_eq(word, hexa_str("assert")))) {
        return hexa_bool(1);
    }
    if (hexa_truthy(hexa_eq(word, hexa_str("invariant")))) {
        return hexa_bool(1);
    }
    if (hexa_truthy(hexa_eq(word, hexa_str("theorem")))) {
        return hexa_bool(1);
    }
    if (hexa_truthy(hexa_eq(word, hexa_str("macro")))) {
        return hexa_bool(1);
    }
    if (hexa_truthy(hexa_eq(word, hexa_str("derive")))) {
        return hexa_bool(1);
    }
    if (hexa_truthy(hexa_eq(word, hexa_str("where")))) {
        return hexa_bool(1);
    }
    if (hexa_truthy(hexa_eq(word, hexa_str("comptime")))) {
        return hexa_bool(1);
    }
    if (hexa_truthy(hexa_eq(word, hexa_str("try")))) {
        return hexa_bool(1);
    }
    if (hexa_truthy(hexa_eq(word, hexa_str("catch")))) {
        return hexa_bool(1);
    }
    if (hexa_truthy(hexa_eq(word, hexa_str("throw")))) {
        return hexa_bool(1);
    }
    if (hexa_truthy(hexa_eq(word, hexa_str("panic")))) {
        return hexa_bool(1);
    }
    if (hexa_truthy(hexa_eq(word, hexa_str("recover")))) {
        return hexa_bool(1);
    }
    if (hexa_truthy(hexa_eq(word, hexa_str("intent")))) {
        return hexa_bool(1);
    }
    if (hexa_truthy(hexa_eq(word, hexa_str("generate")))) {
        return hexa_bool(1);
    }
    if (hexa_truthy(hexa_eq(word, hexa_str("verify")))) {
        return hexa_bool(1);
    }
    if (hexa_truthy(hexa_eq(word, hexa_str("optimize")))) {
        return hexa_bool(1);
    }
    if (hexa_truthy(hexa_eq(word, hexa_str("break")))) {
        return hexa_bool(1);
    }
    if (hexa_truthy(hexa_eq(word, hexa_str("continue")))) {
        return hexa_bool(1);
    }
    if (hexa_truthy(hexa_eq(word, hexa_str("extern")))) {
        return hexa_bool(1);
    }
    if (hexa_truthy(hexa_eq(word, hexa_str("dyn")))) {
        return hexa_bool(1);
    }
    if (hexa_truthy(hexa_eq(word, hexa_str("scope")))) {
        return hexa_bool(1);
    }
    return hexa_bool(0);
    return hexa_void();
}


HexaVal keyword_kind(HexaVal word) {
    if (hexa_truthy(hexa_eq(word, hexa_str("true")))) {
        return hexa_str("BoolLit");
    }
    if (hexa_truthy(hexa_eq(word, hexa_str("false")))) {
        return hexa_str("BoolLit");
    }
    if (hexa_truthy(is_keyword(word))) {
        HexaVal first = hexa_str_to_upper(hexa_to_string(hexa_index_get(hexa_str_chars(word), hexa_int(0))));
        HexaVal rest = hexa_str("");
        HexaVal chars = hexa_str_chars(word);
        HexaVal i = hexa_int(1);
        while (hexa_truthy(hexa_bool((i).i < (hexa_int(hexa_len(chars))).i))) {
            rest = hexa_add(rest, hexa_to_string(hexa_index_get(chars, i)));
            i = hexa_add(i, hexa_int(1));
        }
        return hexa_add(first, rest);
    }
    return hexa_str("Ident");
    return hexa_void();
}


HexaVal is_ident_start(HexaVal ch) {
    if (hexa_truthy(hexa_bool((ch.tag==TAG_STR && ch.s && isalpha((unsigned char)ch.s[0])) || (ch.tag==TAG_CHAR && isalpha((unsigned char)ch.i))))) {
        return hexa_bool(1);
    }
    if (hexa_truthy(hexa_eq(ch, hexa_str("_")))) {
        return hexa_bool(1);
    }
    return hexa_bool(0);
    return hexa_void();
}


HexaVal is_ident_char(HexaVal ch) {
    if (hexa_truthy(hexa_bool((ch.tag==TAG_STR && ch.s && isalnum((unsigned char)ch.s[0])) || (ch.tag==TAG_CHAR && isalnum((unsigned char)ch.i))))) {
        return hexa_bool(1);
    }
    if (hexa_truthy(hexa_eq(ch, hexa_str("_")))) {
        return hexa_bool(1);
    }
    return hexa_bool(0);
    return hexa_void();
}


HexaVal tokenize(HexaVal source) {
    HexaVal tokens = hexa_array_new();
    HexaVal chars = hexa_str_chars(source);
    HexaVal pos = hexa_int(0);
    HexaVal line = hexa_int(1);
    HexaVal col = hexa_int(1);
    HexaVal total = hexa_int(hexa_len(chars));
    while (hexa_truthy(hexa_bool((pos).i < (total).i))) {
        HexaVal ch = hexa_index_get(chars, pos);
        if (hexa_truthy(hexa_bool(hexa_truthy(hexa_bool(hexa_truthy(hexa_eq(ch, hexa_str(" "))) || hexa_truthy(hexa_eq(ch, hexa_str("\t"))))) || hexa_truthy(hexa_eq(ch, hexa_str("\r")))))) {
            pos = hexa_add(pos, hexa_int(1));
            col = hexa_add(col, hexa_int(1));
        } else {
            if (hexa_truthy(hexa_eq(ch, hexa_str("\n")))) {
                tokens = hexa_array_push(tokens, Token(hexa_str("Newline"), hexa_str("\n"), line, col));
                pos = hexa_add(pos, hexa_int(1));
                line = hexa_add(line, hexa_int(1));
                col = hexa_int(1);
            } else {
                if (hexa_truthy(hexa_bool(hexa_truthy(hexa_bool(hexa_truthy(hexa_eq(ch, hexa_str("/"))) && hexa_truthy(hexa_bool((hexa_add(pos, hexa_int(1))).i < (total).i)))) && hexa_truthy(hexa_eq(hexa_index_get(chars, hexa_add(pos, hexa_int(1))), hexa_str("/")))))) {
                    pos = hexa_add(pos, hexa_int(2));
                    col = hexa_add(col, hexa_int(2));
                    while (hexa_truthy(hexa_bool(hexa_truthy(hexa_bool((pos).i < (total).i)) && hexa_truthy(hexa_bool(!hexa_truthy(hexa_eq(hexa_index_get(chars, pos), hexa_str("\n")))))))) {
                        pos = hexa_add(pos, hexa_int(1));
                        col = hexa_add(col, hexa_int(1));
                    }
                } else {
                    if (hexa_truthy(is_ident_start(ch))) {
                        HexaVal start_col = col;
                        HexaVal word = hexa_str("");
                        while (hexa_truthy(hexa_bool(hexa_truthy(hexa_bool((pos).i < (total).i)) && hexa_truthy(is_ident_char(hexa_index_get(chars, pos)))))) {
                            word = hexa_add(word, hexa_to_string(hexa_index_get(chars, pos)));
                            pos = hexa_add(pos, hexa_int(1));
                            col = hexa_add(col, hexa_int(1));
                        }
                        HexaVal kind = keyword_kind(word);
                        tokens = hexa_array_push(tokens, Token(kind, word, line, start_col));
                    } else {
                        if (hexa_truthy(hexa_bool((ch.tag==TAG_STR && ch.s && isdigit((unsigned char)ch.s[0])) || (ch.tag==TAG_CHAR && isdigit((unsigned char)ch.i))))) {
                            HexaVal start_col = col;
                            HexaVal num_str = hexa_str("");
                            HexaVal is_float = hexa_bool(0);
                            while (hexa_truthy(hexa_bool(hexa_truthy(hexa_bool((pos).i < (total).i)) && hexa_truthy(hexa_bool(hexa_truthy(hexa_bool((hexa_index_get(chars, pos).tag==TAG_STR && hexa_index_get(chars, pos).s && isdigit((unsigned char)hexa_index_get(chars, pos).s[0])) || (hexa_index_get(chars, pos).tag==TAG_CHAR && isdigit((unsigned char)hexa_index_get(chars, pos).i)))) || hexa_truthy(hexa_eq(hexa_index_get(chars, pos), hexa_str("_")))))))) {
                                if (hexa_truthy(hexa_eq(hexa_index_get(chars, pos), hexa_str("_")))) {
                                    pos = hexa_add(pos, hexa_int(1));
                                    col = hexa_add(col, hexa_int(1));
                                } else {
                                    num_str = hexa_add(num_str, hexa_to_string(hexa_index_get(chars, pos)));
                                    pos = hexa_add(pos, hexa_int(1));
                                    col = hexa_add(col, hexa_int(1));
                                }
                            }
                            if (hexa_truthy(hexa_bool(hexa_truthy(hexa_bool((pos).i < (total).i)) && hexa_truthy(hexa_eq(hexa_index_get(chars, pos), hexa_str(".")))))) {
                                if (hexa_truthy(hexa_bool(hexa_truthy(hexa_bool((hexa_add(pos, hexa_int(1))).i < (total).i)) && hexa_truthy(hexa_bool((hexa_index_get(chars, hexa_add(pos, hexa_int(1))).tag==TAG_STR && hexa_index_get(chars, hexa_add(pos, hexa_int(1))).s && isdigit((unsigned char)hexa_index_get(chars, hexa_add(pos, hexa_int(1))).s[0])) || (hexa_index_get(chars, hexa_add(pos, hexa_int(1))).tag==TAG_CHAR && isdigit((unsigned char)hexa_index_get(chars, hexa_add(pos, hexa_int(1))).i))))))) {
                                    is_float = hexa_bool(1);
                                    num_str = hexa_add(num_str, hexa_str("."));
                                    pos = hexa_add(pos, hexa_int(1));
                                    col = hexa_add(col, hexa_int(1));
                                    while (hexa_truthy(hexa_bool(hexa_truthy(hexa_bool((pos).i < (total).i)) && hexa_truthy(hexa_bool(hexa_truthy(hexa_bool((hexa_index_get(chars, pos).tag==TAG_STR && hexa_index_get(chars, pos).s && isdigit((unsigned char)hexa_index_get(chars, pos).s[0])) || (hexa_index_get(chars, pos).tag==TAG_CHAR && isdigit((unsigned char)hexa_index_get(chars, pos).i)))) || hexa_truthy(hexa_eq(hexa_index_get(chars, pos), hexa_str("_")))))))) {
                                        if (hexa_truthy(hexa_eq(hexa_index_get(chars, pos), hexa_str("_")))) {
                                            pos = hexa_add(pos, hexa_int(1));
                                            col = hexa_add(col, hexa_int(1));
                                        } else {
                                            num_str = hexa_add(num_str, hexa_to_string(hexa_index_get(chars, pos)));
                                            pos = hexa_add(pos, hexa_int(1));
                                            col = hexa_add(col, hexa_int(1));
                                        }
                                    }
                                }
                            }
                            if (hexa_truthy(is_float)) {
                                tokens = hexa_array_push(tokens, Token(hexa_str("FloatLit"), num_str, line, start_col));
                            } else {
                                tokens = hexa_array_push(tokens, Token(hexa_str("IntLit"), num_str, line, start_col));
                            }
                        } else {
                            if (hexa_truthy(hexa_eq(ch, hexa_str("\"")))) {
                                HexaVal start_col = col;
                                pos = hexa_add(pos, hexa_int(1));
                                col = hexa_add(col, hexa_int(1));
                                HexaVal s = hexa_str("");
                                HexaVal done = hexa_bool(0);
                                while (hexa_truthy(hexa_bool(hexa_truthy(hexa_bool((pos).i < (total).i)) && hexa_truthy(hexa_bool(!hexa_truthy(done)))))) {
                                    HexaVal c = hexa_index_get(chars, pos);
                                    if (hexa_truthy(hexa_eq(c, hexa_str("\"")))) {
                                        done = hexa_bool(1);
                                        pos = hexa_add(pos, hexa_int(1));
                                        col = hexa_add(col, hexa_int(1));
                                    } else {
                                        if (hexa_truthy(hexa_eq(c, hexa_str("\\")))) {
                                            pos = hexa_add(pos, hexa_int(1));
                                            col = hexa_add(col, hexa_int(1));
                                            if (hexa_truthy(hexa_bool((pos).i < (total).i))) {
                                                HexaVal esc = hexa_index_get(chars, pos);
                                                if (hexa_truthy(hexa_eq(esc, hexa_str("n")))) {
                                                    s = hexa_add(s, hexa_str("\n"));
                                                } else {
                                                    if (hexa_truthy(hexa_eq(esc, hexa_str("t")))) {
                                                        s = hexa_add(s, hexa_str("\t"));
                                                    } else {
                                                        if (hexa_truthy(hexa_eq(esc, hexa_str("r")))) {
                                                            s = hexa_add(s, hexa_str("\r"));
                                                        } else {
                                                            if (hexa_truthy(hexa_eq(esc, hexa_str("\\")))) {
                                                                s = hexa_add(s, hexa_str("\\"));
                                                            } else {
                                                                if (hexa_truthy(hexa_eq(esc, hexa_str("\"")))) {
                                                                    s = hexa_add(s, hexa_str("\""));
                                                                } else {
                                                                    if (hexa_truthy(hexa_eq(esc, hexa_str("0")))) {
                                                                        s = hexa_add(s, hexa_str(""));
                                                                    } else {
                                                                        s = hexa_add(s, hexa_to_string(esc));
                                                                    }
                                                                }
                                                            }
                                                        }
                                                    }
                                                }
                                                pos = hexa_add(pos, hexa_int(1));
                                                col = hexa_add(col, hexa_int(1));
                                            }
                                        } else {
                                            s = hexa_add(s, hexa_to_string(c));
                                            pos = hexa_add(pos, hexa_int(1));
                                            if (hexa_truthy(hexa_eq(c, hexa_str("\n")))) {
                                                line = hexa_add(line, hexa_int(1));
                                                col = hexa_int(1);
                                            } else {
                                                col = hexa_add(col, hexa_int(1));
                                            }
                                        }
                                    }
                                }
                                tokens = hexa_array_push(tokens, Token(hexa_str("StringLit"), s, line, start_col));
                            } else {
                                if (hexa_truthy(hexa_eq(ch, hexa_str("'")))) {
                                    HexaVal start_col = col;
                                    pos = hexa_add(pos, hexa_int(1));
                                    col = hexa_add(col, hexa_int(1));
                                    HexaVal ch_val = hexa_str("");
                                    if (hexa_truthy(hexa_bool(hexa_truthy(hexa_bool((pos).i < (total).i)) && hexa_truthy(hexa_eq(hexa_index_get(chars, pos), hexa_str("\\")))))) {
                                        pos = hexa_add(pos, hexa_int(1));
                                        col = hexa_add(col, hexa_int(1));
                                        if (hexa_truthy(hexa_bool((pos).i < (total).i))) {
                                            HexaVal esc = hexa_index_get(chars, pos);
                                            if (hexa_truthy(hexa_eq(esc, hexa_str("n")))) {
                                                ch_val = hexa_str("\n");
                                            } else {
                                                if (hexa_truthy(hexa_eq(esc, hexa_str("t")))) {
                                                    ch_val = hexa_str("\t");
                                                } else {
                                                    if (hexa_truthy(hexa_eq(esc, hexa_str("r")))) {
                                                        ch_val = hexa_str("\r");
                                                    } else {
                                                        if (hexa_truthy(hexa_eq(esc, hexa_str("\\")))) {
                                                            ch_val = hexa_str("\\");
                                                        } else {
                                                            if (hexa_truthy(hexa_eq(esc, hexa_str("'")))) {
                                                                ch_val = hexa_str("'");
                                                            } else {
                                                                if (hexa_truthy(hexa_eq(esc, hexa_str("0")))) {
                                                                    ch_val = hexa_str("");
                                                                } else {
                                                                    ch_val = hexa_to_string(esc);
                                                                }
                                                            }
                                                        }
                                                    }
                                                }
                                            }
                                            pos = hexa_add(pos, hexa_int(1));
                                            col = hexa_add(col, hexa_int(1));
                                        }
                                    } else {
                                        if (hexa_truthy(hexa_bool((pos).i < (total).i))) {
                                            ch_val = hexa_to_string(hexa_index_get(chars, pos));
                                            pos = hexa_add(pos, hexa_int(1));
                                            col = hexa_add(col, hexa_int(1));
                                        }
                                    }
                                    if (hexa_truthy(hexa_bool(hexa_truthy(hexa_bool((pos).i < (total).i)) && hexa_truthy(hexa_eq(hexa_index_get(chars, pos), hexa_str("'")))))) {
                                        pos = hexa_add(pos, hexa_int(1));
                                        col = hexa_add(col, hexa_int(1));
                                    }
                                    tokens = hexa_array_push(tokens, Token(hexa_str("CharLit"), ch_val, line, start_col));
                                } else {
                                    HexaVal start_col = col;
                                    if (hexa_truthy(hexa_eq(ch, hexa_str("+")))) {
                                        tokens = hexa_array_push(tokens, Token(hexa_str("Plus"), hexa_str("+"), line, start_col));
                                        pos = hexa_add(pos, hexa_int(1));
                                        col = hexa_add(col, hexa_int(1));
                                    } else {
                                        if (hexa_truthy(hexa_eq(ch, hexa_str("-")))) {
                                            if (hexa_truthy(hexa_bool(hexa_truthy(hexa_bool((hexa_add(pos, hexa_int(1))).i < (total).i)) && hexa_truthy(hexa_eq(hexa_index_get(chars, hexa_add(pos, hexa_int(1))), hexa_str(">")))))) {
                                                tokens = hexa_array_push(tokens, Token(hexa_str("Arrow"), hexa_str("->"), line, start_col));
                                                pos = hexa_add(pos, hexa_int(2));
                                                col = hexa_add(col, hexa_int(2));
                                            } else {
                                                tokens = hexa_array_push(tokens, Token(hexa_str("Minus"), hexa_str("-"), line, start_col));
                                                pos = hexa_add(pos, hexa_int(1));
                                                col = hexa_add(col, hexa_int(1));
                                            }
                                        } else {
                                            if (hexa_truthy(hexa_eq(ch, hexa_str("*")))) {
                                                if (hexa_truthy(hexa_bool(hexa_truthy(hexa_bool((hexa_add(pos, hexa_int(1))).i < (total).i)) && hexa_truthy(hexa_eq(hexa_index_get(chars, hexa_add(pos, hexa_int(1))), hexa_str("*")))))) {
                                                    tokens = hexa_array_push(tokens, Token(hexa_str("Power"), hexa_str("**"), line, start_col));
                                                    pos = hexa_add(pos, hexa_int(2));
                                                    col = hexa_add(col, hexa_int(2));
                                                } else {
                                                    tokens = hexa_array_push(tokens, Token(hexa_str("Star"), hexa_str("*"), line, start_col));
                                                    pos = hexa_add(pos, hexa_int(1));
                                                    col = hexa_add(col, hexa_int(1));
                                                }
                                            } else {
                                                if (hexa_truthy(hexa_eq(ch, hexa_str("/")))) {
                                                    tokens = hexa_array_push(tokens, Token(hexa_str("Slash"), hexa_str("/"), line, start_col));
                                                    pos = hexa_add(pos, hexa_int(1));
                                                    col = hexa_add(col, hexa_int(1));
                                                } else {
                                                    if (hexa_truthy(hexa_eq(ch, hexa_str("%")))) {
                                                        tokens = hexa_array_push(tokens, Token(hexa_str("Percent"), hexa_str("%"), line, start_col));
                                                        pos = hexa_add(pos, hexa_int(1));
                                                        col = hexa_add(col, hexa_int(1));
                                                    } else {
                                                        if (hexa_truthy(hexa_eq(ch, hexa_str("=")))) {
                                                            if (hexa_truthy(hexa_bool(hexa_truthy(hexa_bool((hexa_add(pos, hexa_int(1))).i < (total).i)) && hexa_truthy(hexa_eq(hexa_index_get(chars, hexa_add(pos, hexa_int(1))), hexa_str("=")))))) {
                                                                tokens = hexa_array_push(tokens, Token(hexa_str("EqEq"), hexa_str("=="), line, start_col));
                                                                pos = hexa_add(pos, hexa_int(2));
                                                                col = hexa_add(col, hexa_int(2));
                                                            } else {
                                                                tokens = hexa_array_push(tokens, Token(hexa_str("Eq"), hexa_str("="), line, start_col));
                                                                pos = hexa_add(pos, hexa_int(1));
                                                                col = hexa_add(col, hexa_int(1));
                                                            }
                                                        } else {
                                                            if (hexa_truthy(hexa_eq(ch, hexa_str("!")))) {
                                                                if (hexa_truthy(hexa_bool(hexa_truthy(hexa_bool((hexa_add(pos, hexa_int(1))).i < (total).i)) && hexa_truthy(hexa_eq(hexa_index_get(chars, hexa_add(pos, hexa_int(1))), hexa_str("=")))))) {
                                                                    tokens = hexa_array_push(tokens, Token(hexa_str("NotEq"), hexa_str("!="), line, start_col));
                                                                    pos = hexa_add(pos, hexa_int(2));
                                                                    col = hexa_add(col, hexa_int(2));
                                                                } else {
                                                                    tokens = hexa_array_push(tokens, Token(hexa_str("Not"), hexa_str("!"), line, start_col));
                                                                    pos = hexa_add(pos, hexa_int(1));
                                                                    col = hexa_add(col, hexa_int(1));
                                                                }
                                                            } else {
                                                                if (hexa_truthy(hexa_eq(ch, hexa_str("<")))) {
                                                                    if (hexa_truthy(hexa_bool(hexa_truthy(hexa_bool((hexa_add(pos, hexa_int(1))).i < (total).i)) && hexa_truthy(hexa_eq(hexa_index_get(chars, hexa_add(pos, hexa_int(1))), hexa_str("=")))))) {
                                                                        tokens = hexa_array_push(tokens, Token(hexa_str("LtEq"), hexa_str("<="), line, start_col));
                                                                        pos = hexa_add(pos, hexa_int(2));
                                                                        col = hexa_add(col, hexa_int(2));
                                                                    } else {
                                                                        tokens = hexa_array_push(tokens, Token(hexa_str("Lt"), hexa_str("<"), line, start_col));
                                                                        pos = hexa_add(pos, hexa_int(1));
                                                                        col = hexa_add(col, hexa_int(1));
                                                                    }
                                                                } else {
                                                                    if (hexa_truthy(hexa_eq(ch, hexa_str(">")))) {
                                                                        if (hexa_truthy(hexa_bool(hexa_truthy(hexa_bool((hexa_add(pos, hexa_int(1))).i < (total).i)) && hexa_truthy(hexa_eq(hexa_index_get(chars, hexa_add(pos, hexa_int(1))), hexa_str("=")))))) {
                                                                            tokens = hexa_array_push(tokens, Token(hexa_str("GtEq"), hexa_str(">="), line, start_col));
                                                                            pos = hexa_add(pos, hexa_int(2));
                                                                            col = hexa_add(col, hexa_int(2));
                                                                        } else {
                                                                            tokens = hexa_array_push(tokens, Token(hexa_str("Gt"), hexa_str(">"), line, start_col));
                                                                            pos = hexa_add(pos, hexa_int(1));
                                                                            col = hexa_add(col, hexa_int(1));
                                                                        }
                                                                    } else {
                                                                        if (hexa_truthy(hexa_eq(ch, hexa_str("&")))) {
                                                                            if (hexa_truthy(hexa_bool(hexa_truthy(hexa_bool((hexa_add(pos, hexa_int(1))).i < (total).i)) && hexa_truthy(hexa_eq(hexa_index_get(chars, hexa_add(pos, hexa_int(1))), hexa_str("&")))))) {
                                                                                tokens = hexa_array_push(tokens, Token(hexa_str("And"), hexa_str("&&"), line, start_col));
                                                                                pos = hexa_add(pos, hexa_int(2));
                                                                                col = hexa_add(col, hexa_int(2));
                                                                            } else {
                                                                                tokens = hexa_array_push(tokens, Token(hexa_str("BitAnd"), hexa_str("&"), line, start_col));
                                                                                pos = hexa_add(pos, hexa_int(1));
                                                                                col = hexa_add(col, hexa_int(1));
                                                                            }
                                                                        } else {
                                                                            if (hexa_truthy(hexa_eq(ch, hexa_str("|")))) {
                                                                                if (hexa_truthy(hexa_bool(hexa_truthy(hexa_bool((hexa_add(pos, hexa_int(1))).i < (total).i)) && hexa_truthy(hexa_eq(hexa_index_get(chars, hexa_add(pos, hexa_int(1))), hexa_str("|")))))) {
                                                                                    tokens = hexa_array_push(tokens, Token(hexa_str("Or"), hexa_str("||"), line, start_col));
                                                                                    pos = hexa_add(pos, hexa_int(2));
                                                                                    col = hexa_add(col, hexa_int(2));
                                                                                } else {
                                                                                    tokens = hexa_array_push(tokens, Token(hexa_str("BitOr"), hexa_str("|"), line, start_col));
                                                                                    pos = hexa_add(pos, hexa_int(1));
                                                                                    col = hexa_add(col, hexa_int(1));
                                                                                }
                                                                            } else {
                                                                                if (hexa_truthy(hexa_eq(ch, hexa_str("^")))) {
                                                                                    if (hexa_truthy(hexa_bool(hexa_truthy(hexa_bool((hexa_add(pos, hexa_int(1))).i < (total).i)) && hexa_truthy(hexa_eq(hexa_index_get(chars, hexa_add(pos, hexa_int(1))), hexa_str("^")))))) {
                                                                                        tokens = hexa_array_push(tokens, Token(hexa_str("Xor"), hexa_str("^^"), line, start_col));
                                                                                        pos = hexa_add(pos, hexa_int(2));
                                                                                        col = hexa_add(col, hexa_int(2));
                                                                                    } else {
                                                                                        tokens = hexa_array_push(tokens, Token(hexa_str("BitXor"), hexa_str("^"), line, start_col));
                                                                                        pos = hexa_add(pos, hexa_int(1));
                                                                                        col = hexa_add(col, hexa_int(1));
                                                                                    }
                                                                                } else {
                                                                                    if (hexa_truthy(hexa_eq(ch, hexa_str("~")))) {
                                                                                        tokens = hexa_array_push(tokens, Token(hexa_str("BitNot"), hexa_str("~"), line, start_col));
                                                                                        pos = hexa_add(pos, hexa_int(1));
                                                                                        col = hexa_add(col, hexa_int(1));
                                                                                    } else {
                                                                                        if (hexa_truthy(hexa_eq(ch, hexa_str("?")))) {
                                                                                            if (hexa_truthy(hexa_bool(hexa_truthy(hexa_bool((hexa_add(pos, hexa_int(1))).i < (total).i)) && hexa_truthy(hexa_eq(hexa_index_get(chars, hexa_add(pos, hexa_int(1))), hexa_str("?")))))) {
                                                                                                tokens = hexa_array_push(tokens, Token(hexa_str("NullCoal"), hexa_str("??"), line, start_col));
                                                                                                pos = hexa_add(pos, hexa_int(2));
                                                                                                col = hexa_add(col, hexa_int(2));
                                                                                            } else {
                                                                                                tokens = hexa_array_push(tokens, Token(hexa_str("Question"), hexa_str("?"), line, start_col));
                                                                                                pos = hexa_add(pos, hexa_int(1));
                                                                                                col = hexa_add(col, hexa_int(1));
                                                                                            }
                                                                                        } else {
                                                                                        if (hexa_truthy(hexa_eq(ch, hexa_str(":")))) {
                                                                                            if (hexa_truthy(hexa_bool(hexa_truthy(hexa_bool((hexa_add(pos, hexa_int(1))).i < (total).i)) && hexa_truthy(hexa_eq(hexa_index_get(chars, hexa_add(pos, hexa_int(1))), hexa_str("=")))))) {
                                                                                                tokens = hexa_array_push(tokens, Token(hexa_str("ColonEq"), hexa_str(":="), line, start_col));
                                                                                                pos = hexa_add(pos, hexa_int(2));
                                                                                                col = hexa_add(col, hexa_int(2));
                                                                                            } else {
                                                                                                if (hexa_truthy(hexa_bool(hexa_truthy(hexa_bool((hexa_add(pos, hexa_int(1))).i < (total).i)) && hexa_truthy(hexa_eq(hexa_index_get(chars, hexa_add(pos, hexa_int(1))), hexa_str(":")))))) {
                                                                                                    tokens = hexa_array_push(tokens, Token(hexa_str("ColonColon"), hexa_str("::"), line, start_col));
                                                                                                    pos = hexa_add(pos, hexa_int(2));
                                                                                                    col = hexa_add(col, hexa_int(2));
                                                                                                } else {
                                                                                                    tokens = hexa_array_push(tokens, Token(hexa_str("Colon"), hexa_str(":"), line, start_col));
                                                                                                    pos = hexa_add(pos, hexa_int(1));
                                                                                                    col = hexa_add(col, hexa_int(1));
                                                                                                }
                                                                                            }
                                                                                        } else {
                                                                                            if (hexa_truthy(hexa_eq(ch, hexa_str(".")))) {
                                                                                                if (hexa_truthy(hexa_bool(hexa_truthy(hexa_bool((hexa_add(pos, hexa_int(1))).i < (total).i)) && hexa_truthy(hexa_eq(hexa_index_get(chars, hexa_add(pos, hexa_int(1))), hexa_str(".")))))) {
                                                                                                    if (hexa_truthy(hexa_bool(hexa_truthy(hexa_bool((hexa_add(pos, hexa_int(2))).i < (total).i)) && hexa_truthy(hexa_eq(hexa_index_get(chars, hexa_add(pos, hexa_int(2))), hexa_str("=")))))) {
                                                                                                        tokens = hexa_array_push(tokens, Token(hexa_str("DotDotEq"), hexa_str("..="), line, start_col));
                                                                                                        pos = hexa_add(pos, hexa_int(3));
                                                                                                        col = hexa_add(col, hexa_int(3));
                                                                                                    } else {
                                                                                                        tokens = hexa_array_push(tokens, Token(hexa_str("DotDot"), hexa_str(".."), line, start_col));
                                                                                                        pos = hexa_add(pos, hexa_int(2));
                                                                                                        col = hexa_add(col, hexa_int(2));
                                                                                                    }
                                                                                                } else {
                                                                                                    tokens = hexa_array_push(tokens, Token(hexa_str("Dot"), hexa_str("."), line, start_col));
                                                                                                    pos = hexa_add(pos, hexa_int(1));
                                                                                                    col = hexa_add(col, hexa_int(1));
                                                                                                }
                                                                                            } else {
                                                                                                if (hexa_truthy(hexa_eq(ch, hexa_str("(")))) {
                                                                                                    tokens = hexa_array_push(tokens, Token(hexa_str("LParen"), hexa_str("("), line, start_col));
                                                                                                    pos = hexa_add(pos, hexa_int(1));
                                                                                                    col = hexa_add(col, hexa_int(1));
                                                                                                } else {
                                                                                                    if (hexa_truthy(hexa_eq(ch, hexa_str(")")))) {
                                                                                                        tokens = hexa_array_push(tokens, Token(hexa_str("RParen"), hexa_str(")"), line, start_col));
                                                                                                        pos = hexa_add(pos, hexa_int(1));
                                                                                                        col = hexa_add(col, hexa_int(1));
                                                                                                    } else {
                                                                                                        if (hexa_truthy(hexa_eq(ch, hexa_str("{")))) {
                                                                                                            tokens = hexa_array_push(tokens, Token(hexa_str("LBrace"), hexa_str("{"), line, start_col));
                                                                                                            pos = hexa_add(pos, hexa_int(1));
                                                                                                            col = hexa_add(col, hexa_int(1));
                                                                                                        } else {
                                                                                                            if (hexa_truthy(hexa_eq(ch, hexa_str("}")))) {
                                                                                                                tokens = hexa_array_push(tokens, Token(hexa_str("RBrace"), hexa_str("}"), line, start_col));
                                                                                                                pos = hexa_add(pos, hexa_int(1));
                                                                                                                col = hexa_add(col, hexa_int(1));
                                                                                                            } else {
                                                                                                                if (hexa_truthy(hexa_eq(ch, hexa_str("[")))) {
                                                                                                                    tokens = hexa_array_push(tokens, Token(hexa_str("LBracket"), hexa_str("["), line, start_col));
                                                                                                                    pos = hexa_add(pos, hexa_int(1));
                                                                                                                    col = hexa_add(col, hexa_int(1));
                                                                                                                } else {
                                                                                                                    if (hexa_truthy(hexa_eq(ch, hexa_str("]")))) {
                                                                                                                        tokens = hexa_array_push(tokens, Token(hexa_str("RBracket"), hexa_str("]"), line, start_col));
                                                                                                                        pos = hexa_add(pos, hexa_int(1));
                                                                                                                        col = hexa_add(col, hexa_int(1));
                                                                                                                    } else {
                                                                                                                        if (hexa_truthy(hexa_eq(ch, hexa_str(",")))) {
                                                                                                                            tokens = hexa_array_push(tokens, Token(hexa_str("Comma"), hexa_str(","), line, start_col));
                                                                                                                            pos = hexa_add(pos, hexa_int(1));
                                                                                                                            col = hexa_add(col, hexa_int(1));
                                                                                                                        } else {
                                                                                                                            if (hexa_truthy(hexa_eq(ch, hexa_str(";")))) {
                                                                                                                                tokens = hexa_array_push(tokens, Token(hexa_str("Semicolon"), hexa_str(";"), line, start_col));
                                                                                                                                pos = hexa_add(pos, hexa_int(1));
                                                                                                                                col = hexa_add(col, hexa_int(1));
                                                                                                                            } else {
                                                                                                                                if (hexa_truthy(hexa_eq(ch, hexa_str("@")))) {
                                                                                                                                    tokens = hexa_array_push(tokens, Token(hexa_str("At"), hexa_str("@"), line, start_col));
                                                                                                                                    pos = hexa_add(pos, hexa_int(1));
                                                                                                                                    col = hexa_add(col, hexa_int(1));
                                                                                                                                } else {
                                                                                                                                    if (hexa_truthy(hexa_eq(ch, hexa_str("#")))) {
                                                                                                                                        if (hexa_truthy(hexa_bool(hexa_truthy(hexa_bool((hexa_add(pos, hexa_int(1))).i < (total).i)) && hexa_truthy(hexa_eq(hexa_index_get(chars, hexa_add(pos, hexa_int(1))), hexa_str("{")))))) {
                                                                                                                                            tokens = hexa_array_push(tokens, Token(hexa_str("HashLBrace"), hexa_str("#{"), line, start_col));
                                                                                                                                            pos = hexa_add(pos, hexa_int(2));
                                                                                                                                            col = hexa_add(col, hexa_int(2));
                                                                                                                                        } else {
                                                                                                                                            pos = hexa_add(pos, hexa_int(1));
                                                                                                                                            col = hexa_add(col, hexa_int(1));
                                                                                                                                        }
                                                                                                                                    } else {
                                                                                                                                        pos = hexa_add(pos, hexa_int(1));
                                                                                                                                        col = hexa_add(col, hexa_int(1));
                                                                                                                                    }
                                                                                                                                }
                                                                                                                            }
                                                                                                                        }
                                                                                                                    }
                                                                                                                }
                                                                                                            }
                                                                                                        }
                                                                                                    }
                                                                                                }
                                                                                            }
                                                                                        }
                                                                                    }
                                                                                }
                                                                            }
                                                                        }
                                                                    }
                                                                }
                                                            }
                                                        }
                                                    }
                                                }
                                            }
                                            }
                                        }
                                    }
                                }
                            }
                        }
                    }
                }
            }
        }
    }
    tokens = hexa_array_push(tokens, Token(hexa_str("Eof"), hexa_str(""), line, col));
    return tokens;
    return hexa_void();
}


int main() {
    p_tokens = hexa_array_new();
    p_pos = hexa_int(0);
    p_pending_symbol = hexa_str("");
    p_pending_link = hexa_str("");
    p_pending_attrs = hexa_str("");
    p_errors = hexa_array_new();
    p_max_errors = hexa_int(50);
    hexa_println(hexa_str("=== HEXA Self-Hosting Parser ==="));
    hexa_println(hexa_str(""));
    HexaVal t1 = tokenize(hexa_str("let x = 42"));
    HexaVal ast1 = parse(t1);
    hexa_println(hexa_str("Test 1: let x = 42"));
    print_ast(ast1);
    /* AssertStmt */
    /* AssertStmt */
    /* AssertStmt */
    /* AssertStmt */
    /* AssertStmt */
    hexa_println(hexa_str("  PASS"));
    hexa_println(hexa_str(""));
    HexaVal t2 = tokenize(hexa_str("fn add(a, b) {\n  a + b\n}"));
    HexaVal ast2 = parse(t2);
    hexa_println(hexa_str("Test 2: fn add(a, b) { a + b }"));
    print_ast(ast2);
    /* AssertStmt */
    /* AssertStmt */
    /* AssertStmt */
    /* AssertStmt */
    /* AssertStmt */
    /* AssertStmt */
    /* AssertStmt */
    hexa_println(hexa_str("  PASS"));
    hexa_println(hexa_str(""));
    HexaVal t3 = tokenize(hexa_str("if x > 0 { x } else { -x }"));
    HexaVal ast3 = parse(t3);
    hexa_println(hexa_str("Test 3: if x > 0 { x } else { -x }"));
    print_ast(ast3);
    /* AssertStmt */
    /* AssertStmt */
    /* AssertStmt */
    /* AssertStmt */
    /* AssertStmt */
    /* AssertStmt */
    /* AssertStmt */
    hexa_println(hexa_str("  PASS"));
    hexa_println(hexa_str(""));
    HexaVal t4 = tokenize(hexa_str("1 + 2 * 3"));
    HexaVal ast4 = parse(t4);
    hexa_println(hexa_str("Test 4: 1 + 2 * 3 (precedence)"));
    print_ast(ast4);
    /* AssertStmt */
    /* AssertStmt */
    HexaVal expr4 = hexa_map_get(hexa_index_get(ast4, hexa_int(0)), "left");
    /* AssertStmt */
    /* AssertStmt */
    /* AssertStmt */
    /* AssertStmt */
    /* AssertStmt */
    /* AssertStmt */
    /* AssertStmt */
    /* AssertStmt */
    hexa_println(hexa_str("  PASS"));
    hexa_println(hexa_str(""));
    HexaVal t5 = tokenize(hexa_str("struct Point {\n  x: float,\n  y: float\n}"));
    HexaVal ast5 = parse(t5);
    hexa_println(hexa_str("Test 5: struct Point { x: float, y: float }"));
    print_ast(ast5);
    /* AssertStmt */
    /* AssertStmt */
    /* AssertStmt */
    /* AssertStmt */
    /* AssertStmt */
    /* AssertStmt */
    /* AssertStmt */
    /* AssertStmt */
    hexa_println(hexa_str("  PASS"));
    hexa_println(hexa_str(""));
    HexaVal t6 = tokenize(hexa_str("for i in 0..10 {\n  print(i)\n}"));
    HexaVal ast6 = parse(t6);
    hexa_println(hexa_str("Test 6: for i in 0..10 { print(i) }"));
    print_ast(ast6);
    /* AssertStmt */
    /* AssertStmt */
    /* AssertStmt */
    /* AssertStmt */
    /* AssertStmt */
    hexa_println(hexa_str("  PASS"));
    hexa_println(hexa_str(""));
    HexaVal t7 = tokenize(hexa_str("const PI = 3.14\nfn get_pi() {\n  return PI\n}"));
    HexaVal ast7 = parse(t7);
    hexa_println(hexa_str("Test 7: const + fn with return"));
    print_ast(ast7);
    /* AssertStmt */
    /* AssertStmt */
    /* AssertStmt */
    /* AssertStmt */
    /* AssertStmt */
    /* AssertStmt */
    hexa_println(hexa_str("  PASS"));
    hexa_println(hexa_str(""));
    HexaVal t8 = tokenize(hexa_str("enum Color {\n  Red,\n  Green,\n  Blue\n}"));
    HexaVal ast8 = parse(t8);
    hexa_println(hexa_str("Test 8: enum Color { Red, Green, Blue }"));
    print_ast(ast8);
    /* AssertStmt */
    /* AssertStmt */
    /* AssertStmt */
    /* AssertStmt */
    hexa_println(hexa_str("  PASS"));
    hexa_println(hexa_str(""));
    HexaVal code9 = hexa_str("fn factorial(n) {\n  if n <= 1 {\n    return 1\n  }\n  return n * factorial(n - 1)\n}");
    HexaVal t9 = tokenize(code9);
    HexaVal ast9 = parse(t9);
    hexa_println(hexa_str("Test 9: round-trip factorial function"));
    print_ast(ast9);
    /* AssertStmt */
    /* AssertStmt */
    /* AssertStmt */
    /* AssertStmt */
    /* AssertStmt */
    hexa_println(hexa_str("  PASS"));
    hexa_println(hexa_str(""));
    HexaVal t10 = tokenize(hexa_str("arr.push(x).len()"));
    HexaVal ast10 = parse(t10);
    hexa_println(hexa_str("Test 10: arr.push(x).len()"));
    print_ast(ast10);
    /* AssertStmt */
    /* AssertStmt */
    HexaVal e10 = hexa_map_get(hexa_index_get(ast10, hexa_int(0)), "left");
    /* AssertStmt */
    /* AssertStmt */
    /* AssertStmt */
    hexa_println(hexa_str("  PASS"));
    hexa_println(hexa_str(""));
    HexaVal t11 = tokenize(hexa_str("match x {\n  0 -> \"zero\",\n  _ -> \"other\"\n}"));
    HexaVal ast11 = parse(t11);
    hexa_println(hexa_str("Test 11: match expression"));
    print_ast(ast11);
    /* AssertStmt */
    /* AssertStmt */
    /* AssertStmt */
    /* AssertStmt */
    hexa_println(hexa_str("  PASS"));
    hexa_println(hexa_str(""));
    HexaVal t12 = tokenize(hexa_str("let mut i = 0\nwhile i < 10 {\n  i = i + 1\n}"));
    HexaVal ast12 = parse(t12);
    hexa_println(hexa_str("Test 12: let mut + while + assignment"));
    print_ast(ast12);
    /* AssertStmt */
    /* AssertStmt */
    /* AssertStmt */
    /* AssertStmt */
    /* AssertStmt */
    /* AssertStmt */
    hexa_println(hexa_str("  PASS"));
    hexa_println(hexa_str(""));
    HexaVal t13 = tokenize(hexa_str("!true"));
    HexaVal ast13 = parse(t13);
    hexa_println(hexa_str("Test 13: !true (unary)"));
    print_ast(ast13);
    /* AssertStmt */
    /* AssertStmt */
    /* AssertStmt */
    hexa_println(hexa_str("  PASS"));
    hexa_println(hexa_str(""));
    HexaVal t14 = tokenize(hexa_str("[1, 2, 3][0]"));
    HexaVal ast14 = parse(t14);
    hexa_println(hexa_str("Test 14: [1,2,3][0] (array + index)"));
    print_ast(ast14);
    /* AssertStmt */
    /* AssertStmt */
    /* AssertStmt */
    hexa_println(hexa_str("  PASS"));
    hexa_println(hexa_str(""));
    HexaVal t15 = tokenize(hexa_str("loop {\n  break\n}"));
    HexaVal ast15 = parse(t15);
    hexa_println(hexa_str("Test 15: loop { break }"));
    print_ast(ast15);
    /* AssertStmt */
    /* AssertStmt */
    /* AssertStmt */
    hexa_println(hexa_str("  PASS"));
    hexa_println(hexa_str(""));
    HexaVal t16 = tokenize(hexa_str("comptime const N = 6"));
    HexaVal ast16 = parse(t16);
    hexa_println(hexa_str("Test 16: comptime const N = 6"));
    print_ast(ast16);
    /* AssertStmt */
    /* AssertStmt */
    /* AssertStmt */
    hexa_println(hexa_str("  PASS"));
    hexa_println(hexa_str(""));
    HexaVal t17 = tokenize(hexa_str("pure fn add(a, b) {\n  a + b\n}"));
    HexaVal ast17 = parse(t17);
    hexa_println(hexa_str("Test 17: pure fn add(a, b)"));
    print_ast(ast17);
    /* AssertStmt */
    /* AssertStmt */
    /* AssertStmt */
    /* AssertStmt */
    hexa_println(hexa_str("  PASS"));
    hexa_println(hexa_str(""));
    HexaVal t18 = tokenize(hexa_str("theorem add_comm {\n  assert 1 + 2 == 2 + 1\n}"));
    HexaVal ast18 = parse(t18);
    hexa_println(hexa_str("Test 18: theorem add_comm"));
    print_ast(ast18);
    /* AssertStmt */
    /* AssertStmt */
    /* AssertStmt */
    /* AssertStmt */
    hexa_println(hexa_str("  PASS"));
    hexa_println(hexa_str(""));
    HexaVal t19 = tokenize(hexa_str("yield 42"));
    HexaVal ast19 = parse(t19);
    hexa_println(hexa_str("Test 19: yield 42"));
    print_ast(ast19);
    /* AssertStmt */
    /* AssertStmt */
    /* AssertStmt */
    hexa_println(hexa_str("  PASS"));
    hexa_println(hexa_str(""));
    HexaVal t20 = tokenize(hexa_str("optimize fn fib(n) {\n  n + 1\n}"));
    HexaVal ast20 = parse(t20);
    hexa_println(hexa_str("Test 20: optimize fn fib(n)"));
    print_ast(ast20);
    /* AssertStmt */
    /* AssertStmt */
    /* AssertStmt */
    hexa_println(hexa_str("  PASS"));
    hexa_println(hexa_str(""));
    HexaVal t21 = tokenize(hexa_str("extern fn getpid() -> Int"));
    HexaVal ast21 = parse(t21);
    hexa_println(hexa_str("Test 21: extern fn getpid() -> Int"));
    print_ast(ast21);
    /* AssertStmt */
    /* AssertStmt */
    /* AssertStmt */
    /* AssertStmt */
    /* AssertStmt */
    hexa_println(hexa_str("  PASS"));
    hexa_println(hexa_str(""));
    HexaVal t22 = tokenize(hexa_str("@symbol(\"objc_msgSend\")\nextern fn objc_send3(obj, sel, a1) -> Int"));
    HexaVal ast22 = parse(t22);
    hexa_println(hexa_str("Test 22: @symbol(\"objc_msgSend\") extern fn objc_send3"));
    print_ast(ast22);
    /* AssertStmt */
    /* AssertStmt */
    /* AssertStmt */
    /* AssertStmt */
    /* AssertStmt */
    hexa_println(hexa_str("  PASS"));
    hexa_println(hexa_str(""));
    HexaVal t23 = tokenize(hexa_str("@link(\"libm\")\n@symbol(\"cos\")\nextern fn my_cos(x) -> Float"));
    HexaVal ast23 = parse(t23);
    hexa_println(hexa_str("Test 23: @link + @symbol extern fn"));
    print_ast(ast23);
    /* AssertStmt */
    /* AssertStmt */
    /* AssertStmt */
    /* AssertStmt */
    /* AssertStmt */
    hexa_println(hexa_str("  PASS"));
    hexa_println(hexa_str(""));
    hexa_println(hexa_str("=== Self-Hosting Parser: ALL 23 TESTS PASSED ==="));
    /* ProofStmt */
    /* ProofStmt */
    /* ProofStmt */
    /* ProofStmt */
    /* ProofStmt */
    /* ProofStmt */
    /* ProofStmt */
    /* ProofStmt */
    /* ProofStmt */
    /* ProofStmt */
    /* ProofStmt */
    /* ProofStmt */
    /* ProofStmt */
    /* ProofStmt */
    /* ProofStmt */
    /* ProofStmt */
    /* ProofStmt */
    /* ProofStmt */
    /* ProofStmt */
    /* ProofStmt */
    /* ProofStmt */
    /* ProofStmt */
    /* ProofStmt */
    /* ProofStmt */
    /* ProofStmt */
    /* ProofStmt */
    /* ProofStmt */
    /* ProofStmt */
    /* ProofStmt */
    /* ProofStmt */
    /* ProofStmt */
    return 0;
}
