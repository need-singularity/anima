// Generated by HEXA self-host compiler
#include "runtime.c"

HexaVal tc_error(HexaVal msg);
HexaVal tc_error_at(HexaVal name, HexaVal msg);
HexaVal tc_push_scope(void);
HexaVal tc_pop_scope(void);
HexaVal tc_define(HexaVal name, HexaVal typ);
HexaVal tc_lookup(HexaVal name);
HexaVal tc_register_fn(HexaVal name, HexaVal arity, HexaVal ret_type);
HexaVal tc_lookup_fn_arity(HexaVal name);
HexaVal tc_lookup_fn_ret(HexaVal name);
HexaVal tc_register_struct(HexaVal name, HexaVal field_count);
HexaVal tc_register_struct_field(HexaVal fname, HexaVal ftype);
HexaVal tc_register_enum(HexaVal name, HexaVal variant_count);
HexaVal tc_register_enum_variant(HexaVal vname);
HexaVal tc_lookup_struct(HexaVal name);
HexaVal tc_lookup_struct_field(HexaVal struct_name, HexaVal field_name);
HexaVal tc_get_struct_field_names(HexaVal struct_name);
HexaVal tc_lookup_enum(HexaVal name);
HexaVal tc_get_enum_variants(HexaVal name);
HexaVal tc_warn(HexaVal msg);
HexaVal tc_warn_at(HexaVal name, HexaVal msg);
HexaVal tc_register_generic_struct(HexaVal name, HexaVal tparams);
HexaVal tc_register_generic_fn(HexaVal name, HexaVal tparams);
HexaVal tc_lookup_generic_struct_param_count(HexaVal name);
HexaVal tc_get_generic_struct_params(HexaVal name);
HexaVal tc_get_generic_struct_bounds(HexaVal name);
HexaVal tc_lookup_generic_fn_param_count(HexaVal name);
HexaVal tc_get_generic_fn_params(HexaVal name);
HexaVal tc_get_generic_fn_bounds(HexaVal name);
HexaVal tc_push_type_params(HexaVal tparams);
HexaVal tc_pop_type_params(HexaVal tparams);
HexaVal tc_is_type_param(HexaVal name);
HexaVal tc_get_type_param_bound(HexaVal name);
HexaVal tc_validate_type_args(HexaVal struct_name, HexaVal type_args);
HexaVal tc_validate_fn_type_args(HexaVal fn_name, HexaVal type_args);
HexaVal tc_register_builtins(void);
HexaVal annotation_to_type(HexaVal ann);
HexaVal types_compatible(HexaVal expected, HexaVal actual);
HexaVal tc_infer_expr(HexaVal node);
HexaVal tc_check_stmt(HexaVal node);
HexaVal tc_check_stmts(HexaVal stmts);
HexaVal tc_first_pass(HexaVal stmts);
HexaVal type_check(HexaVal stmts);
HexaVal type_check_ok(HexaVal stmts);
HexaVal print_type_errors(HexaVal errors);
HexaVal type_errors_count(HexaVal errors);
HexaVal type_errors_has(HexaVal errors, HexaVal substr);
HexaVal type_warnings_count(HexaVal errors);
HexaVal mk(HexaVal kind, HexaVal name, HexaVal value, HexaVal op, HexaVal left, HexaVal right, HexaVal params, HexaVal body, HexaVal args, HexaVal fields, HexaVal variants, HexaVal arms, HexaVal ret_type);
HexaVal nd(HexaVal kind, HexaVal name);
HexaVal lit(HexaVal kind, HexaVal val);
HexaVal let_stmt(HexaVal name, HexaVal init);
HexaVal expr_stmt(HexaVal e);
HexaVal ret_stmt(HexaVal e);
HexaVal fn_decl(HexaVal name, HexaVal params, HexaVal body, HexaVal ret);
HexaVal call_node(HexaVal callee, HexaVal args);
HexaVal field_node(HexaVal obj, HexaVal fname);
HexaVal binop_node(HexaVal op, HexaVal left, HexaVal right);
HexaVal struct_decl_node(HexaVal name, HexaVal fields);
HexaVal struct_field_node(HexaVal name, HexaVal typ);
HexaVal struct_init_node(HexaVal name, HexaVal fields);
HexaVal field_init_node(HexaVal name, HexaVal val);
HexaVal enum_decl_node(HexaVal name, HexaVal variants);
HexaVal enum_variant_node(HexaVal name);
HexaVal match_expr_node(HexaVal scrutinee, HexaVal arms);
HexaVal match_arm_node(HexaVal pattern, HexaVal body);
HexaVal param_node(HexaVal name, HexaVal typ);

HexaVal tc_errors;
HexaVal scope_names;
HexaVal scope_types;
HexaVal scope_depths;
HexaVal tc_depth;
HexaVal fn_names;
HexaVal fn_arities;
HexaVal fn_ret_types;
HexaVal struct_names;
HexaVal struct_field_counts;
HexaVal struct_field_offsets;
HexaVal struct_all_field_names;
HexaVal struct_all_field_types;
HexaVal enum_names;
HexaVal enum_variant_counts;
HexaVal enum_variant_offsets;
HexaVal enum_all_variant_names;
HexaVal current_fn_ret_type;
HexaVal current_fn_name;
HexaVal generic_struct_names;
HexaVal generic_struct_param_counts;
HexaVal generic_struct_param_offsets;
HexaVal generic_all_param_names;
HexaVal generic_all_param_bounds;
HexaVal generic_fn_names;
HexaVal generic_fn_param_counts;
HexaVal generic_fn_param_offsets;
HexaVal generic_fn_all_param_names;
HexaVal generic_fn_all_param_bounds;
HexaVal tparam_names;
HexaVal tparam_bound;
HexaVal test_pass;
HexaVal s1;
HexaVal p2;
HexaVal body2;
HexaVal args2a;
HexaVal s2a;
HexaVal args2b;
HexaVal s2b;
HexaVal sf3;
HexaVal fi3;
HexaVal s3a;
HexaVal s3b;
HexaVal body4;
HexaVal s4;
HexaVal ev5;
HexaVal ab5a;
HexaVal arms5a;
HexaVal s5a;
HexaVal ab5b;
HexaVal arms5b;
HexaVal s5b;
HexaVal s6;
HexaVal fi7;
HexaVal s7;
HexaVal body8;
HexaVal s8;
HexaVal fi9;
HexaVal s9;
HexaVal inner_body;
HexaVal outer_body;
HexaVal s10;

HexaVal Token(HexaVal kind, HexaVal value, HexaVal line, HexaVal col) {
    HexaVal __s = hexa_map_new();
    __s = hexa_map_set(__s, "__type__", hexa_str("Token"));
    __s = hexa_map_set(__s, "kind", kind);
    __s = hexa_map_set(__s, "value", value);
    __s = hexa_map_set(__s, "line", line);
    __s = hexa_map_set(__s, "col", col);
    return __s;
}


HexaVal AstNode(HexaVal kind, HexaVal name, HexaVal value, HexaVal op, HexaVal left, HexaVal right, HexaVal cond, HexaVal then_body, HexaVal else_body, HexaVal params, HexaVal body, HexaVal args, HexaVal fields, HexaVal items, HexaVal variants, HexaVal arms, HexaVal iter_expr, HexaVal ret_type, HexaVal target, HexaVal trait_name, HexaVal methods) {
    HexaVal __s = hexa_map_new();
    __s = hexa_map_set(__s, "__type__", hexa_str("AstNode"));
    __s = hexa_map_set(__s, "kind", kind);
    __s = hexa_map_set(__s, "name", name);
    __s = hexa_map_set(__s, "value", value);
    __s = hexa_map_set(__s, "op", op);
    __s = hexa_map_set(__s, "left", left);
    __s = hexa_map_set(__s, "right", right);
    __s = hexa_map_set(__s, "cond", cond);
    __s = hexa_map_set(__s, "then_body", then_body);
    __s = hexa_map_set(__s, "else_body", else_body);
    __s = hexa_map_set(__s, "params", params);
    __s = hexa_map_set(__s, "body", body);
    __s = hexa_map_set(__s, "args", args);
    __s = hexa_map_set(__s, "fields", fields);
    __s = hexa_map_set(__s, "items", items);
    __s = hexa_map_set(__s, "variants", variants);
    __s = hexa_map_set(__s, "arms", arms);
    __s = hexa_map_set(__s, "iter_expr", iter_expr);
    __s = hexa_map_set(__s, "ret_type", ret_type);
    __s = hexa_map_set(__s, "target", target);
    __s = hexa_map_set(__s, "trait_name", trait_name);
    __s = hexa_map_set(__s, "methods", methods);
    return __s;
}


HexaVal TypeError(HexaVal message, HexaVal name) {
    HexaVal __s = hexa_map_new();
    __s = hexa_map_set(__s, "__type__", hexa_str("TypeError"));
    __s = hexa_map_set(__s, "message", message);
    __s = hexa_map_set(__s, "name", name);
    return __s;
}


HexaVal tc_error(HexaVal msg) {
    tc_errors = hexa_array_push(tc_errors, TypeError(msg, hexa_str("")));
    return hexa_void();
}


HexaVal tc_error_at(HexaVal name, HexaVal msg) {
    tc_errors = hexa_array_push(tc_errors, TypeError(msg, name));
    return hexa_void();
}


HexaVal TypeErrorEx(HexaVal message, HexaVal name, HexaVal severity) {
    HexaVal __s = hexa_map_new();
    __s = hexa_map_set(__s, "__type__", hexa_str("TypeErrorEx"));
    __s = hexa_map_set(__s, "message", message);
    __s = hexa_map_set(__s, "name", name);
    __s = hexa_map_set(__s, "severity", severity);
    return __s;
}


HexaVal tc_push_scope(void) {
    tc_depth = hexa_add(tc_depth, hexa_int(1));
    return hexa_void();
}


HexaVal tc_pop_scope(void) {
    HexaVal new_names = hexa_array_new();
    HexaVal new_types = hexa_array_new();
    HexaVal new_depths = hexa_array_new();
    HexaVal i = hexa_int(0);
    while (hexa_truthy(hexa_bool((i).i < (hexa_int(hexa_len(scope_names))).i))) {
        if (hexa_truthy(hexa_bool((hexa_index_get(scope_depths, i)).i < (tc_depth).i))) {
            new_names = hexa_array_push(new_names, hexa_index_get(scope_names, i));
            new_types = hexa_array_push(new_types, hexa_index_get(scope_types, i));
            new_depths = hexa_array_push(new_depths, hexa_index_get(scope_depths, i));
        }
        i = hexa_add(i, hexa_int(1));
    }
    scope_names = new_names;
    scope_types = new_types;
    scope_depths = new_depths;
    tc_depth = hexa_int((tc_depth).i - (hexa_int(1)).i);
    return hexa_void();
}


HexaVal tc_define(HexaVal name, HexaVal typ) {
    scope_names = hexa_array_push(scope_names, name);
    scope_types = hexa_array_push(scope_types, typ);
    scope_depths = hexa_array_push(scope_depths, tc_depth);
    return hexa_void();
}


HexaVal tc_lookup(HexaVal name) {
    HexaVal i = hexa_int((hexa_int(hexa_len(scope_names))).i - (hexa_int(1)).i);
    while (hexa_truthy(hexa_bool((i).i >= (hexa_int(0)).i))) {
        if (hexa_truthy(hexa_eq(hexa_index_get(scope_names, i), name))) {
            return hexa_index_get(scope_types, i);
        }
        i = hexa_int((i).i - (hexa_int(1)).i);
    }
    return hexa_str("");
    return hexa_void();
}


HexaVal tc_register_fn(HexaVal name, HexaVal arity, HexaVal ret_type) {
    fn_names = hexa_array_push(fn_names, name);
    fn_arities = hexa_array_push(fn_arities, arity);
    fn_ret_types = hexa_array_push(fn_ret_types, ret_type);
    return hexa_void();
}


HexaVal tc_lookup_fn_arity(HexaVal name) {
    HexaVal i = hexa_int(0);
    while (hexa_truthy(hexa_bool((i).i < (hexa_int(hexa_len(fn_names))).i))) {
        if (hexa_truthy(hexa_eq(hexa_index_get(fn_names, i), name))) {
            return hexa_index_get(fn_arities, i);
        }
        i = hexa_add(i, hexa_int(1));
    }
    return hexa_int(-(hexa_int(1)).i);
    return hexa_void();
}


HexaVal tc_lookup_fn_ret(HexaVal name) {
    HexaVal i = hexa_int(0);
    while (hexa_truthy(hexa_bool((i).i < (hexa_int(hexa_len(fn_names))).i))) {
        if (hexa_truthy(hexa_eq(hexa_index_get(fn_names, i), name))) {
            return hexa_index_get(fn_ret_types, i);
        }
        i = hexa_add(i, hexa_int(1));
    }
    return hexa_str("unknown");
    return hexa_void();
}


HexaVal tc_register_struct(HexaVal name, HexaVal field_count) {
    struct_names = hexa_array_push(struct_names, name);
    struct_field_counts = hexa_array_push(struct_field_counts, field_count);
    struct_field_offsets = hexa_array_push(struct_field_offsets, hexa_int(hexa_len(struct_all_field_names)));
    return hexa_void();
}


HexaVal tc_register_struct_field(HexaVal fname, HexaVal ftype) {
    struct_all_field_names = hexa_array_push(struct_all_field_names, fname);
    struct_all_field_types = hexa_array_push(struct_all_field_types, ftype);
    return hexa_void();
}


HexaVal tc_register_enum(HexaVal name, HexaVal variant_count) {
    enum_names = hexa_array_push(enum_names, name);
    enum_variant_counts = hexa_array_push(enum_variant_counts, variant_count);
    enum_variant_offsets = hexa_array_push(enum_variant_offsets, hexa_int(hexa_len(enum_all_variant_names)));
    return hexa_void();
}


HexaVal tc_register_enum_variant(HexaVal vname) {
    enum_all_variant_names = hexa_array_push(enum_all_variant_names, vname);
    return hexa_void();
}


HexaVal tc_lookup_struct(HexaVal name) {
    HexaVal i = hexa_int(0);
    while (hexa_truthy(hexa_bool((i).i < (hexa_int(hexa_len(struct_names))).i))) {
        if (hexa_truthy(hexa_eq(hexa_index_get(struct_names, i), name))) {
            return hexa_index_get(struct_field_counts, i);
        }
        i = hexa_add(i, hexa_int(1));
    }
    return hexa_int(-(hexa_int(1)).i);
    return hexa_void();
}


HexaVal tc_lookup_struct_field(HexaVal struct_name, HexaVal field_name) {
    HexaVal si = hexa_int(0);
    while (hexa_truthy(hexa_bool((si).i < (hexa_int(hexa_len(struct_names))).i))) {
        if (hexa_truthy(hexa_eq(hexa_index_get(struct_names, si), struct_name))) {
            HexaVal offset = hexa_index_get(struct_field_offsets, si);
            HexaVal count = hexa_index_get(struct_field_counts, si);
            HexaVal fi = hexa_int(0);
            while (hexa_truthy(hexa_bool((fi).i < (count).i))) {
                if (hexa_truthy(hexa_eq(hexa_index_get(struct_all_field_names, hexa_add(offset, fi)), field_name))) {
                    return hexa_index_get(struct_all_field_types, hexa_add(offset, fi));
                }
                fi = hexa_add(fi, hexa_int(1));
            }
            return hexa_str("");
        }
        si = hexa_add(si, hexa_int(1));
    }
    return hexa_str("");
    return hexa_void();
}


HexaVal tc_get_struct_field_names(HexaVal struct_name) {
    HexaVal result = hexa_array_new();
    HexaVal si = hexa_int(0);
    while (hexa_truthy(hexa_bool((si).i < (hexa_int(hexa_len(struct_names))).i))) {
        if (hexa_truthy(hexa_eq(hexa_index_get(struct_names, si), struct_name))) {
            HexaVal offset = hexa_index_get(struct_field_offsets, si);
            HexaVal count = hexa_index_get(struct_field_counts, si);
            HexaVal fi = hexa_int(0);
            while (hexa_truthy(hexa_bool((fi).i < (count).i))) {
                result = hexa_array_push(result, hexa_index_get(struct_all_field_names, hexa_add(offset, fi)));
                fi = hexa_add(fi, hexa_int(1));
            }
            return result;
        }
        si = hexa_add(si, hexa_int(1));
    }
    return result;
    return hexa_void();
}


HexaVal tc_lookup_enum(HexaVal name) {
    HexaVal i = hexa_int(0);
    while (hexa_truthy(hexa_bool((i).i < (hexa_int(hexa_len(enum_names))).i))) {
        if (hexa_truthy(hexa_eq(hexa_index_get(enum_names, i), name))) {
            return hexa_index_get(enum_variant_counts, i);
        }
        i = hexa_add(i, hexa_int(1));
    }
    return hexa_int(-(hexa_int(1)).i);
    return hexa_void();
}


HexaVal tc_get_enum_variants(HexaVal name) {
    HexaVal result = hexa_array_new();
    HexaVal ei = hexa_int(0);
    while (hexa_truthy(hexa_bool((ei).i < (hexa_int(hexa_len(enum_names))).i))) {
        if (hexa_truthy(hexa_eq(hexa_index_get(enum_names, ei), name))) {
            HexaVal offset = hexa_index_get(enum_variant_offsets, ei);
            HexaVal count = hexa_index_get(enum_variant_counts, ei);
            HexaVal vi = hexa_int(0);
            while (hexa_truthy(hexa_bool((vi).i < (count).i))) {
                result = hexa_array_push(result, hexa_index_get(enum_all_variant_names, hexa_add(offset, vi)));
                vi = hexa_add(vi, hexa_int(1));
            }
            return result;
        }
        ei = hexa_add(ei, hexa_int(1));
    }
    return result;
    return hexa_void();
}


HexaVal tc_warn(HexaVal msg) {
    tc_errors = hexa_array_push(tc_errors, TypeError(hexa_add(hexa_str("[warn] "), msg), hexa_str("")));
    return hexa_void();
}


HexaVal tc_warn_at(HexaVal name, HexaVal msg) {
    tc_errors = hexa_array_push(tc_errors, TypeError(hexa_add(hexa_str("[warn] "), msg), name));
    return hexa_void();
}


HexaVal tc_register_generic_struct(HexaVal name, HexaVal tparams) {
    HexaVal count = hexa_int(hexa_len(tparams));
    if (hexa_truthy(hexa_eq(count, hexa_int(0)))) {
        return hexa_void();
    }
    generic_struct_names = hexa_array_push(generic_struct_names, name);
    generic_struct_param_counts = hexa_array_push(generic_struct_param_counts, count);
    generic_struct_param_offsets = hexa_array_push(generic_struct_param_offsets, hexa_int(hexa_len(generic_all_param_names)));
    HexaVal i = hexa_int(0);
    while (hexa_truthy(hexa_bool((i).i < (count).i))) {
        generic_all_param_names = hexa_array_push(generic_all_param_names, hexa_map_get(hexa_index_get(tparams, i), "name"));
        HexaVal bound = hexa_map_get(hexa_index_get(tparams, i), "value");
        if (hexa_truthy(hexa_eq(bound, hexa_str("")))) {
            generic_all_param_bounds = hexa_array_push(generic_all_param_bounds, hexa_str(""));
        } else {
            generic_all_param_bounds = hexa_array_push(generic_all_param_bounds, bound);
        }
        i = hexa_add(i, hexa_int(1));
    }
    return hexa_void();
}


HexaVal tc_register_generic_fn(HexaVal name, HexaVal tparams) {
    HexaVal count = hexa_int(hexa_len(tparams));
    if (hexa_truthy(hexa_eq(count, hexa_int(0)))) {
        return hexa_void();
    }
    generic_fn_names = hexa_array_push(generic_fn_names, name);
    generic_fn_param_counts = hexa_array_push(generic_fn_param_counts, count);
    generic_fn_param_offsets = hexa_array_push(generic_fn_param_offsets, hexa_int(hexa_len(generic_fn_all_param_names)));
    HexaVal i = hexa_int(0);
    while (hexa_truthy(hexa_bool((i).i < (count).i))) {
        generic_fn_all_param_names = hexa_array_push(generic_fn_all_param_names, hexa_map_get(hexa_index_get(tparams, i), "name"));
        HexaVal bound = hexa_map_get(hexa_index_get(tparams, i), "value");
        if (hexa_truthy(hexa_eq(bound, hexa_str("")))) {
            generic_fn_all_param_bounds = hexa_array_push(generic_fn_all_param_bounds, hexa_str(""));
        } else {
            generic_fn_all_param_bounds = hexa_array_push(generic_fn_all_param_bounds, bound);
        }
        i = hexa_add(i, hexa_int(1));
    }
    return hexa_void();
}


HexaVal tc_lookup_generic_struct_param_count(HexaVal name) {
    HexaVal i = hexa_int(0);
    while (hexa_truthy(hexa_bool((i).i < (hexa_int(hexa_len(generic_struct_names))).i))) {
        if (hexa_truthy(hexa_eq(hexa_index_get(generic_struct_names, i), name))) {
            return hexa_index_get(generic_struct_param_counts, i);
        }
        i = hexa_add(i, hexa_int(1));
    }
    return hexa_int(0);
    return hexa_void();
}


HexaVal tc_get_generic_struct_params(HexaVal name) {
    HexaVal result = hexa_array_new();
    HexaVal i = hexa_int(0);
    while (hexa_truthy(hexa_bool((i).i < (hexa_int(hexa_len(generic_struct_names))).i))) {
        if (hexa_truthy(hexa_eq(hexa_index_get(generic_struct_names, i), name))) {
            HexaVal offset = hexa_index_get(generic_struct_param_offsets, i);
            HexaVal count = hexa_index_get(generic_struct_param_counts, i);
            HexaVal j = hexa_int(0);
            while (hexa_truthy(hexa_bool((j).i < (count).i))) {
                result = hexa_array_push(result, hexa_index_get(generic_all_param_names, hexa_add(offset, j)));
                j = hexa_add(j, hexa_int(1));
            }
            return result;
        }
        i = hexa_add(i, hexa_int(1));
    }
    return result;
    return hexa_void();
}


HexaVal tc_get_generic_struct_bounds(HexaVal name) {
    HexaVal result = hexa_array_new();
    HexaVal i = hexa_int(0);
    while (hexa_truthy(hexa_bool((i).i < (hexa_int(hexa_len(generic_struct_names))).i))) {
        if (hexa_truthy(hexa_eq(hexa_index_get(generic_struct_names, i), name))) {
            HexaVal offset = hexa_index_get(generic_struct_param_offsets, i);
            HexaVal count = hexa_index_get(generic_struct_param_counts, i);
            HexaVal j = hexa_int(0);
            while (hexa_truthy(hexa_bool((j).i < (count).i))) {
                result = hexa_array_push(result, hexa_index_get(generic_all_param_bounds, hexa_add(offset, j)));
                j = hexa_add(j, hexa_int(1));
            }
            return result;
        }
        i = hexa_add(i, hexa_int(1));
    }
    return result;
    return hexa_void();
}


HexaVal tc_lookup_generic_fn_param_count(HexaVal name) {
    HexaVal i = hexa_int(0);
    while (hexa_truthy(hexa_bool((i).i < (hexa_int(hexa_len(generic_fn_names))).i))) {
        if (hexa_truthy(hexa_eq(hexa_index_get(generic_fn_names, i), name))) {
            return hexa_index_get(generic_fn_param_counts, i);
        }
        i = hexa_add(i, hexa_int(1));
    }
    return hexa_int(0);
    return hexa_void();
}


HexaVal tc_get_generic_fn_params(HexaVal name) {
    HexaVal result = hexa_array_new();
    HexaVal i = hexa_int(0);
    while (hexa_truthy(hexa_bool((i).i < (hexa_int(hexa_len(generic_fn_names))).i))) {
        if (hexa_truthy(hexa_eq(hexa_index_get(generic_fn_names, i), name))) {
            HexaVal offset = hexa_index_get(generic_fn_param_offsets, i);
            HexaVal count = hexa_index_get(generic_fn_param_counts, i);
            HexaVal j = hexa_int(0);
            while (hexa_truthy(hexa_bool((j).i < (count).i))) {
                result = hexa_array_push(result, hexa_index_get(generic_fn_all_param_names, hexa_add(offset, j)));
                j = hexa_add(j, hexa_int(1));
            }
            return result;
        }
        i = hexa_add(i, hexa_int(1));
    }
    return result;
    return hexa_void();
}


HexaVal tc_get_generic_fn_bounds(HexaVal name) {
    HexaVal result = hexa_array_new();
    HexaVal i = hexa_int(0);
    while (hexa_truthy(hexa_bool((i).i < (hexa_int(hexa_len(generic_fn_names))).i))) {
        if (hexa_truthy(hexa_eq(hexa_index_get(generic_fn_names, i), name))) {
            HexaVal offset = hexa_index_get(generic_fn_param_offsets, i);
            HexaVal count = hexa_index_get(generic_fn_param_counts, i);
            HexaVal j = hexa_int(0);
            while (hexa_truthy(hexa_bool((j).i < (count).i))) {
                result = hexa_array_push(result, hexa_index_get(generic_fn_all_param_bounds, hexa_add(offset, j)));
                j = hexa_add(j, hexa_int(1));
            }
            return result;
        }
        i = hexa_add(i, hexa_int(1));
    }
    return result;
    return hexa_void();
}


HexaVal tc_push_type_params(HexaVal tparams) {
    HexaVal i = hexa_int(0);
    while (hexa_truthy(hexa_bool((i).i < (hexa_int(hexa_len(tparams))).i))) {
        HexaVal tp = hexa_index_get(tparams, i);
        tparam_names = hexa_array_push(tparam_names, hexa_map_get(tp, "name"));
        if (hexa_truthy(hexa_bool(!hexa_truthy(hexa_eq(hexa_map_get(tp, "value"), hexa_str("")))))) {
            tparam_bound = hexa_array_push(tparam_bound, hexa_map_get(tp, "value"));
        } else {
            tparam_bound = hexa_array_push(tparam_bound, hexa_str(""));
        }
        tc_define(hexa_map_get(tp, "name"), hexa_str("typeparam"));
        i = hexa_add(i, hexa_int(1));
    }
    return hexa_void();
}


HexaVal tc_pop_type_params(HexaVal tparams) {
    HexaVal count = hexa_int(hexa_len(tparams));
    if (hexa_truthy(hexa_eq(count, hexa_int(0)))) {
        return hexa_void();
    }
    HexaVal nn = hexa_array_new();
    HexaVal nb = hexa_array_new();
    HexaVal i = hexa_int(0);
    HexaVal target = hexa_int((hexa_int(hexa_len(tparam_names))).i - (count).i);
    while (hexa_truthy(hexa_bool((i).i < (target).i))) {
        nn = hexa_array_push(nn, hexa_index_get(tparam_names, i));
        nb = hexa_array_push(nb, hexa_index_get(tparam_bound, i));
        i = hexa_add(i, hexa_int(1));
    }
    tparam_names = nn;
    tparam_bound = nb;
    return hexa_void();
}


HexaVal tc_is_type_param(HexaVal name) {
    HexaVal i = hexa_int(0);
    while (hexa_truthy(hexa_bool((i).i < (hexa_int(hexa_len(tparam_names))).i))) {
        if (hexa_truthy(hexa_eq(hexa_index_get(tparam_names, i), name))) {
            return hexa_bool(1);
        }
        i = hexa_add(i, hexa_int(1));
    }
    return hexa_bool(0);
    return hexa_void();
}


HexaVal tc_get_type_param_bound(HexaVal name) {
    HexaVal i = hexa_int((hexa_int(hexa_len(tparam_names))).i - (hexa_int(1)).i);
    while (hexa_truthy(hexa_bool((i).i >= (hexa_int(0)).i))) {
        if (hexa_truthy(hexa_eq(hexa_index_get(tparam_names, i), name))) {
            return hexa_index_get(tparam_bound, i);
        }
        i = hexa_int((i).i - (hexa_int(1)).i);
    }
    return hexa_str("");
    return hexa_void();
}


HexaVal tc_validate_type_args(HexaVal struct_name, HexaVal type_args) {
    HexaVal expected = tc_lookup_generic_struct_param_count(struct_name);
    HexaVal actual = hexa_int(hexa_len(type_args));
    if (hexa_truthy(hexa_eq(expected, hexa_int(0)))) {
        if (hexa_truthy(hexa_bool((actual).i > (hexa_int(0)).i))) {
            tc_error(hexa_add(hexa_add(hexa_add(hexa_add(hexa_str("Struct '"), struct_name), hexa_str("' is not generic but given ")), hexa_to_string(actual)), hexa_str(" type arguments")));
        }
        return hexa_void();
    }
    if (hexa_truthy(hexa_bool(!hexa_truthy(hexa_eq(actual, expected))))) {
        tc_error(hexa_add(hexa_add(hexa_add(hexa_add(hexa_add(hexa_str("Struct '"), struct_name), hexa_str("' expects ")), hexa_to_string(expected)), hexa_str(" type params, got ")), hexa_to_string(actual)));
        return hexa_void();
    }
    HexaVal bounds = tc_get_generic_struct_bounds(struct_name);
    HexaVal i = hexa_int(0);
    while (hexa_truthy(hexa_bool((i).i < (actual).i))) {
        HexaVal bound = hexa_index_get(bounds, i);
        if (hexa_truthy(hexa_bool(!hexa_truthy(hexa_eq(bound, hexa_str("")))))) {
            HexaVal arg_name = hexa_map_get(hexa_index_get(type_args, i), "name");
            HexaVal arg_type = tc_lookup(arg_name);
            if (hexa_truthy(hexa_bool(hexa_truthy(hexa_eq(arg_type, hexa_str(""))) && hexa_truthy(hexa_bool(!hexa_truthy(tc_is_type_param(arg_name))))))) {
                HexaVal at = annotation_to_type(arg_name);
                if (hexa_truthy(hexa_bool(hexa_truthy(hexa_bool(hexa_truthy(hexa_eq(at, arg_name)) && hexa_truthy(hexa_eq(tc_lookup_struct(arg_name), hexa_int(-(hexa_int(1)).i))))) && hexa_truthy(hexa_eq(tc_lookup_enum(arg_name), hexa_int(-(hexa_int(1)).i)))))) {
                    tc_error(hexa_add(hexa_add(hexa_add(hexa_add(hexa_str("Unknown type '"), arg_name), hexa_str("' used as type argument for '")), struct_name), hexa_str("'")));
                }
            }
        }
        i = hexa_add(i, hexa_int(1));
    }
    return hexa_void();
}


HexaVal tc_validate_fn_type_args(HexaVal fn_name, HexaVal type_args) {
    HexaVal expected = tc_lookup_generic_fn_param_count(fn_name);
    HexaVal actual = hexa_int(hexa_len(type_args));
    if (hexa_truthy(hexa_eq(expected, hexa_int(0)))) {
        if (hexa_truthy(hexa_bool((actual).i > (hexa_int(0)).i))) {
            tc_error(hexa_add(hexa_add(hexa_add(hexa_add(hexa_str("Function '"), fn_name), hexa_str("' is not generic but given ")), hexa_to_string(actual)), hexa_str(" type arguments")));
        }
        return hexa_void();
    }
    if (hexa_truthy(hexa_bool(!hexa_truthy(hexa_eq(actual, expected))))) {
        tc_error(hexa_add(hexa_add(hexa_add(hexa_add(hexa_add(hexa_str("Function '"), fn_name), hexa_str("' expects ")), hexa_to_string(expected)), hexa_str(" type params, got ")), hexa_to_string(actual)));
        return hexa_void();
    }
    return hexa_void();
}


HexaVal tc_register_builtins(void) {
    tc_register_fn(hexa_str("println"), hexa_int(-(hexa_int(1)).i), hexa_str("void"));
    tc_register_fn(hexa_str("print"), hexa_int(-(hexa_int(1)).i), hexa_str("void"));
    tc_register_fn(hexa_str("format"), hexa_int(-(hexa_int(1)).i), hexa_str("string"));
    tc_register_fn(hexa_str("len"), hexa_int(1), hexa_str("int"));
    tc_register_fn(hexa_str("to_string"), hexa_int(1), hexa_str("string"));
    tc_register_fn(hexa_str("is_alpha"), hexa_int(1), hexa_str("bool"));
    tc_register_fn(hexa_str("is_digit"), hexa_int(1), hexa_str("bool"));
    tc_register_fn(hexa_str("is_alphanumeric"), hexa_int(1), hexa_str("bool"));
    tc_register_fn(hexa_str("read_file"), hexa_int(1), hexa_str("string"));
    tc_register_fn(hexa_str("type_of"), hexa_int(1), hexa_str("string"));
    tc_register_fn(hexa_str("int"), hexa_int(1), hexa_str("int"));
    tc_register_fn(hexa_str("float"), hexa_int(1), hexa_str("float"));
    tc_register_fn(hexa_str("string"), hexa_int(1), hexa_str("string"));
    tc_register_fn(hexa_str("push"), hexa_int(2), hexa_str("array"));
    tc_register_fn(hexa_str("sigma"), hexa_int(1), hexa_str("int"));
    tc_register_fn(hexa_str("phi"), hexa_int(1), hexa_str("int"));
    tc_register_fn(hexa_str("tau"), hexa_int(1), hexa_str("int"));
    return hexa_void();
}


HexaVal annotation_to_type(HexaVal ann) {
    if (hexa_truthy(hexa_eq(ann, hexa_str("")))) {
        return hexa_str("unknown");
    }
    if (hexa_truthy(hexa_eq(ann, hexa_str("int")))) {
        return hexa_str("int");
    }
    if (hexa_truthy(hexa_eq(ann, hexa_str("float")))) {
        return hexa_str("float");
    }
    if (hexa_truthy(hexa_eq(ann, hexa_str("bool")))) {
        return hexa_str("bool");
    }
    if (hexa_truthy(hexa_eq(ann, hexa_str("string")))) {
        return hexa_str("string");
    }
    if (hexa_truthy(hexa_eq(ann, hexa_str("char")))) {
        return hexa_str("char");
    }
    if (hexa_truthy(hexa_eq(ann, hexa_str("void")))) {
        return hexa_str("void");
    }
    if (hexa_truthy(hexa_eq(ann, hexa_str("any")))) {
        return hexa_str("any");
    }
    if (hexa_truthy(hexa_eq(ann, hexa_str("array")))) {
        return hexa_str("array");
    }
    if (hexa_truthy(tc_is_type_param(ann))) {
        return ann;
    }
    return ann;
    return hexa_void();
}


HexaVal types_compatible(HexaVal expected, HexaVal actual) {
    if (hexa_truthy(hexa_eq(expected, hexa_str("unknown")))) {
        return hexa_bool(1);
    }
    if (hexa_truthy(hexa_eq(actual, hexa_str("unknown")))) {
        return hexa_bool(1);
    }
    if (hexa_truthy(hexa_eq(expected, hexa_str("any")))) {
        return hexa_bool(1);
    }
    if (hexa_truthy(hexa_eq(actual, hexa_str("any")))) {
        return hexa_bool(1);
    }
    if (hexa_truthy(hexa_eq(expected, actual))) {
        return hexa_bool(1);
    }
    if (hexa_truthy(hexa_bool(hexa_truthy(hexa_eq(expected, hexa_str("float"))) && hexa_truthy(hexa_eq(actual, hexa_str("int")))))) {
        return hexa_bool(1);
    }
    if (hexa_truthy(hexa_eq(expected, hexa_str("typeparam")))) {
        return hexa_bool(1);
    }
    if (hexa_truthy(hexa_eq(actual, hexa_str("typeparam")))) {
        return hexa_bool(1);
    }
    if (hexa_truthy(tc_is_type_param(expected))) {
        return hexa_bool(1);
    }
    if (hexa_truthy(tc_is_type_param(actual))) {
        return hexa_bool(1);
    }
    return hexa_bool(0);
    return hexa_void();
}


HexaVal tc_infer_expr(HexaVal node) {
    if (hexa_truthy(hexa_eq(node, hexa_str("")))) {
        return hexa_str("void");
    }
    HexaVal k = hexa_map_get(node, "kind");
    if (hexa_truthy(hexa_eq(k, hexa_str("IntLit")))) {
        return hexa_str("int");
    }
    if (hexa_truthy(hexa_eq(k, hexa_str("FloatLit")))) {
        return hexa_str("float");
    }
    if (hexa_truthy(hexa_eq(k, hexa_str("BoolLit")))) {
        return hexa_str("bool");
    }
    if (hexa_truthy(hexa_eq(k, hexa_str("StringLit")))) {
        return hexa_str("string");
    }
    if (hexa_truthy(hexa_eq(k, hexa_str("CharLit")))) {
        return hexa_str("char");
    }
    if (hexa_truthy(hexa_eq(k, hexa_str("Array")))) {
        return hexa_str("array");
    }
    if (hexa_truthy(hexa_eq(k, hexa_str("Tuple")))) {
        return hexa_str("tuple");
    }
    if (hexa_truthy(hexa_eq(k, hexa_str("Wildcard")))) {
        return hexa_str("any");
    }
    if (hexa_truthy(hexa_eq(k, hexa_str("Range")))) {
        tc_infer_expr(hexa_map_get(node, "left"));
        tc_infer_expr(hexa_map_get(node, "right"));
        return hexa_str("range");
    }
    if (hexa_truthy(hexa_eq(k, hexa_str("Lambda")))) {
        return hexa_str("fn");
    }
    if (hexa_truthy(hexa_eq(k, hexa_str("Ident")))) {
        HexaVal typ = tc_lookup(hexa_map_get(node, "name"));
        if (hexa_truthy(hexa_eq(typ, hexa_str("")))) {
            tc_error(hexa_add(hexa_add(hexa_str("Undeclared variable '"), hexa_map_get(node, "name")), hexa_str("'")));
            return hexa_str("unknown");
        }
        return typ;
    }
    if (hexa_truthy(hexa_eq(k, hexa_str("BinOp")))) {
        HexaVal lt = tc_infer_expr(hexa_map_get(node, "left"));
        HexaVal rt = tc_infer_expr(hexa_map_get(node, "right"));
        HexaVal op = hexa_map_get(node, "op");
        if (hexa_truthy(hexa_bool(hexa_truthy(hexa_bool(hexa_truthy(hexa_bool(hexa_truthy(hexa_bool(hexa_truthy(hexa_bool(hexa_truthy(hexa_eq(op, hexa_str("=="))) || hexa_truthy(hexa_eq(op, hexa_str("!="))))) || hexa_truthy(hexa_eq(op, hexa_str("<"))))) || hexa_truthy(hexa_eq(op, hexa_str(">"))))) || hexa_truthy(hexa_eq(op, hexa_str("<="))))) || hexa_truthy(hexa_eq(op, hexa_str(">=")))))) {
            return hexa_str("bool");
        }
        if (hexa_truthy(hexa_eq(op, hexa_str("??")))) {
            return rt;
        }
        if (hexa_truthy(hexa_bool(hexa_truthy(hexa_bool(hexa_truthy(hexa_eq(op, hexa_str("&&"))) || hexa_truthy(hexa_eq(op, hexa_str("||"))))) || hexa_truthy(hexa_eq(op, hexa_str("^^")))))) {
            if (hexa_truthy(hexa_bool(hexa_truthy(hexa_bool(!hexa_truthy(hexa_eq(lt, hexa_str("bool"))))) && hexa_truthy(hexa_bool(!hexa_truthy(hexa_eq(lt, hexa_str("unknown")))))))) {
                tc_error(hexa_add(hexa_add(hexa_add(hexa_add(hexa_str("Logical operator '"), op), hexa_str("' expects bool, got '")), lt), hexa_str("'")));
            }
            if (hexa_truthy(hexa_bool(hexa_truthy(hexa_bool(!hexa_truthy(hexa_eq(rt, hexa_str("bool"))))) && hexa_truthy(hexa_bool(!hexa_truthy(hexa_eq(rt, hexa_str("unknown")))))))) {
                tc_error(hexa_add(hexa_add(hexa_add(hexa_add(hexa_str("Logical operator '"), op), hexa_str("' expects bool, got '")), rt), hexa_str("'")));
            }
            return hexa_str("bool");
        }
        if (hexa_truthy(hexa_eq(op, hexa_str("+")))) {
            if (hexa_truthy(hexa_bool(hexa_truthy(hexa_eq(lt, hexa_str("string"))) || hexa_truthy(hexa_eq(rt, hexa_str("string")))))) {
                return hexa_str("string");
            }
        }
        if (hexa_truthy(hexa_bool(hexa_truthy(hexa_bool(hexa_truthy(hexa_bool(hexa_truthy(hexa_bool(hexa_truthy(hexa_bool(hexa_truthy(hexa_eq(op, hexa_str("+"))) || hexa_truthy(hexa_eq(op, hexa_str("-"))))) || hexa_truthy(hexa_eq(op, hexa_str("*"))))) || hexa_truthy(hexa_eq(op, hexa_str("/"))))) || hexa_truthy(hexa_eq(op, hexa_str("%"))))) || hexa_truthy(hexa_eq(op, hexa_str("**")))))) {
            if (hexa_truthy(hexa_bool(hexa_truthy(hexa_eq(lt, hexa_str("float"))) || hexa_truthy(hexa_eq(rt, hexa_str("float")))))) {
                return hexa_str("float");
            }
            if (hexa_truthy(hexa_bool(hexa_truthy(hexa_eq(lt, hexa_str("int"))) && hexa_truthy(hexa_eq(rt, hexa_str("int")))))) {
                return hexa_str("int");
            }
            if (hexa_truthy(hexa_bool(hexa_truthy(hexa_bool(hexa_truthy(hexa_bool(!hexa_truthy(types_compatible(lt, rt)))) && hexa_truthy(hexa_bool(!hexa_truthy(hexa_eq(lt, hexa_str("unknown"))))))) && hexa_truthy(hexa_bool(!hexa_truthy(hexa_eq(rt, hexa_str("unknown")))))))) {
                tc_error(hexa_add(hexa_add(hexa_add(hexa_add(hexa_add(hexa_add(hexa_str("Arithmetic type mismatch: '"), lt), hexa_str("' ")), op), hexa_str(" '")), rt), hexa_str("'")));
            }
            return lt;
        }
        return hexa_str("unknown");
    }
    if (hexa_truthy(hexa_eq(k, hexa_str("UnaryOp")))) {
        HexaVal ot = tc_infer_expr(hexa_map_get(node, "left"));
        if (hexa_truthy(hexa_eq(hexa_map_get(node, "op"), hexa_str("!")))) {
            if (hexa_truthy(hexa_bool(hexa_truthy(hexa_bool(!hexa_truthy(hexa_eq(ot, hexa_str("bool"))))) && hexa_truthy(hexa_bool(!hexa_truthy(hexa_eq(ot, hexa_str("unknown")))))))) {
                tc_error(hexa_add(hexa_add(hexa_str("'!' operator expects bool, got '"), ot), hexa_str("'")));
            }
            return hexa_str("bool");
        }
        if (hexa_truthy(hexa_eq(hexa_map_get(node, "op"), hexa_str("-")))) {
            return ot;
        }
        return ot;
    }
    if (hexa_truthy(hexa_eq(k, hexa_str("Call")))) {
        HexaVal callee = hexa_map_get(node, "left");
        HexaVal arg_count = hexa_int(hexa_len(hexa_map_get(node, "args")));
        HexaVal i = hexa_int(0);
        while (hexa_truthy(hexa_bool((i).i < (arg_count).i))) {
            tc_infer_expr(hexa_index_get(hexa_map_get(node, "args"), i));
            i = hexa_add(i, hexa_int(1));
        }
        if (hexa_truthy(hexa_eq(hexa_map_get(callee, "kind"), hexa_str("Ident")))) {
            HexaVal fn_arity = tc_lookup_fn_arity(hexa_map_get(callee, "name"));
            if (hexa_truthy(hexa_eq(fn_arity, hexa_int(-(hexa_int(1)).i)))) {
                return hexa_str("unknown");
            }
            if (hexa_truthy(hexa_bool(hexa_truthy(hexa_bool((fn_arity).i >= (hexa_int(0)).i)) && hexa_truthy(hexa_bool(!hexa_truthy(hexa_eq(fn_arity, arg_count))))))) {
                tc_error(hexa_add(hexa_add(hexa_add(hexa_add(hexa_add(hexa_str("Function '"), hexa_map_get(callee, "name")), hexa_str("' expects ")), hexa_to_string(fn_arity)), hexa_str(" args, got ")), hexa_to_string(arg_count)));
            }
            return tc_lookup_fn_ret(hexa_map_get(callee, "name"));
        }
        if (hexa_truthy(hexa_eq(hexa_map_get(callee, "kind"), hexa_str("Field")))) {
            tc_infer_expr(hexa_map_get(callee, "left"));
            return hexa_str("unknown");
        }
        return hexa_str("unknown");
    }
    if (hexa_truthy(hexa_eq(k, hexa_str("Field")))) {
        HexaVal obj_type = tc_infer_expr(hexa_map_get(node, "left"));
        HexaVal field_name = hexa_map_get(node, "name");
        if (hexa_truthy(hexa_bool(hexa_truthy(hexa_bool(hexa_truthy(hexa_bool(!hexa_truthy(hexa_eq(obj_type, hexa_str("unknown"))))) && hexa_truthy(hexa_bool(!hexa_truthy(hexa_eq(obj_type, hexa_str("any"))))))) && hexa_truthy(hexa_bool(!hexa_truthy(hexa_eq(tc_lookup_struct(obj_type), hexa_int(-(hexa_int(1)).i)))))))) {
            HexaVal ftype = tc_lookup_struct_field(obj_type, field_name);
            if (hexa_truthy(hexa_eq(ftype, hexa_str("")))) {
                HexaVal known = tc_get_struct_field_names(obj_type);
                HexaVal hint = hexa_str("");
                if (hexa_truthy(hexa_bool((hexa_int(hexa_len(known))).i > (hexa_int(0)).i))) {
                    hint = hexa_str(" (known fields: ");
                    HexaVal fi = hexa_int(0);
                    while (hexa_truthy(hexa_bool((fi).i < (hexa_int(hexa_len(known))).i))) {
                        if (hexa_truthy(hexa_bool((fi).i > (hexa_int(0)).i))) {
                            hint = hexa_add(hint, hexa_str(", "));
                        }
                        hint = hexa_add(hint, hexa_index_get(known, fi));
                        fi = hexa_add(fi, hexa_int(1));
                    }
                    hint = hexa_add(hint, hexa_str(")"));
                }
                tc_error(hexa_add(hexa_add(hexa_add(hexa_add(hexa_add(hexa_str("Struct '"), obj_type), hexa_str("' has no field '")), field_name), hexa_str("'")), hint));
                return hexa_str("unknown");
            }
            return annotation_to_type(ftype);
        }
        return hexa_str("unknown");
    }
    if (hexa_truthy(hexa_eq(k, hexa_str("Index")))) {
        tc_infer_expr(hexa_map_get(node, "left"));
        HexaVal idx_type = tc_infer_expr(hexa_map_get(node, "right"));
        if (hexa_truthy(hexa_bool(hexa_truthy(hexa_bool(!hexa_truthy(hexa_eq(idx_type, hexa_str("int"))))) && hexa_truthy(hexa_bool(!hexa_truthy(hexa_eq(idx_type, hexa_str("unknown")))))))) {
            tc_error(hexa_add(hexa_add(hexa_str("Array index must be int, got '"), idx_type), hexa_str("'")));
        }
        return hexa_str("unknown");
    }
    if (hexa_truthy(hexa_eq(k, hexa_str("IfExpr")))) {
        HexaVal cond_type = tc_infer_expr(hexa_map_get(node, "cond"));
        if (hexa_truthy(hexa_bool(hexa_truthy(hexa_bool(!hexa_truthy(hexa_eq(cond_type, hexa_str("bool"))))) && hexa_truthy(hexa_bool(!hexa_truthy(hexa_eq(cond_type, hexa_str("unknown")))))))) {
            tc_error(hexa_add(hexa_add(hexa_str("If condition must be bool, got '"), cond_type), hexa_str("'")));
        }
        tc_push_scope();
        tc_check_stmts(hexa_map_get(node, "then_body"));
        tc_pop_scope();
        if (hexa_truthy(hexa_bool(hexa_truthy(hexa_bool(!hexa_truthy(hexa_eq(hexa_map_get(node, "else_body"), hexa_str(""))))) && hexa_truthy(hexa_bool((hexa_int(hexa_len(hexa_map_get(node, "else_body")))).i > (hexa_int(0)).i))))) {
            tc_push_scope();
            tc_check_stmts(hexa_map_get(node, "else_body"));
            tc_pop_scope();
        }
        return hexa_str("unknown");
    }
    if (hexa_truthy(hexa_eq(k, hexa_str("MatchExpr")))) {
        HexaVal match_type = tc_infer_expr(hexa_map_get(node, "left"));
        HexaVal arm_count = hexa_int(hexa_len(hexa_map_get(node, "arms")));
        HexaVal has_wildcard = hexa_bool(0);
        HexaVal covered_variants = hexa_array_new();
        HexaVal i = hexa_int(0);
        while (hexa_truthy(hexa_bool((i).i < (arm_count).i))) {
            HexaVal arm = hexa_index_get(hexa_map_get(node, "arms"), i);
            HexaVal pat = hexa_map_get(arm, "left");
            if (hexa_truthy(hexa_bool(hexa_truthy(hexa_bool(!hexa_truthy(hexa_eq(pat, hexa_str(""))))) && hexa_truthy(hexa_eq(hexa_map_get(pat, "kind"), hexa_str("Wildcard")))))) {
                has_wildcard = hexa_bool(1);
            }
            if (hexa_truthy(hexa_bool(hexa_truthy(hexa_bool(!hexa_truthy(hexa_eq(pat, hexa_str(""))))) && hexa_truthy(hexa_eq(hexa_map_get(pat, "kind"), hexa_str("EnumPath")))))) {
                covered_variants = hexa_array_push(covered_variants, hexa_map_get(pat, "name"));
            }
            tc_push_scope();
            if (hexa_truthy(hexa_bool(hexa_truthy(hexa_bool(!hexa_truthy(hexa_eq(pat, hexa_str(""))))) && hexa_truthy(hexa_eq(hexa_map_get(pat, "kind"), hexa_str("Ident")))))) {
                tc_define(hexa_map_get(pat, "name"), match_type);
            }
            tc_check_stmts(hexa_map_get(arm, "body"));
            tc_pop_scope();
            i = hexa_add(i, hexa_int(1));
        }
        if (hexa_truthy(hexa_bool(!hexa_truthy(has_wildcard)))) {
            if (hexa_truthy(hexa_bool(hexa_truthy(hexa_bool(hexa_truthy(hexa_bool(!hexa_truthy(hexa_eq(match_type, hexa_str("unknown"))))) && hexa_truthy(hexa_bool(!hexa_truthy(hexa_eq(match_type, hexa_str("any"))))))) && hexa_truthy(hexa_bool(!hexa_truthy(hexa_eq(tc_lookup_enum(match_type), hexa_int(-(hexa_int(1)).i)))))))) {
                HexaVal all_variants = tc_get_enum_variants(match_type);
                HexaVal missing = hexa_array_new();
                HexaVal vi = hexa_int(0);
                while (hexa_truthy(hexa_bool((vi).i < (hexa_int(hexa_len(all_variants))).i))) {
                    HexaVal found = hexa_bool(0);
                    HexaVal ci = hexa_int(0);
                    while (hexa_truthy(hexa_bool((ci).i < (hexa_int(hexa_len(covered_variants))).i))) {
                        if (hexa_truthy(hexa_eq(hexa_index_get(covered_variants, ci), hexa_index_get(all_variants, vi)))) {
                            found = hexa_bool(1);
                        }
                        ci = hexa_add(ci, hexa_int(1));
                    }
                    if (hexa_truthy(hexa_bool(!hexa_truthy(found)))) {
                        missing = hexa_array_push(missing, hexa_index_get(all_variants, vi));
                    }
                    vi = hexa_add(vi, hexa_int(1));
                }
                if (hexa_truthy(hexa_bool((hexa_int(hexa_len(missing))).i > (hexa_int(0)).i))) {
                    HexaVal miss_str = hexa_str("");
                    HexaVal mi = hexa_int(0);
                    while (hexa_truthy(hexa_bool((mi).i < (hexa_int(hexa_len(missing))).i))) {
                        if (hexa_truthy(hexa_bool((mi).i > (hexa_int(0)).i))) {
                            miss_str = hexa_add(miss_str, hexa_str(", "));
                        }
                        miss_str = hexa_add(miss_str, hexa_index_get(missing, mi));
                        mi = hexa_add(mi, hexa_int(1));
                    }
                    tc_warn(hexa_add(hexa_str("Match may not be exhaustive — missing variants: "), miss_str));
                }
            } else {
                if (hexa_truthy(hexa_bool((arm_count).i > (hexa_int(0)).i))) {
                    tc_warn(hexa_str("Match has no wildcard '_' arm — may not be exhaustive"));
                }
            }
        }
        return hexa_str("unknown");
    }
    if (hexa_truthy(hexa_eq(k, hexa_str("StructInit")))) {
        HexaVal sc = tc_lookup_struct(hexa_map_get(node, "name"));
        if (hexa_truthy(hexa_eq(sc, hexa_int(-(hexa_int(1)).i)))) {
            tc_error(hexa_add(hexa_add(hexa_str("Unknown struct '"), hexa_map_get(node, "name")), hexa_str("'")));
        } else {
            HexaVal si_type_args = hexa_map_get(node, "items");
            if (hexa_truthy(hexa_bool(hexa_truthy(hexa_bool(!hexa_truthy(hexa_eq(si_type_args, hexa_str(""))))) && hexa_truthy(hexa_bool((hexa_int(hexa_len(si_type_args))).i > (hexa_int(0)).i))))) {
                tc_validate_type_args(hexa_map_get(node, "name"), si_type_args);
            } else {
                HexaVal expected_tp = tc_lookup_generic_struct_param_count(hexa_map_get(node, "name"));
                if (hexa_truthy(hexa_bool((expected_tp).i > (hexa_int(0)).i))) {
                    tc_warn(hexa_add(hexa_add(hexa_add(hexa_add(hexa_str("Generic struct '"), hexa_map_get(node, "name")), hexa_str("' used without type arguments (expected ")), hexa_to_string(expected_tp)), hexa_str(")")));
                }
            }
            HexaVal i = hexa_int(0);
            while (hexa_truthy(hexa_bool((i).i < (hexa_int(hexa_len(hexa_map_get(node, "fields")))).i))) {
                HexaVal fld = hexa_index_get(hexa_map_get(node, "fields"), i);
                HexaVal init_type = tc_infer_expr(hexa_map_get(fld, "left"));
                HexaVal expected_type = tc_lookup_struct_field(hexa_map_get(node, "name"), hexa_map_get(fld, "name"));
                if (hexa_truthy(hexa_bool(hexa_truthy(hexa_eq(expected_type, hexa_str(""))) && hexa_truthy(hexa_bool(!hexa_truthy(hexa_eq(hexa_map_get(fld, "name"), hexa_str("")))))))) {
                    tc_error(hexa_add(hexa_add(hexa_add(hexa_add(hexa_str("Struct '"), hexa_map_get(node, "name")), hexa_str("' has no field '")), hexa_map_get(fld, "name")), hexa_str("'")));
                } else {
                    if (hexa_truthy(hexa_bool(hexa_truthy(hexa_bool(!hexa_truthy(hexa_eq(expected_type, hexa_str(""))))) && hexa_truthy(hexa_bool(!hexa_truthy(hexa_eq(init_type, hexa_str("unknown")))))))) {
                        HexaVal et = annotation_to_type(expected_type);
                        if (hexa_truthy(hexa_bool(!hexa_truthy(types_compatible(et, init_type))))) {
                            tc_error_at(hexa_map_get(fld, "name"), hexa_add(hexa_add(hexa_add(hexa_add(hexa_str("Field type mismatch: expected '"), et), hexa_str("', got '")), init_type), hexa_str("'")));
                        }
                    }
                }
                i = hexa_add(i, hexa_int(1));
            }
            if (hexa_truthy(hexa_bool(!hexa_truthy(hexa_eq(hexa_int(hexa_len(hexa_map_get(node, "fields"))), sc))))) {
                tc_warn(hexa_add(hexa_add(hexa_add(hexa_add(hexa_add(hexa_add(hexa_str("Struct '"), hexa_map_get(node, "name")), hexa_str("' has ")), hexa_to_string(sc)), hexa_str(" fields, but ")), hexa_to_string(hexa_int(hexa_len(hexa_map_get(node, "fields"))))), hexa_str(" provided")));
            }
        }
        return hexa_map_get(node, "name");
    }
    if (hexa_truthy(hexa_eq(k, hexa_str("EnumPath")))) {
        return hexa_map_get(node, "name");
    }
    return hexa_str("unknown");
    return hexa_void();
}


HexaVal tc_check_stmt(HexaVal node) {
    HexaVal k = hexa_map_get(node, "kind");
    if (hexa_truthy(hexa_bool(hexa_truthy(hexa_eq(k, hexa_str("LetStmt"))) || hexa_truthy(hexa_eq(k, hexa_str("LetMutStmt")))))) {
        HexaVal typ = tc_infer_expr(hexa_map_get(node, "left"));
        HexaVal ann = annotation_to_type(hexa_map_get(node, "value"));
        if (hexa_truthy(hexa_bool(hexa_truthy(hexa_bool(!hexa_truthy(hexa_eq(ann, hexa_str("unknown"))))) && hexa_truthy(hexa_bool(!hexa_truthy(types_compatible(ann, typ))))))) {
            tc_error_at(hexa_map_get(node, "name"), hexa_add(hexa_add(hexa_add(hexa_add(hexa_str("Type mismatch: declared '"), ann), hexa_str("' but assigned '")), typ), hexa_str("'")));
        }
        if (hexa_truthy(hexa_bool(!hexa_truthy(hexa_eq(ann, hexa_str("unknown")))))) {
            tc_define(hexa_map_get(node, "name"), ann);
        } else {
            tc_define(hexa_map_get(node, "name"), typ);
        }
        return hexa_void();
    }
    if (hexa_truthy(hexa_bool(hexa_truthy(hexa_eq(k, hexa_str("ConstStmt"))) || hexa_truthy(hexa_eq(k, hexa_str("StaticStmt")))))) {
        HexaVal typ = tc_infer_expr(hexa_map_get(node, "left"));
        HexaVal ann = annotation_to_type(hexa_map_get(node, "value"));
        if (hexa_truthy(hexa_bool(!hexa_truthy(hexa_eq(ann, hexa_str("unknown")))))) {
            tc_define(hexa_map_get(node, "name"), ann);
        } else {
            tc_define(hexa_map_get(node, "name"), typ);
        }
        return hexa_void();
    }
    if (hexa_truthy(hexa_eq(k, hexa_str("FnDecl")))) {
        HexaVal arity = hexa_int(hexa_len(hexa_map_get(node, "params")));
        HexaVal fn_tparams = hexa_map_get(node, "items");
        HexaVal has_tparams = hexa_bool(hexa_truthy(hexa_bool(!hexa_truthy(hexa_eq(fn_tparams, hexa_str(""))))) && hexa_truthy(hexa_bool((hexa_int(hexa_len(fn_tparams))).i > (hexa_int(0)).i)));
        if (hexa_truthy(has_tparams)) {
            tc_register_generic_fn(hexa_map_get(node, "name"), fn_tparams);
        }
        HexaVal ret = annotation_to_type(hexa_map_get(node, "ret_type"));
        tc_register_fn(hexa_map_get(node, "name"), arity, ret);
        tc_define(hexa_map_get(node, "name"), hexa_str("fn"));
        HexaVal prev_fn_ret = current_fn_ret_type;
        HexaVal prev_fn_name = current_fn_name;
        current_fn_ret_type = ret;
        current_fn_name = hexa_map_get(node, "name");
        tc_push_scope();
        if (hexa_truthy(has_tparams)) {
            tc_push_type_params(fn_tparams);
        }
        HexaVal i = hexa_int(0);
        while (hexa_truthy(hexa_bool((i).i < (arity).i))) {
            HexaVal p = hexa_index_get(hexa_map_get(node, "params"), i);
            HexaVal ptype = annotation_to_type(hexa_map_get(p, "value"));
            tc_define(hexa_map_get(p, "name"), ptype);
            i = hexa_add(i, hexa_int(1));
        }
        tc_check_stmts(hexa_map_get(node, "body"));
        tc_pop_scope();
        if (hexa_truthy(has_tparams)) {
            tc_pop_type_params(fn_tparams);
        }
        current_fn_ret_type = prev_fn_ret;
        current_fn_name = prev_fn_name;
        return hexa_void();
    }
    if (hexa_truthy(hexa_eq(k, hexa_str("StructDecl")))) {
        HexaVal fc = hexa_int(hexa_len(hexa_map_get(node, "fields")));
        tc_register_struct(hexa_map_get(node, "name"), fc);
        HexaVal st_tparams = hexa_map_get(node, "items");
        if (hexa_truthy(hexa_bool(hexa_truthy(hexa_bool(!hexa_truthy(hexa_eq(st_tparams, hexa_str(""))))) && hexa_truthy(hexa_bool((hexa_int(hexa_len(st_tparams))).i > (hexa_int(0)).i))))) {
            tc_register_generic_struct(hexa_map_get(node, "name"), st_tparams);
        }
        HexaVal fi = hexa_int(0);
        while (hexa_truthy(hexa_bool((fi).i < (fc).i))) {
            HexaVal f = hexa_index_get(hexa_map_get(node, "fields"), fi);
            tc_register_struct_field(hexa_map_get(f, "name"), hexa_map_get(f, "value"));
            fi = hexa_add(fi, hexa_int(1));
        }
        tc_define(hexa_map_get(node, "name"), hexa_str("type"));
        return hexa_void();
    }
    if (hexa_truthy(hexa_eq(k, hexa_str("EnumDecl")))) {
        HexaVal vc = hexa_int(hexa_len(hexa_map_get(node, "variants")));
        tc_register_enum(hexa_map_get(node, "name"), vc);
        HexaVal vi = hexa_int(0);
        while (hexa_truthy(hexa_bool((vi).i < (vc).i))) {
            tc_register_enum_variant(hexa_map_get(hexa_index_get(hexa_map_get(node, "variants"), vi), "name"));
            vi = hexa_add(vi, hexa_int(1));
        }
        tc_define(hexa_map_get(node, "name"), hexa_str("type"));
        return hexa_void();
    }
    if (hexa_truthy(hexa_eq(k, hexa_str("TraitDecl")))) {
        tc_define(hexa_map_get(node, "name"), hexa_str("type"));
        return hexa_void();
    }
    if (hexa_truthy(hexa_eq(k, hexa_str("ImplBlock")))) {
        tc_push_scope();
        HexaVal i = hexa_int(0);
        while (hexa_truthy(hexa_bool((i).i < (hexa_int(hexa_len(hexa_map_get(node, "methods")))).i))) {
            tc_check_stmt(hexa_index_get(hexa_map_get(node, "methods"), i));
            i = hexa_add(i, hexa_int(1));
        }
        tc_pop_scope();
        return hexa_void();
    }
    if (hexa_truthy(hexa_eq(k, hexa_str("ForStmt")))) {
        tc_infer_expr(hexa_map_get(node, "iter_expr"));
        tc_push_scope();
        tc_define(hexa_map_get(node, "name"), hexa_str("unknown"));
        tc_check_stmts(hexa_map_get(node, "body"));
        tc_pop_scope();
        return hexa_void();
    }
    if (hexa_truthy(hexa_eq(k, hexa_str("WhileStmt")))) {
        HexaVal cond_type = tc_infer_expr(hexa_map_get(node, "cond"));
        if (hexa_truthy(hexa_bool(hexa_truthy(hexa_bool(!hexa_truthy(hexa_eq(cond_type, hexa_str("bool"))))) && hexa_truthy(hexa_bool(!hexa_truthy(hexa_eq(cond_type, hexa_str("unknown")))))))) {
            tc_error(hexa_add(hexa_add(hexa_str("While condition must be bool, got '"), cond_type), hexa_str("'")));
        }
        tc_push_scope();
        tc_check_stmts(hexa_map_get(node, "body"));
        tc_pop_scope();
        return hexa_void();
    }
    if (hexa_truthy(hexa_eq(k, hexa_str("LoopStmt")))) {
        tc_push_scope();
        tc_check_stmts(hexa_map_get(node, "body"));
        tc_pop_scope();
        return hexa_void();
    }
    if (hexa_truthy(hexa_eq(k, hexa_str("ReturnStmt")))) {
        if (hexa_truthy(hexa_bool(!hexa_truthy(hexa_eq(hexa_map_get(node, "left"), hexa_str("")))))) {
            HexaVal ret_val_type = tc_infer_expr(hexa_map_get(node, "left"));
            if (hexa_truthy(hexa_bool(hexa_truthy(hexa_bool(!hexa_truthy(hexa_eq(current_fn_ret_type, hexa_str("unknown"))))) && hexa_truthy(hexa_bool(!hexa_truthy(hexa_eq(current_fn_ret_type, hexa_str("void")))))))) {
                if (hexa_truthy(hexa_bool(hexa_truthy(hexa_bool(!hexa_truthy(types_compatible(current_fn_ret_type, ret_val_type)))) && hexa_truthy(hexa_bool(!hexa_truthy(hexa_eq(ret_val_type, hexa_str("unknown")))))))) {
                    tc_error_at(current_fn_name, hexa_add(hexa_add(hexa_add(hexa_add(hexa_str("Return type mismatch: expected '"), current_fn_ret_type), hexa_str("', got '")), ret_val_type), hexa_str("'")));
                }
            }
        } else {
            if (hexa_truthy(hexa_bool(hexa_truthy(hexa_bool(!hexa_truthy(hexa_eq(current_fn_ret_type, hexa_str("unknown"))))) && hexa_truthy(hexa_bool(!hexa_truthy(hexa_eq(current_fn_ret_type, hexa_str("void")))))))) {
                tc_warn_at(current_fn_name, hexa_add(hexa_add(hexa_str("Bare 'return' in function expecting '"), current_fn_ret_type), hexa_str("'")));
            }
        }
        return hexa_void();
    }
    if (hexa_truthy(hexa_eq(k, hexa_str("AssignStmt")))) {
        if (hexa_truthy(hexa_bool(hexa_truthy(hexa_bool(!hexa_truthy(hexa_eq(hexa_map_get(node, "left"), hexa_str(""))))) && hexa_truthy(hexa_eq(hexa_map_get(hexa_map_get(node, "left"), "kind"), hexa_str("Ident")))))) {
            HexaVal typ = tc_lookup(hexa_map_get(hexa_map_get(node, "left"), "name"));
            if (hexa_truthy(hexa_eq(typ, hexa_str("")))) {
                tc_error(hexa_add(hexa_add(hexa_str("Assignment to undeclared variable '"), hexa_map_get(hexa_map_get(node, "left"), "name")), hexa_str("'")));
            }
        }
        tc_infer_expr(hexa_map_get(node, "left"));
        tc_infer_expr(hexa_map_get(node, "right"));
        return hexa_void();
    }
    if (hexa_truthy(hexa_eq(k, hexa_str("ExprStmt")))) {
        tc_infer_expr(hexa_map_get(node, "left"));
        return hexa_void();
    }
    if (hexa_truthy(hexa_eq(k, hexa_str("AssertStmt")))) {
        HexaVal t = tc_infer_expr(hexa_map_get(node, "left"));
        if (hexa_truthy(hexa_bool(hexa_truthy(hexa_bool(!hexa_truthy(hexa_eq(t, hexa_str("bool"))))) && hexa_truthy(hexa_bool(!hexa_truthy(hexa_eq(t, hexa_str("unknown")))))))) {
            tc_error(hexa_add(hexa_add(hexa_str("Assert expects bool expression, got '"), t), hexa_str("'")));
        }
        return hexa_void();
    }
    if (hexa_truthy(hexa_eq(k, hexa_str("UseStmt")))) {
        return hexa_void();
    }
    if (hexa_truthy(hexa_eq(k, hexa_str("ModStmt")))) {
        return hexa_void();
    }
    if (hexa_truthy(hexa_eq(k, hexa_str("ImportStmt")))) {
        return hexa_void();
    }
    if (hexa_truthy(hexa_eq(k, hexa_str("ProofStmt")))) {
        tc_push_scope();
        tc_check_stmts(hexa_map_get(node, "body"));
        tc_pop_scope();
        return hexa_void();
    }
    return hexa_void();
}


HexaVal tc_check_stmts(HexaVal stmts) {
    if (hexa_truthy(hexa_eq(stmts, hexa_str("")))) {
        return hexa_void();
    }
    HexaVal i = hexa_int(0);
    while (hexa_truthy(hexa_bool((i).i < (hexa_int(hexa_len(stmts))).i))) {
        tc_check_stmt(hexa_index_get(stmts, i));
        i = hexa_add(i, hexa_int(1));
    }
    return hexa_void();
}


HexaVal tc_first_pass(HexaVal stmts) {
    HexaVal i = hexa_int(0);
    while (hexa_truthy(hexa_bool((i).i < (hexa_int(hexa_len(stmts))).i))) {
        HexaVal s = hexa_index_get(stmts, i);
        if (hexa_truthy(hexa_eq(hexa_map_get(s, "kind"), hexa_str("FnDecl")))) {
            tc_register_fn(hexa_map_get(s, "name"), hexa_int(hexa_len(hexa_map_get(s, "params"))), annotation_to_type(hexa_map_get(s, "ret_type")));
            tc_define(hexa_map_get(s, "name"), hexa_str("fn"));
            HexaVal fp_tparams = hexa_map_get(s, "items");
            if (hexa_truthy(hexa_bool(hexa_truthy(hexa_bool(!hexa_truthy(hexa_eq(fp_tparams, hexa_str(""))))) && hexa_truthy(hexa_bool((hexa_int(hexa_len(fp_tparams))).i > (hexa_int(0)).i))))) {
                tc_register_generic_fn(hexa_map_get(s, "name"), fp_tparams);
            }
        }
        if (hexa_truthy(hexa_eq(hexa_map_get(s, "kind"), hexa_str("StructDecl")))) {
            HexaVal fc = hexa_int(hexa_len(hexa_map_get(s, "fields")));
            tc_register_struct(hexa_map_get(s, "name"), fc);
            HexaVal fi = hexa_int(0);
            while (hexa_truthy(hexa_bool((fi).i < (fc).i))) {
                tc_register_struct_field(hexa_map_get(hexa_index_get(hexa_map_get(s, "fields"), fi), "name"), hexa_map_get(hexa_index_get(hexa_map_get(s, "fields"), fi), "value"));
                fi = hexa_add(fi, hexa_int(1));
            }
            HexaVal sp_tparams = hexa_map_get(s, "items");
            if (hexa_truthy(hexa_bool(hexa_truthy(hexa_bool(!hexa_truthy(hexa_eq(sp_tparams, hexa_str(""))))) && hexa_truthy(hexa_bool((hexa_int(hexa_len(sp_tparams))).i > (hexa_int(0)).i))))) {
                tc_register_generic_struct(hexa_map_get(s, "name"), sp_tparams);
            }
            tc_define(hexa_map_get(s, "name"), hexa_str("type"));
        }
        if (hexa_truthy(hexa_eq(hexa_map_get(s, "kind"), hexa_str("EnumDecl")))) {
            HexaVal vc = hexa_int(hexa_len(hexa_map_get(s, "variants")));
            tc_register_enum(hexa_map_get(s, "name"), vc);
            HexaVal vi = hexa_int(0);
            while (hexa_truthy(hexa_bool((vi).i < (vc).i))) {
                tc_register_enum_variant(hexa_map_get(hexa_index_get(hexa_map_get(s, "variants"), vi), "name"));
                vi = hexa_add(vi, hexa_int(1));
            }
            tc_define(hexa_map_get(s, "name"), hexa_str("type"));
        }
        if (hexa_truthy(hexa_eq(hexa_map_get(s, "kind"), hexa_str("TraitDecl")))) {
            tc_define(hexa_map_get(s, "name"), hexa_str("type"));
        }
        i = hexa_add(i, hexa_int(1));
    }
    return hexa_void();
}


HexaVal type_check(HexaVal stmts) {
    tc_errors = hexa_array_new();
    scope_names = hexa_array_new();
    scope_types = hexa_array_new();
    scope_depths = hexa_array_new();
    tc_depth = hexa_int(0);
    fn_names = hexa_array_new();
    fn_arities = hexa_array_new();
    fn_ret_types = hexa_array_new();
    struct_names = hexa_array_new();
    struct_field_counts = hexa_array_new();
    struct_field_offsets = hexa_array_new();
    struct_all_field_names = hexa_array_new();
    struct_all_field_types = hexa_array_new();
    enum_names = hexa_array_new();
    enum_variant_counts = hexa_array_new();
    enum_variant_offsets = hexa_array_new();
    enum_all_variant_names = hexa_array_new();
    current_fn_ret_type = hexa_str("unknown");
    current_fn_name = hexa_str("");
    generic_struct_names = hexa_array_new();
    generic_struct_param_counts = hexa_array_new();
    generic_struct_param_offsets = hexa_array_new();
    generic_all_param_names = hexa_array_new();
    generic_all_param_bounds = hexa_array_new();
    generic_fn_names = hexa_array_new();
    generic_fn_param_counts = hexa_array_new();
    generic_fn_param_offsets = hexa_array_new();
    generic_fn_all_param_names = hexa_array_new();
    generic_fn_all_param_bounds = hexa_array_new();
    tparam_names = hexa_array_new();
    tparam_bound = hexa_array_new();
    tc_register_builtins();
    tc_first_pass(stmts);
    tc_check_stmts(stmts);
    return tc_errors;
    return hexa_void();
}


HexaVal type_check_ok(HexaVal stmts) {
    HexaVal errors = type_check(stmts);
    return hexa_eq(hexa_int(hexa_len(errors)), hexa_int(0));
    return hexa_void();
}


HexaVal print_type_errors(HexaVal errors) {
    HexaVal i = hexa_int(0);
    while (hexa_truthy(hexa_bool((i).i < (hexa_int(hexa_len(errors))).i))) {
        HexaVal e = hexa_index_get(errors, i);
        if (hexa_truthy(hexa_bool(!hexa_truthy(hexa_eq(hexa_map_get(e, "name"), hexa_str("")))))) {
            hexa_println(hexa_format_n(hexa_str("  TYPE ERROR [{}]: {}"), hexa_array_push(hexa_array_push(hexa_array_new(), hexa_map_get(e, "name")), hexa_map_get(e, "message"))));
        } else {
            hexa_println(hexa_format_n(hexa_str("  TYPE ERROR: {}"), hexa_array_push(hexa_array_new(), hexa_map_get(e, "message"))));
        }
        i = hexa_add(i, hexa_int(1));
    }
    return hexa_void();
}


HexaVal type_errors_count(HexaVal errors) {
    return hexa_int(hexa_len(errors));
    return hexa_void();
}


HexaVal type_errors_has(HexaVal errors, HexaVal substr) {
    HexaVal i = hexa_int(0);
    while (hexa_truthy(hexa_bool((i).i < (hexa_int(hexa_len(errors))).i))) {
        HexaVal msg = hexa_map_get(hexa_index_get(errors, i), "message");
        if (hexa_truthy(hexa_bool(hexa_str_contains(msg, substr)))) {
            return hexa_bool(1);
        }
        i = hexa_add(i, hexa_int(1));
    }
    return hexa_bool(0);
    return hexa_void();
}


HexaVal type_warnings_count(HexaVal errors) {
    HexaVal count = hexa_int(0);
    HexaVal i = hexa_int(0);
    while (hexa_truthy(hexa_bool((i).i < (hexa_int(hexa_len(errors))).i))) {
        if (hexa_truthy(hexa_bool(hexa_str_contains(hexa_map_get(hexa_index_get(errors, i), "message"), hexa_str("[warn]"))))) {
            count = hexa_add(count, hexa_int(1));
        }
        i = hexa_add(i, hexa_int(1));
    }
    return count;
    return hexa_void();
}


HexaVal mk(HexaVal kind, HexaVal name, HexaVal value, HexaVal op, HexaVal left, HexaVal right, HexaVal params, HexaVal body, HexaVal args, HexaVal fields, HexaVal variants, HexaVal arms, HexaVal ret_type) {
    return hexa_map_set(hexa_map_set(hexa_map_set(hexa_map_set(hexa_map_set(hexa_map_set(hexa_map_set(hexa_map_set(hexa_map_set(hexa_map_set(hexa_map_set(hexa_map_set(hexa_map_set(hexa_map_set(hexa_map_set(hexa_map_set(hexa_map_set(hexa_map_set(hexa_map_set(hexa_map_set(hexa_map_set(hexa_map_new(), "kind", kind), "name", name), "value", value), "op", op), "left", left), "right", right), "cond", hexa_str("")), "then_body", hexa_str("")), "else_body", hexa_str("")), "params", params), "body", body), "args", args), "fields", fields), "items", hexa_str("")), "variants", variants), "arms", arms), "iter_expr", hexa_str("")), "ret_type", ret_type), "target", hexa_str("")), "trait_name", hexa_str("")), "methods", hexa_str(""));
    return hexa_void();
}


HexaVal nd(HexaVal kind, HexaVal name) {
    return mk(kind, name, hexa_str(""), hexa_str(""), hexa_str(""), hexa_str(""), hexa_str(""), hexa_str(""), hexa_str(""), hexa_str(""), hexa_str(""), hexa_str(""), hexa_str(""));
    return hexa_void();
}


HexaVal lit(HexaVal kind, HexaVal val) {
    return mk(kind, hexa_str(""), val, hexa_str(""), hexa_str(""), hexa_str(""), hexa_str(""), hexa_str(""), hexa_str(""), hexa_str(""), hexa_str(""), hexa_str(""), hexa_str(""));
    return hexa_void();
}


HexaVal let_stmt(HexaVal name, HexaVal init) {
    return mk(hexa_str("LetStmt"), name, hexa_str(""), hexa_str(""), init, hexa_str(""), hexa_str(""), hexa_str(""), hexa_str(""), hexa_str(""), hexa_str(""), hexa_str(""), hexa_str(""));
    return hexa_void();
}


HexaVal expr_stmt(HexaVal e) {
    return mk(hexa_str("ExprStmt"), hexa_str(""), hexa_str(""), hexa_str(""), e, hexa_str(""), hexa_str(""), hexa_str(""), hexa_str(""), hexa_str(""), hexa_str(""), hexa_str(""), hexa_str(""));
    return hexa_void();
}


HexaVal ret_stmt(HexaVal e) {
    return mk(hexa_str("ReturnStmt"), hexa_str(""), hexa_str(""), hexa_str(""), e, hexa_str(""), hexa_str(""), hexa_str(""), hexa_str(""), hexa_str(""), hexa_str(""), hexa_str(""), hexa_str(""));
    return hexa_void();
}


HexaVal fn_decl(HexaVal name, HexaVal params, HexaVal body, HexaVal ret) {
    return mk(hexa_str("FnDecl"), name, hexa_str(""), hexa_str(""), hexa_str(""), hexa_str(""), params, body, hexa_str(""), hexa_str(""), hexa_str(""), hexa_str(""), ret);
    return hexa_void();
}


HexaVal call_node(HexaVal callee, HexaVal args) {
    return mk(hexa_str("Call"), hexa_str(""), hexa_str(""), hexa_str(""), callee, hexa_str(""), hexa_str(""), hexa_str(""), args, hexa_str(""), hexa_str(""), hexa_str(""), hexa_str(""));
    return hexa_void();
}


HexaVal field_node(HexaVal obj, HexaVal fname) {
    return mk(hexa_str("Field"), fname, hexa_str(""), hexa_str(""), obj, hexa_str(""), hexa_str(""), hexa_str(""), hexa_str(""), hexa_str(""), hexa_str(""), hexa_str(""), hexa_str(""));
    return hexa_void();
}


HexaVal binop_node(HexaVal op, HexaVal left, HexaVal right) {
    return mk(hexa_str("BinOp"), hexa_str(""), hexa_str(""), op, left, right, hexa_str(""), hexa_str(""), hexa_str(""), hexa_str(""), hexa_str(""), hexa_str(""), hexa_str(""));
    return hexa_void();
}


HexaVal struct_decl_node(HexaVal name, HexaVal fields) {
    return mk(hexa_str("StructDecl"), name, hexa_str(""), hexa_str(""), hexa_str(""), hexa_str(""), hexa_str(""), hexa_str(""), hexa_str(""), fields, hexa_str(""), hexa_str(""), hexa_str(""));
    return hexa_void();
}


HexaVal struct_field_node(HexaVal name, HexaVal typ) {
    return mk(hexa_str("StructField"), name, typ, hexa_str(""), hexa_str(""), hexa_str(""), hexa_str(""), hexa_str(""), hexa_str(""), hexa_str(""), hexa_str(""), hexa_str(""), hexa_str(""));
    return hexa_void();
}


HexaVal struct_init_node(HexaVal name, HexaVal fields) {
    return mk(hexa_str("StructInit"), name, hexa_str(""), hexa_str(""), hexa_str(""), hexa_str(""), hexa_str(""), hexa_str(""), hexa_str(""), fields, hexa_str(""), hexa_str(""), hexa_str(""));
    return hexa_void();
}


HexaVal field_init_node(HexaVal name, HexaVal val) {
    return mk(hexa_str("FieldInit"), name, hexa_str(""), hexa_str(""), val, hexa_str(""), hexa_str(""), hexa_str(""), hexa_str(""), hexa_str(""), hexa_str(""), hexa_str(""), hexa_str(""));
    return hexa_void();
}


HexaVal enum_decl_node(HexaVal name, HexaVal variants) {
    return mk(hexa_str("EnumDecl"), name, hexa_str(""), hexa_str(""), hexa_str(""), hexa_str(""), hexa_str(""), hexa_str(""), hexa_str(""), hexa_str(""), variants, hexa_str(""), hexa_str(""));
    return hexa_void();
}


HexaVal enum_variant_node(HexaVal name) {
    return nd(hexa_str("EnumVariant"), name);
    return hexa_void();
}


HexaVal match_expr_node(HexaVal scrutinee, HexaVal arms) {
    return mk(hexa_str("MatchExpr"), hexa_str(""), hexa_str(""), hexa_str(""), scrutinee, hexa_str(""), hexa_str(""), hexa_str(""), hexa_str(""), hexa_str(""), hexa_str(""), arms, hexa_str(""));
    return hexa_void();
}


HexaVal match_arm_node(HexaVal pattern, HexaVal body) {
    return mk(hexa_str("MatchArm"), hexa_str(""), hexa_str(""), hexa_str(""), pattern, hexa_str(""), hexa_str(""), body, hexa_str(""), hexa_str(""), hexa_str(""), hexa_str(""), hexa_str(""));
    return hexa_void();
}


HexaVal param_node(HexaVal name, HexaVal typ) {
    return mk(hexa_str("Param"), name, typ, hexa_str(""), hexa_str(""), hexa_str(""), hexa_str(""), hexa_str(""), hexa_str(""), hexa_str(""), hexa_str(""), hexa_str(""), hexa_str(""));
    return hexa_void();
}


int main() {
    tc_errors = hexa_array_new();
    scope_names = hexa_array_new();
    scope_types = hexa_array_new();
    scope_depths = hexa_array_new();
    tc_depth = hexa_int(0);
    fn_names = hexa_array_new();
    fn_arities = hexa_array_new();
    fn_ret_types = hexa_array_new();
    struct_names = hexa_array_new();
    struct_field_counts = hexa_array_new();
    struct_field_offsets = hexa_array_new();
    struct_all_field_names = hexa_array_new();
    struct_all_field_types = hexa_array_new();
    enum_names = hexa_array_new();
    enum_variant_counts = hexa_array_new();
    enum_variant_offsets = hexa_array_new();
    enum_all_variant_names = hexa_array_new();
    current_fn_ret_type = hexa_str("unknown");
    current_fn_name = hexa_str("");
    generic_struct_names = hexa_array_new();
    generic_struct_param_counts = hexa_array_new();
    generic_struct_param_offsets = hexa_array_new();
    generic_all_param_names = hexa_array_new();
    generic_all_param_bounds = hexa_array_new();
    generic_fn_names = hexa_array_new();
    generic_fn_param_counts = hexa_array_new();
    generic_fn_param_offsets = hexa_array_new();
    generic_fn_all_param_names = hexa_array_new();
    generic_fn_all_param_bounds = hexa_array_new();
    tparam_names = hexa_array_new();
    tparam_bound = hexa_array_new();
    test_pass = hexa_int(0);
    s1 = hexa_array_new();
    s1 = hexa_array_push(s1, let_stmt(hexa_str("x"), lit(hexa_str("IntLit"), hexa_str("42"))));
    s1 = hexa_array_push(s1, let_stmt(hexa_str("y"), lit(hexa_str("StringLit"), hexa_str("hello"))));
    s1 = hexa_array_push(s1, let_stmt(hexa_str("z"), lit(hexa_str("BoolLit"), hexa_str("true"))));
    s1 = hexa_array_push(s1, let_stmt(hexa_str("w"), lit(hexa_str("FloatLit"), hexa_str("3.14"))));
    HexaVal errs1 = type_check(s1);
    /* AssertStmt */
    type_check(s1);
    /* AssertStmt */
    /* AssertStmt */
    /* AssertStmt */
    /* AssertStmt */
    test_pass = hexa_add(test_pass, hexa_int(1));
    hexa_println(hexa_str("PASS: Test 1 — type inference for literals (int/string/bool/float)"));
    p2 = hexa_array_new();
    p2 = hexa_array_push(p2, param_node(hexa_str("a"), hexa_str("int")));
    p2 = hexa_array_push(p2, param_node(hexa_str("b"), hexa_str("int")));
    body2 = hexa_array_new();
    body2 = hexa_array_push(body2, ret_stmt(binop_node(hexa_str("+"), nd(hexa_str("Ident"), hexa_str("a")), nd(hexa_str("Ident"), hexa_str("b")))));
    HexaVal fd2 = fn_decl(hexa_str("add"), p2, body2, hexa_str("int"));
    args2a = hexa_array_new();
    args2a = hexa_array_push(args2a, lit(hexa_str("IntLit"), hexa_str("1")));
    args2a = hexa_array_push(args2a, lit(hexa_str("IntLit"), hexa_str("2")));
    s2a = hexa_array_new();
    s2a = hexa_array_push(s2a, fd2);
    s2a = hexa_array_push(s2a, expr_stmt(call_node(nd(hexa_str("Ident"), hexa_str("add")), args2a)));
    HexaVal errs2a = type_check(s2a);
    /* AssertStmt */
    test_pass = hexa_add(test_pass, hexa_int(1));
    hexa_println(hexa_str("PASS: Test 2a — correct arity (2 args) accepted"));
    args2b = hexa_array_new();
    args2b = hexa_array_push(args2b, lit(hexa_str("IntLit"), hexa_str("1")));
    args2b = hexa_array_push(args2b, lit(hexa_str("IntLit"), hexa_str("2")));
    args2b = hexa_array_push(args2b, lit(hexa_str("IntLit"), hexa_str("3")));
    s2b = hexa_array_new();
    s2b = hexa_array_push(s2b, fd2);
    s2b = hexa_array_push(s2b, expr_stmt(call_node(nd(hexa_str("Ident"), hexa_str("add")), args2b)));
    HexaVal errs2b = type_check(s2b);
    /* AssertStmt */
    /* AssertStmt */
    test_pass = hexa_add(test_pass, hexa_int(1));
    hexa_println(hexa_str("PASS: Test 2b — wrong arity (3 args) detected"));
    sf3 = hexa_array_new();
    sf3 = hexa_array_push(sf3, struct_field_node(hexa_str("x"), hexa_str("int")));
    sf3 = hexa_array_push(sf3, struct_field_node(hexa_str("y"), hexa_str("int")));
    HexaVal sd3 = struct_decl_node(hexa_str("Point"), sf3);
    fi3 = hexa_array_new();
    fi3 = hexa_array_push(fi3, field_init_node(hexa_str("x"), lit(hexa_str("IntLit"), hexa_str("10"))));
    fi3 = hexa_array_push(fi3, field_init_node(hexa_str("y"), lit(hexa_str("IntLit"), hexa_str("20"))));
    HexaVal lp3 = let_stmt(hexa_str("p"), struct_init_node(hexa_str("Point"), fi3));
    HexaVal fn3a = field_node(nd(hexa_str("Ident"), hexa_str("p")), hexa_str("x"));
    HexaVal es3a = expr_stmt(fn3a);
    s3a = hexa_array_new();
    s3a = hexa_array_push(s3a, sd3);
    s3a = hexa_array_push(s3a, lp3);
    s3a = hexa_array_push(s3a, es3a);
    HexaVal errs3a = type_check(s3a);
    /* AssertStmt */
    test_pass = hexa_add(test_pass, hexa_int(1));
    hexa_println(hexa_str("PASS: Test 3a — valid struct field access (Point.x)"));
    HexaVal fn3b = field_node(nd(hexa_str("Ident"), hexa_str("p")), hexa_str("z"));
    HexaVal es3b = expr_stmt(fn3b);
    s3b = hexa_array_new();
    s3b = hexa_array_push(s3b, sd3);
    s3b = hexa_array_push(s3b, lp3);
    s3b = hexa_array_push(s3b, es3b);
    HexaVal errs3b = type_check(s3b);
    /* AssertStmt */
    test_pass = hexa_add(test_pass, hexa_int(1));
    hexa_println(hexa_str("PASS: Test 3b — invalid struct field 'z' detected"));
    body4 = hexa_array_new();
    body4 = hexa_array_push(body4, ret_stmt(lit(hexa_str("StringLit"), hexa_str("oops"))));
    s4 = hexa_array_new();
    s4 = hexa_array_push(s4, fn_decl(hexa_str("get_num"), hexa_array_new(), body4, hexa_str("int")));
    HexaVal errs4 = type_check(s4);
    /* AssertStmt */
    test_pass = hexa_add(test_pass, hexa_int(1));
    hexa_println(hexa_str("PASS: Test 4 — return type mismatch (string vs int) detected"));
    ev5 = hexa_array_new();
    ev5 = hexa_array_push(ev5, enum_variant_node(hexa_str("Red")));
    ev5 = hexa_array_push(ev5, enum_variant_node(hexa_str("Green")));
    ev5 = hexa_array_push(ev5, enum_variant_node(hexa_str("Blue")));
    HexaVal ed5 = enum_decl_node(hexa_str("Color"), ev5);
    HexaVal lc5 = let_stmt(hexa_str("c"), nd(hexa_str("Ident"), hexa_str("c")));
    ab5a = hexa_array_new();
    ab5a = hexa_array_push(ab5a, expr_stmt(lit(hexa_str("IntLit"), hexa_str("0"))));
    arms5a = hexa_array_new();
    arms5a = hexa_array_push(arms5a, match_arm_node(nd(hexa_str("Wildcard"), hexa_str("_")), ab5a));
    s5a = hexa_array_new();
    s5a = hexa_array_push(s5a, ed5);
    s5a = hexa_array_push(s5a, mk(hexa_str("LetMutStmt"), hexa_str("c"), hexa_str("Color"), hexa_str(""), lit(hexa_str("StringLit"), hexa_str("Red")), hexa_str(""), hexa_str(""), hexa_str(""), hexa_str(""), hexa_str(""), hexa_str(""), hexa_str(""), hexa_str("")));
    s5a = hexa_array_push(s5a, expr_stmt(match_expr_node(nd(hexa_str("Ident"), hexa_str("c")), arms5a)));
    HexaVal errs5a = type_check(s5a);
    HexaVal w5a = type_warnings_count(errs5a);
    /* AssertStmt */
    test_pass = hexa_add(test_pass, hexa_int(1));
    hexa_println(hexa_str("PASS: Test 5a — match with wildcard (no exhaustiveness warning)"));
    ab5b = hexa_array_new();
    ab5b = hexa_array_push(ab5b, expr_stmt(lit(hexa_str("IntLit"), hexa_str("1"))));
    arms5b = hexa_array_new();
    arms5b = hexa_array_push(arms5b, match_arm_node(lit(hexa_str("IntLit"), hexa_str("0")), ab5b));
    s5b = hexa_array_new();
    s5b = hexa_array_push(s5b, expr_stmt(match_expr_node(nd(hexa_str("Ident"), hexa_str("unknown_var")), arms5b)));
    HexaVal errs5b = type_check(s5b);
    HexaVal w5b = type_warnings_count(errs5b);
    test_pass = hexa_add(test_pass, hexa_int(1));
    hexa_println(hexa_add(hexa_add(hexa_str("PASS: Test 5b — match without wildcard (warnings: "), hexa_to_string(w5b)), hexa_str(")")));
    s6 = hexa_array_new();
    s6 = hexa_array_push(s6, expr_stmt(nd(hexa_str("Ident"), hexa_str("undefined_a"))));
    s6 = hexa_array_push(s6, expr_stmt(nd(hexa_str("Ident"), hexa_str("undefined_b"))));
    s6 = hexa_array_push(s6, expr_stmt(nd(hexa_str("Ident"), hexa_str("undefined_c"))));
    HexaVal errs6 = type_check(s6);
    /* AssertStmt */
    /* AssertStmt */
    /* AssertStmt */
    /* AssertStmt */
    test_pass = hexa_add(test_pass, hexa_int(1));
    hexa_println(hexa_str("PASS: Test 6 — error accumulation (3 errors collected, not stopped at first)"));
    fi7 = hexa_array_new();
    fi7 = hexa_array_push(fi7, field_init_node(hexa_str("x"), lit(hexa_str("IntLit"), hexa_str("10"))));
    s7 = hexa_array_new();
    s7 = hexa_array_push(s7, sd3);
    s7 = hexa_array_push(s7, let_stmt(hexa_str("q"), struct_init_node(hexa_str("Point"), fi7)));
    HexaVal errs7 = type_check(s7);
    /* AssertStmt */
    test_pass = hexa_add(test_pass, hexa_int(1));
    hexa_println(hexa_str("PASS: Test 7 — struct init field count mismatch detected"));
    body8 = hexa_array_new();
    body8 = hexa_array_push(body8, ret_stmt(lit(hexa_str("IntLit"), hexa_str("42"))));
    s8 = hexa_array_new();
    s8 = hexa_array_push(s8, fn_decl(hexa_str("get_num2"), hexa_array_new(), body8, hexa_str("int")));
    HexaVal errs8 = type_check(s8);
    /* AssertStmt */
    test_pass = hexa_add(test_pass, hexa_int(1));
    hexa_println(hexa_str("PASS: Test 8 — correct return type (int -> int) accepted"));
    fi9 = hexa_array_new();
    fi9 = hexa_array_push(fi9, field_init_node(hexa_str("x"), lit(hexa_str("StringLit"), hexa_str("bad"))));
    fi9 = hexa_array_push(fi9, field_init_node(hexa_str("y"), lit(hexa_str("IntLit"), hexa_str("20"))));
    s9 = hexa_array_new();
    s9 = hexa_array_push(s9, sd3);
    s9 = hexa_array_push(s9, let_stmt(hexa_str("r"), struct_init_node(hexa_str("Point"), fi9)));
    HexaVal errs9 = type_check(s9);
    /* AssertStmt */
    test_pass = hexa_add(test_pass, hexa_int(1));
    hexa_println(hexa_str("PASS: Test 9 — struct field type mismatch (string into int field)"));
    inner_body = hexa_array_new();
    inner_body = hexa_array_push(inner_body, ret_stmt(lit(hexa_str("IntLit"), hexa_str("1"))));
    outer_body = hexa_array_new();
    outer_body = hexa_array_push(outer_body, fn_decl(hexa_str("inner"), hexa_array_new(), inner_body, hexa_str("int")));
    outer_body = hexa_array_push(outer_body, ret_stmt(lit(hexa_str("StringLit"), hexa_str("hello"))));
    s10 = hexa_array_new();
    s10 = hexa_array_push(s10, fn_decl(hexa_str("outer"), hexa_array_new(), outer_body, hexa_str("string")));
    HexaVal errs10 = type_check(s10);
    /* AssertStmt */
    test_pass = hexa_add(test_pass, hexa_int(1));
    hexa_println(hexa_str("PASS: Test 10 — nested fn return type isolation (inner:int, outer:string)"));
    hexa_println(hexa_str(""));
    hexa_println(hexa_add(hexa_add(hexa_str("=== self/type_checker.hexa — "), hexa_to_string(test_pass)), hexa_str(" tests passed ===")));
    return 0;
}
